//*****************************************************************************
//
// audio_test.c
//
// Copyright (c) 2019-2029 SemiDrive Incorporated.  All rights reserved.
// Software License Agreement
//
//*****************************************************************************

#include <sd_audio.h>
#include <stdio.h>

const pcm_params_t audio_pcm_test_params[] = {

// perform audio playback and capture on board (uni-direction).
// perform loopback to check if data transfer correct in simulation env.


/////////////////////////////////////////////////////////////////////////////mode 1//////////////////////////////////////////////////////////////////////////////////////////

//case 1~20
    {SD_AUDIO_TRANSFER_CODEC_SLAVE | SD_AUDIO_DIR_MODE_TRANSMIT | SD_AUDIO_CHANNEL_NUM_TX_MONO, SD_AUDIO_SR_44100, SD_AUDIO_SAMPLE_WIDTH_8BITS, SD_AUDIO_I2S_STANDARD_PHILLIPS},
    {SD_AUDIO_TRANSFER_CODEC_SLAVE | SD_AUDIO_DIR_MODE_TRANSMIT | SD_AUDIO_CHANNEL_NUM_TX_MONO, SD_AUDIO_SR_44100, SD_AUDIO_SAMPLE_WIDTH_8BITS, SD_AUDIO_I2S_LEFT_JUSTIFIED},
    {SD_AUDIO_TRANSFER_CODEC_SLAVE | SD_AUDIO_DIR_MODE_TRANSMIT | SD_AUDIO_CHANNEL_NUM_TX_MONO, SD_AUDIO_SR_44100, SD_AUDIO_SAMPLE_WIDTH_8BITS, SD_AUDIO_I2S_RIGHT_JUSTIFIED},
    {SD_AUDIO_TRANSFER_CODEC_SLAVE | SD_AUDIO_DIR_MODE_TRANSMIT | SD_AUDIO_CHANNEL_NUM_TX_MONO, SD_AUDIO_SR_44100, SD_AUDIO_SAMPLE_WIDTH_8BITS, SD_AUDIO_I2S_DSP_A},
    {SD_AUDIO_TRANSFER_CODEC_SLAVE | SD_AUDIO_DIR_MODE_TRANSMIT | SD_AUDIO_CHANNEL_NUM_TX_MONO, SD_AUDIO_SR_44100, SD_AUDIO_SAMPLE_WIDTH_8BITS, SD_AUDIO_I2S_DSP_B},

    {SD_AUDIO_TRANSFER_CODEC_SLAVE | SD_AUDIO_DIR_MODE_TRANSMIT | SD_AUDIO_CHANNEL_NUM_TX_MONO, SD_AUDIO_SR_44100, SD_AUDIO_SAMPLE_WIDTH_16BITS, SD_AUDIO_I2S_STANDARD_PHILLIPS},
    {SD_AUDIO_TRANSFER_CODEC_SLAVE | SD_AUDIO_DIR_MODE_TRANSMIT | SD_AUDIO_CHANNEL_NUM_TX_MONO, SD_AUDIO_SR_44100, SD_AUDIO_SAMPLE_WIDTH_16BITS, SD_AUDIO_I2S_LEFT_JUSTIFIED},
    {SD_AUDIO_TRANSFER_CODEC_SLAVE | SD_AUDIO_DIR_MODE_TRANSMIT | SD_AUDIO_CHANNEL_NUM_TX_MONO, SD_AUDIO_SR_44100, SD_AUDIO_SAMPLE_WIDTH_16BITS, SD_AUDIO_I2S_RIGHT_JUSTIFIED},
    {SD_AUDIO_TRANSFER_CODEC_SLAVE | SD_AUDIO_DIR_MODE_TRANSMIT | SD_AUDIO_CHANNEL_NUM_TX_MONO, SD_AUDIO_SR_44100, SD_AUDIO_SAMPLE_WIDTH_16BITS,  SD_AUDIO_I2S_DSP_A},
    {SD_AUDIO_TRANSFER_CODEC_SLAVE | SD_AUDIO_DIR_MODE_TRANSMIT | SD_AUDIO_CHANNEL_NUM_TX_MONO, SD_AUDIO_SR_44100, SD_AUDIO_SAMPLE_WIDTH_16BITS,  SD_AUDIO_I2S_DSP_B},

    {SD_AUDIO_TRANSFER_CODEC_SLAVE | SD_AUDIO_DIR_MODE_TRANSMIT | SD_AUDIO_CHANNEL_NUM_TX_MONO, SD_AUDIO_SR_44100, SD_AUDIO_SAMPLE_WIDTH_24BITS, SD_AUDIO_I2S_STANDARD_PHILLIPS},
    {SD_AUDIO_TRANSFER_CODEC_SLAVE | SD_AUDIO_DIR_MODE_TRANSMIT | SD_AUDIO_CHANNEL_NUM_TX_MONO, SD_AUDIO_SR_44100, SD_AUDIO_SAMPLE_WIDTH_24BITS, SD_AUDIO_I2S_LEFT_JUSTIFIED},
    {SD_AUDIO_TRANSFER_CODEC_SLAVE | SD_AUDIO_DIR_MODE_TRANSMIT | SD_AUDIO_CHANNEL_NUM_TX_MONO, SD_AUDIO_SR_44100, SD_AUDIO_SAMPLE_WIDTH_24BITS, SD_AUDIO_I2S_RIGHT_JUSTIFIED},
    {SD_AUDIO_TRANSFER_CODEC_SLAVE | SD_AUDIO_DIR_MODE_TRANSMIT | SD_AUDIO_CHANNEL_NUM_TX_MONO, SD_AUDIO_SR_44100, SD_AUDIO_SAMPLE_WIDTH_24BITS, SD_AUDIO_I2S_DSP_A},
    {SD_AUDIO_TRANSFER_CODEC_SLAVE | SD_AUDIO_DIR_MODE_TRANSMIT | SD_AUDIO_CHANNEL_NUM_TX_MONO, SD_AUDIO_SR_44100, SD_AUDIO_SAMPLE_WIDTH_24BITS, SD_AUDIO_I2S_DSP_B},

    {SD_AUDIO_TRANSFER_CODEC_SLAVE | SD_AUDIO_DIR_MODE_TRANSMIT | SD_AUDIO_CHANNEL_NUM_TX_MONO, SD_AUDIO_SR_44100, SD_AUDIO_SAMPLE_WIDTH_32BITS, SD_AUDIO_I2S_STANDARD_PHILLIPS},
    {SD_AUDIO_TRANSFER_CODEC_SLAVE | SD_AUDIO_DIR_MODE_TRANSMIT | SD_AUDIO_CHANNEL_NUM_TX_MONO, SD_AUDIO_SR_44100, SD_AUDIO_SAMPLE_WIDTH_32BITS, SD_AUDIO_I2S_LEFT_JUSTIFIED},
    {SD_AUDIO_TRANSFER_CODEC_SLAVE | SD_AUDIO_DIR_MODE_TRANSMIT | SD_AUDIO_CHANNEL_NUM_TX_MONO, SD_AUDIO_SR_44100, SD_AUDIO_SAMPLE_WIDTH_32BITS, SD_AUDIO_I2S_RIGHT_JUSTIFIED},
    {SD_AUDIO_TRANSFER_CODEC_SLAVE | SD_AUDIO_DIR_MODE_TRANSMIT | SD_AUDIO_CHANNEL_NUM_TX_MONO, SD_AUDIO_SR_44100, SD_AUDIO_SAMPLE_WIDTH_32BITS, SD_AUDIO_I2S_DSP_A},
    {SD_AUDIO_TRANSFER_CODEC_SLAVE | SD_AUDIO_DIR_MODE_TRANSMIT | SD_AUDIO_CHANNEL_NUM_TX_MONO, SD_AUDIO_SR_44100, SD_AUDIO_SAMPLE_WIDTH_32BITS, SD_AUDIO_I2S_DSP_B},


///////////////////////////////////////////////////////////////////////////////////////////////////////////////////////////////////////////////////////////////////////////////
//case 21~40
    {SD_AUDIO_TRANSFER_CODEC_SLAVE | SD_AUDIO_DIR_MODE_TRANSMIT | SD_AUDIO_CHANNEL_NUM_TX_MONO, SD_AUDIO_SR_48000, SD_AUDIO_SAMPLE_WIDTH_8BITS, SD_AUDIO_I2S_STANDARD_PHILLIPS},
    {SD_AUDIO_TRANSFER_CODEC_SLAVE | SD_AUDIO_DIR_MODE_TRANSMIT | SD_AUDIO_CHANNEL_NUM_TX_MONO, SD_AUDIO_SR_48000, SD_AUDIO_SAMPLE_WIDTH_8BITS, SD_AUDIO_I2S_LEFT_JUSTIFIED},
    {SD_AUDIO_TRANSFER_CODEC_SLAVE | SD_AUDIO_DIR_MODE_TRANSMIT | SD_AUDIO_CHANNEL_NUM_TX_MONO, SD_AUDIO_SR_48000, SD_AUDIO_SAMPLE_WIDTH_8BITS, SD_AUDIO_I2S_RIGHT_JUSTIFIED},
    {SD_AUDIO_TRANSFER_CODEC_SLAVE | SD_AUDIO_DIR_MODE_TRANSMIT | SD_AUDIO_CHANNEL_NUM_TX_MONO, SD_AUDIO_SR_48000, SD_AUDIO_SAMPLE_WIDTH_8BITS, SD_AUDIO_I2S_DSP_A},
    {SD_AUDIO_TRANSFER_CODEC_SLAVE | SD_AUDIO_DIR_MODE_TRANSMIT | SD_AUDIO_CHANNEL_NUM_TX_MONO, SD_AUDIO_SR_48000, SD_AUDIO_SAMPLE_WIDTH_8BITS, SD_AUDIO_I2S_DSP_B},

    {SD_AUDIO_TRANSFER_CODEC_SLAVE | SD_AUDIO_DIR_MODE_TRANSMIT | SD_AUDIO_CHANNEL_NUM_TX_MONO, SD_AUDIO_SR_48000, SD_AUDIO_SAMPLE_WIDTH_16BITS, SD_AUDIO_I2S_STANDARD_PHILLIPS},
    {SD_AUDIO_TRANSFER_CODEC_SLAVE | SD_AUDIO_DIR_MODE_TRANSMIT | SD_AUDIO_CHANNEL_NUM_TX_MONO, SD_AUDIO_SR_48000, SD_AUDIO_SAMPLE_WIDTH_16BITS, SD_AUDIO_I2S_LEFT_JUSTIFIED},
    {SD_AUDIO_TRANSFER_CODEC_SLAVE | SD_AUDIO_DIR_MODE_TRANSMIT | SD_AUDIO_CHANNEL_NUM_TX_MONO, SD_AUDIO_SR_48000, SD_AUDIO_SAMPLE_WIDTH_16BITS, SD_AUDIO_I2S_RIGHT_JUSTIFIED},
    {SD_AUDIO_TRANSFER_CODEC_SLAVE | SD_AUDIO_DIR_MODE_TRANSMIT | SD_AUDIO_CHANNEL_NUM_TX_MONO, SD_AUDIO_SR_48000, SD_AUDIO_SAMPLE_WIDTH_16BITS, SD_AUDIO_I2S_DSP_A},
    {SD_AUDIO_TRANSFER_CODEC_SLAVE | SD_AUDIO_DIR_MODE_TRANSMIT | SD_AUDIO_CHANNEL_NUM_TX_MONO, SD_AUDIO_SR_48000, SD_AUDIO_SAMPLE_WIDTH_16BITS, SD_AUDIO_I2S_DSP_B},

    {SD_AUDIO_TRANSFER_CODEC_SLAVE | SD_AUDIO_DIR_MODE_TRANSMIT | SD_AUDIO_CHANNEL_NUM_TX_MONO, SD_AUDIO_SR_48000, SD_AUDIO_SAMPLE_WIDTH_24BITS, SD_AUDIO_I2S_STANDARD_PHILLIPS},
    {SD_AUDIO_TRANSFER_CODEC_SLAVE | SD_AUDIO_DIR_MODE_TRANSMIT | SD_AUDIO_CHANNEL_NUM_TX_MONO, SD_AUDIO_SR_48000, SD_AUDIO_SAMPLE_WIDTH_24BITS, SD_AUDIO_I2S_LEFT_JUSTIFIED},
    {SD_AUDIO_TRANSFER_CODEC_SLAVE | SD_AUDIO_DIR_MODE_TRANSMIT | SD_AUDIO_CHANNEL_NUM_TX_MONO, SD_AUDIO_SR_48000, SD_AUDIO_SAMPLE_WIDTH_24BITS, SD_AUDIO_I2S_RIGHT_JUSTIFIED},
    {SD_AUDIO_TRANSFER_CODEC_SLAVE | SD_AUDIO_DIR_MODE_TRANSMIT | SD_AUDIO_CHANNEL_NUM_TX_MONO, SD_AUDIO_SR_48000, SD_AUDIO_SAMPLE_WIDTH_24BITS, SD_AUDIO_I2S_DSP_A},
    {SD_AUDIO_TRANSFER_CODEC_SLAVE | SD_AUDIO_DIR_MODE_TRANSMIT | SD_AUDIO_CHANNEL_NUM_TX_MONO, SD_AUDIO_SR_48000, SD_AUDIO_SAMPLE_WIDTH_24BITS, SD_AUDIO_I2S_DSP_B},

    {SD_AUDIO_TRANSFER_CODEC_SLAVE | SD_AUDIO_DIR_MODE_TRANSMIT | SD_AUDIO_CHANNEL_NUM_TX_MONO, SD_AUDIO_SR_48000, SD_AUDIO_SAMPLE_WIDTH_32BITS, SD_AUDIO_I2S_STANDARD_PHILLIPS},
    {SD_AUDIO_TRANSFER_CODEC_SLAVE | SD_AUDIO_DIR_MODE_TRANSMIT | SD_AUDIO_CHANNEL_NUM_TX_MONO, SD_AUDIO_SR_48000, SD_AUDIO_SAMPLE_WIDTH_32BITS, SD_AUDIO_I2S_LEFT_JUSTIFIED},
    {SD_AUDIO_TRANSFER_CODEC_SLAVE | SD_AUDIO_DIR_MODE_TRANSMIT | SD_AUDIO_CHANNEL_NUM_TX_MONO, SD_AUDIO_SR_48000, SD_AUDIO_SAMPLE_WIDTH_32BITS, SD_AUDIO_I2S_RIGHT_JUSTIFIED},
    {SD_AUDIO_TRANSFER_CODEC_SLAVE | SD_AUDIO_DIR_MODE_TRANSMIT | SD_AUDIO_CHANNEL_NUM_TX_MONO, SD_AUDIO_SR_48000, SD_AUDIO_SAMPLE_WIDTH_32BITS, SD_AUDIO_I2S_DSP_A},
    {SD_AUDIO_TRANSFER_CODEC_SLAVE | SD_AUDIO_DIR_MODE_TRANSMIT | SD_AUDIO_CHANNEL_NUM_TX_MONO, SD_AUDIO_SR_48000, SD_AUDIO_SAMPLE_WIDTH_32BITS, SD_AUDIO_I2S_DSP_B},


///////////////////////////////////////////////////////////////////////////////////////////////////////////////////////////////////////////////////////////////////////////////

//case 41~60
    {SD_AUDIO_TRANSFER_CODEC_SLAVE | SD_AUDIO_DIR_MODE_TRANSMIT | SD_AUDIO_CHANNEL_NUM_TX_MONO, SD_AUDIO_SR_96000, SD_AUDIO_SAMPLE_WIDTH_8BITS, SD_AUDIO_I2S_STANDARD_PHILLIPS},
    {SD_AUDIO_TRANSFER_CODEC_SLAVE | SD_AUDIO_DIR_MODE_TRANSMIT | SD_AUDIO_CHANNEL_NUM_TX_MONO, SD_AUDIO_SR_96000, SD_AUDIO_SAMPLE_WIDTH_8BITS, SD_AUDIO_I2S_LEFT_JUSTIFIED},
    {SD_AUDIO_TRANSFER_CODEC_SLAVE | SD_AUDIO_DIR_MODE_TRANSMIT | SD_AUDIO_CHANNEL_NUM_TX_MONO, SD_AUDIO_SR_96000, SD_AUDIO_SAMPLE_WIDTH_8BITS, SD_AUDIO_I2S_RIGHT_JUSTIFIED},
    {SD_AUDIO_TRANSFER_CODEC_SLAVE | SD_AUDIO_DIR_MODE_TRANSMIT | SD_AUDIO_CHANNEL_NUM_TX_MONO, SD_AUDIO_SR_96000, SD_AUDIO_SAMPLE_WIDTH_8BITS, SD_AUDIO_I2S_DSP_A},
    {SD_AUDIO_TRANSFER_CODEC_SLAVE | SD_AUDIO_DIR_MODE_TRANSMIT | SD_AUDIO_CHANNEL_NUM_TX_MONO, SD_AUDIO_SR_96000, SD_AUDIO_SAMPLE_WIDTH_8BITS, SD_AUDIO_I2S_DSP_B},

    {SD_AUDIO_TRANSFER_CODEC_SLAVE | SD_AUDIO_DIR_MODE_TRANSMIT | SD_AUDIO_CHANNEL_NUM_TX_MONO, SD_AUDIO_SR_96000, SD_AUDIO_SAMPLE_WIDTH_16BITS, SD_AUDIO_I2S_STANDARD_PHILLIPS},
    {SD_AUDIO_TRANSFER_CODEC_SLAVE | SD_AUDIO_DIR_MODE_TRANSMIT | SD_AUDIO_CHANNEL_NUM_TX_MONO, SD_AUDIO_SR_96000, SD_AUDIO_SAMPLE_WIDTH_16BITS, SD_AUDIO_I2S_LEFT_JUSTIFIED},
    {SD_AUDIO_TRANSFER_CODEC_SLAVE | SD_AUDIO_DIR_MODE_TRANSMIT | SD_AUDIO_CHANNEL_NUM_TX_MONO, SD_AUDIO_SR_96000, SD_AUDIO_SAMPLE_WIDTH_16BITS, SD_AUDIO_I2S_RIGHT_JUSTIFIED},
    {SD_AUDIO_TRANSFER_CODEC_SLAVE | SD_AUDIO_DIR_MODE_TRANSMIT | SD_AUDIO_CHANNEL_NUM_TX_MONO, SD_AUDIO_SR_96000, SD_AUDIO_SAMPLE_WIDTH_16BITS, SD_AUDIO_I2S_DSP_A},
    {SD_AUDIO_TRANSFER_CODEC_SLAVE | SD_AUDIO_DIR_MODE_TRANSMIT | SD_AUDIO_CHANNEL_NUM_TX_MONO, SD_AUDIO_SR_96000, SD_AUDIO_SAMPLE_WIDTH_16BITS, SD_AUDIO_I2S_DSP_B},

    {SD_AUDIO_TRANSFER_CODEC_SLAVE | SD_AUDIO_DIR_MODE_TRANSMIT | SD_AUDIO_CHANNEL_NUM_TX_MONO, SD_AUDIO_SR_96000, SD_AUDIO_SAMPLE_WIDTH_24BITS, SD_AUDIO_I2S_STANDARD_PHILLIPS},
    {SD_AUDIO_TRANSFER_CODEC_SLAVE | SD_AUDIO_DIR_MODE_TRANSMIT | SD_AUDIO_CHANNEL_NUM_TX_MONO, SD_AUDIO_SR_96000, SD_AUDIO_SAMPLE_WIDTH_24BITS, SD_AUDIO_I2S_LEFT_JUSTIFIED},
    {SD_AUDIO_TRANSFER_CODEC_SLAVE | SD_AUDIO_DIR_MODE_TRANSMIT | SD_AUDIO_CHANNEL_NUM_TX_MONO, SD_AUDIO_SR_96000, SD_AUDIO_SAMPLE_WIDTH_24BITS, SD_AUDIO_I2S_RIGHT_JUSTIFIED},
    {SD_AUDIO_TRANSFER_CODEC_SLAVE | SD_AUDIO_DIR_MODE_TRANSMIT | SD_AUDIO_CHANNEL_NUM_TX_MONO, SD_AUDIO_SR_96000, SD_AUDIO_SAMPLE_WIDTH_24BITS, SD_AUDIO_I2S_DSP_A},
    {SD_AUDIO_TRANSFER_CODEC_SLAVE | SD_AUDIO_DIR_MODE_TRANSMIT | SD_AUDIO_CHANNEL_NUM_TX_MONO, SD_AUDIO_SR_96000, SD_AUDIO_SAMPLE_WIDTH_24BITS, SD_AUDIO_I2S_DSP_B},

    {SD_AUDIO_TRANSFER_CODEC_SLAVE | SD_AUDIO_DIR_MODE_TRANSMIT | SD_AUDIO_CHANNEL_NUM_TX_MONO, SD_AUDIO_SR_96000, SD_AUDIO_SAMPLE_WIDTH_32BITS, SD_AUDIO_I2S_STANDARD_PHILLIPS},
    {SD_AUDIO_TRANSFER_CODEC_SLAVE | SD_AUDIO_DIR_MODE_TRANSMIT | SD_AUDIO_CHANNEL_NUM_TX_MONO, SD_AUDIO_SR_96000, SD_AUDIO_SAMPLE_WIDTH_32BITS, SD_AUDIO_I2S_LEFT_JUSTIFIED},
    {SD_AUDIO_TRANSFER_CODEC_SLAVE | SD_AUDIO_DIR_MODE_TRANSMIT | SD_AUDIO_CHANNEL_NUM_TX_MONO, SD_AUDIO_SR_96000, SD_AUDIO_SAMPLE_WIDTH_32BITS, SD_AUDIO_I2S_RIGHT_JUSTIFIED},
    {SD_AUDIO_TRANSFER_CODEC_SLAVE | SD_AUDIO_DIR_MODE_TRANSMIT | SD_AUDIO_CHANNEL_NUM_TX_MONO, SD_AUDIO_SR_96000, SD_AUDIO_SAMPLE_WIDTH_32BITS, SD_AUDIO_I2S_DSP_A},
    {SD_AUDIO_TRANSFER_CODEC_SLAVE | SD_AUDIO_DIR_MODE_TRANSMIT | SD_AUDIO_CHANNEL_NUM_TX_MONO, SD_AUDIO_SR_96000, SD_AUDIO_SAMPLE_WIDTH_32BITS, SD_AUDIO_I2S_DSP_B},


///////////////////////////////////////////////////////////////////////////////////////////////////////////////////////////////////////////////////////////////////////////////
//case 61~80
    {SD_AUDIO_TRANSFER_CODEC_SLAVE | SD_AUDIO_DIR_MODE_TRANSMIT | SD_AUDIO_CHANNEL_NUM_TX_MONO, SD_AUDIO_SR_192000, SD_AUDIO_SAMPLE_WIDTH_8BITS, SD_AUDIO_I2S_STANDARD_PHILLIPS},
    {SD_AUDIO_TRANSFER_CODEC_SLAVE | SD_AUDIO_DIR_MODE_TRANSMIT | SD_AUDIO_CHANNEL_NUM_TX_MONO, SD_AUDIO_SR_192000, SD_AUDIO_SAMPLE_WIDTH_8BITS, SD_AUDIO_I2S_LEFT_JUSTIFIED},
    {SD_AUDIO_TRANSFER_CODEC_SLAVE | SD_AUDIO_DIR_MODE_TRANSMIT | SD_AUDIO_CHANNEL_NUM_TX_MONO, SD_AUDIO_SR_192000, SD_AUDIO_SAMPLE_WIDTH_8BITS, SD_AUDIO_I2S_RIGHT_JUSTIFIED},
    {SD_AUDIO_TRANSFER_CODEC_SLAVE | SD_AUDIO_DIR_MODE_TRANSMIT | SD_AUDIO_CHANNEL_NUM_TX_MONO, SD_AUDIO_SR_192000, SD_AUDIO_SAMPLE_WIDTH_8BITS, SD_AUDIO_I2S_DSP_A},
    {SD_AUDIO_TRANSFER_CODEC_SLAVE | SD_AUDIO_DIR_MODE_TRANSMIT | SD_AUDIO_CHANNEL_NUM_TX_MONO, SD_AUDIO_SR_192000, SD_AUDIO_SAMPLE_WIDTH_8BITS, SD_AUDIO_I2S_DSP_B},

    {SD_AUDIO_TRANSFER_CODEC_SLAVE | SD_AUDIO_DIR_MODE_TRANSMIT | SD_AUDIO_CHANNEL_NUM_TX_MONO, SD_AUDIO_SR_192000, SD_AUDIO_SAMPLE_WIDTH_16BITS, SD_AUDIO_I2S_STANDARD_PHILLIPS},
    {SD_AUDIO_TRANSFER_CODEC_SLAVE | SD_AUDIO_DIR_MODE_TRANSMIT | SD_AUDIO_CHANNEL_NUM_TX_MONO, SD_AUDIO_SR_192000, SD_AUDIO_SAMPLE_WIDTH_16BITS, SD_AUDIO_I2S_LEFT_JUSTIFIED},
    {SD_AUDIO_TRANSFER_CODEC_SLAVE | SD_AUDIO_DIR_MODE_TRANSMIT | SD_AUDIO_CHANNEL_NUM_TX_MONO, SD_AUDIO_SR_192000, SD_AUDIO_SAMPLE_WIDTH_16BITS, SD_AUDIO_I2S_RIGHT_JUSTIFIED},
    {SD_AUDIO_TRANSFER_CODEC_SLAVE | SD_AUDIO_DIR_MODE_TRANSMIT | SD_AUDIO_CHANNEL_NUM_TX_MONO, SD_AUDIO_SR_192000, SD_AUDIO_SAMPLE_WIDTH_16BITS, SD_AUDIO_I2S_DSP_A},
    {SD_AUDIO_TRANSFER_CODEC_SLAVE | SD_AUDIO_DIR_MODE_TRANSMIT | SD_AUDIO_CHANNEL_NUM_TX_MONO, SD_AUDIO_SR_192000, SD_AUDIO_SAMPLE_WIDTH_16BITS, SD_AUDIO_I2S_DSP_B},

    {SD_AUDIO_TRANSFER_CODEC_SLAVE | SD_AUDIO_DIR_MODE_TRANSMIT | SD_AUDIO_CHANNEL_NUM_TX_MONO, SD_AUDIO_SR_192000, SD_AUDIO_SAMPLE_WIDTH_24BITS, SD_AUDIO_I2S_STANDARD_PHILLIPS},
    {SD_AUDIO_TRANSFER_CODEC_SLAVE | SD_AUDIO_DIR_MODE_TRANSMIT | SD_AUDIO_CHANNEL_NUM_TX_MONO, SD_AUDIO_SR_192000, SD_AUDIO_SAMPLE_WIDTH_24BITS, SD_AUDIO_I2S_LEFT_JUSTIFIED},
    {SD_AUDIO_TRANSFER_CODEC_SLAVE | SD_AUDIO_DIR_MODE_TRANSMIT | SD_AUDIO_CHANNEL_NUM_TX_MONO, SD_AUDIO_SR_192000, SD_AUDIO_SAMPLE_WIDTH_24BITS, SD_AUDIO_I2S_RIGHT_JUSTIFIED},
    {SD_AUDIO_TRANSFER_CODEC_SLAVE | SD_AUDIO_DIR_MODE_TRANSMIT | SD_AUDIO_CHANNEL_NUM_TX_MONO, SD_AUDIO_SR_192000, SD_AUDIO_SAMPLE_WIDTH_24BITS, SD_AUDIO_I2S_DSP_A},
    {SD_AUDIO_TRANSFER_CODEC_SLAVE | SD_AUDIO_DIR_MODE_TRANSMIT | SD_AUDIO_CHANNEL_NUM_TX_MONO, SD_AUDIO_SR_192000, SD_AUDIO_SAMPLE_WIDTH_24BITS, SD_AUDIO_I2S_DSP_B},

    {SD_AUDIO_TRANSFER_CODEC_SLAVE | SD_AUDIO_DIR_MODE_TRANSMIT | SD_AUDIO_CHANNEL_NUM_TX_MONO, SD_AUDIO_SR_192000, SD_AUDIO_SAMPLE_WIDTH_32BITS, SD_AUDIO_I2S_STANDARD_PHILLIPS},
    {SD_AUDIO_TRANSFER_CODEC_SLAVE | SD_AUDIO_DIR_MODE_TRANSMIT | SD_AUDIO_CHANNEL_NUM_TX_MONO, SD_AUDIO_SR_192000, SD_AUDIO_SAMPLE_WIDTH_32BITS, SD_AUDIO_I2S_LEFT_JUSTIFIED},
    {SD_AUDIO_TRANSFER_CODEC_SLAVE | SD_AUDIO_DIR_MODE_TRANSMIT | SD_AUDIO_CHANNEL_NUM_TX_MONO, SD_AUDIO_SR_192000, SD_AUDIO_SAMPLE_WIDTH_32BITS, SD_AUDIO_I2S_RIGHT_JUSTIFIED},
    {SD_AUDIO_TRANSFER_CODEC_SLAVE | SD_AUDIO_DIR_MODE_TRANSMIT | SD_AUDIO_CHANNEL_NUM_TX_MONO, SD_AUDIO_SR_192000, SD_AUDIO_SAMPLE_WIDTH_32BITS, SD_AUDIO_I2S_DSP_A},
    {SD_AUDIO_TRANSFER_CODEC_SLAVE | SD_AUDIO_DIR_MODE_TRANSMIT | SD_AUDIO_CHANNEL_NUM_TX_MONO, SD_AUDIO_SR_192000, SD_AUDIO_SAMPLE_WIDTH_32BITS, SD_AUDIO_I2S_DSP_B},




/////////////////////////////////////////////////////////////////////////////////////////mode 2/////////////////////////////////////////////////////////////////////////////

//case 81~100
    {SD_AUDIO_TRANSFER_CODEC_SLAVE | SD_AUDIO_DIR_MODE_TRANSMIT | SD_AUDIO_CHANNEL_NUM_TX_STEREO, SD_AUDIO_SR_44100, SD_AUDIO_SAMPLE_WIDTH_8BITS, SD_AUDIO_I2S_STANDARD_PHILLIPS},
    {SD_AUDIO_TRANSFER_CODEC_SLAVE | SD_AUDIO_DIR_MODE_TRANSMIT | SD_AUDIO_CHANNEL_NUM_TX_STEREO, SD_AUDIO_SR_44100, SD_AUDIO_SAMPLE_WIDTH_8BITS, SD_AUDIO_I2S_LEFT_JUSTIFIED},
    {SD_AUDIO_TRANSFER_CODEC_SLAVE | SD_AUDIO_DIR_MODE_TRANSMIT | SD_AUDIO_CHANNEL_NUM_TX_STEREO, SD_AUDIO_SR_44100, SD_AUDIO_SAMPLE_WIDTH_8BITS, SD_AUDIO_I2S_RIGHT_JUSTIFIED},
    {SD_AUDIO_TRANSFER_CODEC_SLAVE | SD_AUDIO_DIR_MODE_TRANSMIT | SD_AUDIO_CHANNEL_NUM_TX_STEREO, SD_AUDIO_SR_44100, SD_AUDIO_SAMPLE_WIDTH_8BITS, SD_AUDIO_I2S_DSP_A},
    {SD_AUDIO_TRANSFER_CODEC_SLAVE | SD_AUDIO_DIR_MODE_TRANSMIT | SD_AUDIO_CHANNEL_NUM_TX_STEREO, SD_AUDIO_SR_44100, SD_AUDIO_SAMPLE_WIDTH_8BITS, SD_AUDIO_I2S_DSP_B},

    {SD_AUDIO_TRANSFER_CODEC_SLAVE | SD_AUDIO_DIR_MODE_TRANSMIT | SD_AUDIO_CHANNEL_NUM_TX_STEREO, SD_AUDIO_SR_44100, SD_AUDIO_SAMPLE_WIDTH_16BITS, SD_AUDIO_I2S_STANDARD_PHILLIPS},
    {SD_AUDIO_TRANSFER_CODEC_SLAVE | SD_AUDIO_DIR_MODE_TRANSMIT | SD_AUDIO_CHANNEL_NUM_TX_STEREO, SD_AUDIO_SR_44100, SD_AUDIO_SAMPLE_WIDTH_16BITS, SD_AUDIO_I2S_LEFT_JUSTIFIED},
    {SD_AUDIO_TRANSFER_CODEC_SLAVE | SD_AUDIO_DIR_MODE_TRANSMIT | SD_AUDIO_CHANNEL_NUM_TX_STEREO, SD_AUDIO_SR_44100, SD_AUDIO_SAMPLE_WIDTH_16BITS, SD_AUDIO_I2S_RIGHT_JUSTIFIED},
    {SD_AUDIO_TRANSFER_CODEC_SLAVE | SD_AUDIO_DIR_MODE_TRANSMIT | SD_AUDIO_CHANNEL_NUM_TX_STEREO, SD_AUDIO_SR_44100, SD_AUDIO_SAMPLE_WIDTH_16BITS, SD_AUDIO_I2S_DSP_A},
    {SD_AUDIO_TRANSFER_CODEC_SLAVE | SD_AUDIO_DIR_MODE_TRANSMIT | SD_AUDIO_CHANNEL_NUM_TX_STEREO, SD_AUDIO_SR_44100, SD_AUDIO_SAMPLE_WIDTH_16BITS, SD_AUDIO_I2S_DSP_B},

    {SD_AUDIO_TRANSFER_CODEC_SLAVE | SD_AUDIO_DIR_MODE_TRANSMIT | SD_AUDIO_CHANNEL_NUM_TX_STEREO, SD_AUDIO_SR_44100, SD_AUDIO_SAMPLE_WIDTH_24BITS, SD_AUDIO_I2S_STANDARD_PHILLIPS},
    {SD_AUDIO_TRANSFER_CODEC_SLAVE | SD_AUDIO_DIR_MODE_TRANSMIT | SD_AUDIO_CHANNEL_NUM_TX_STEREO, SD_AUDIO_SR_44100, SD_AUDIO_SAMPLE_WIDTH_24BITS, SD_AUDIO_I2S_LEFT_JUSTIFIED},
    {SD_AUDIO_TRANSFER_CODEC_SLAVE | SD_AUDIO_DIR_MODE_TRANSMIT | SD_AUDIO_CHANNEL_NUM_TX_STEREO, SD_AUDIO_SR_44100, SD_AUDIO_SAMPLE_WIDTH_24BITS, SD_AUDIO_I2S_RIGHT_JUSTIFIED},
    {SD_AUDIO_TRANSFER_CODEC_SLAVE | SD_AUDIO_DIR_MODE_TRANSMIT | SD_AUDIO_CHANNEL_NUM_TX_STEREO, SD_AUDIO_SR_44100, SD_AUDIO_SAMPLE_WIDTH_24BITS, SD_AUDIO_I2S_DSP_A},
    {SD_AUDIO_TRANSFER_CODEC_SLAVE | SD_AUDIO_DIR_MODE_TRANSMIT | SD_AUDIO_CHANNEL_NUM_TX_STEREO, SD_AUDIO_SR_44100, SD_AUDIO_SAMPLE_WIDTH_24BITS, SD_AUDIO_I2S_DSP_B},

    {SD_AUDIO_TRANSFER_CODEC_SLAVE | SD_AUDIO_DIR_MODE_TRANSMIT | SD_AUDIO_CHANNEL_NUM_TX_STEREO, SD_AUDIO_SR_44100, SD_AUDIO_SAMPLE_WIDTH_32BITS, SD_AUDIO_I2S_STANDARD_PHILLIPS},
    {SD_AUDIO_TRANSFER_CODEC_SLAVE | SD_AUDIO_DIR_MODE_TRANSMIT | SD_AUDIO_CHANNEL_NUM_TX_STEREO, SD_AUDIO_SR_44100, SD_AUDIO_SAMPLE_WIDTH_32BITS, SD_AUDIO_I2S_LEFT_JUSTIFIED},
    {SD_AUDIO_TRANSFER_CODEC_SLAVE | SD_AUDIO_DIR_MODE_TRANSMIT | SD_AUDIO_CHANNEL_NUM_TX_STEREO, SD_AUDIO_SR_44100, SD_AUDIO_SAMPLE_WIDTH_32BITS, SD_AUDIO_I2S_RIGHT_JUSTIFIED},
    {SD_AUDIO_TRANSFER_CODEC_SLAVE | SD_AUDIO_DIR_MODE_TRANSMIT | SD_AUDIO_CHANNEL_NUM_TX_STEREO, SD_AUDIO_SR_44100, SD_AUDIO_SAMPLE_WIDTH_32BITS, SD_AUDIO_I2S_DSP_A},
    {SD_AUDIO_TRANSFER_CODEC_SLAVE | SD_AUDIO_DIR_MODE_TRANSMIT | SD_AUDIO_CHANNEL_NUM_TX_STEREO, SD_AUDIO_SR_44100, SD_AUDIO_SAMPLE_WIDTH_32BITS, SD_AUDIO_I2S_DSP_B},


////////////////////////////////////////////////////////////////////////////////////////////////////////////////////////////////////////////////////////////////////////////////
//case 101~120
    {SD_AUDIO_TRANSFER_CODEC_SLAVE | SD_AUDIO_DIR_MODE_TRANSMIT | SD_AUDIO_CHANNEL_NUM_TX_STEREO, SD_AUDIO_SR_48000, SD_AUDIO_SAMPLE_WIDTH_8BITS, SD_AUDIO_I2S_STANDARD_PHILLIPS},
    {SD_AUDIO_TRANSFER_CODEC_SLAVE | SD_AUDIO_DIR_MODE_TRANSMIT | SD_AUDIO_CHANNEL_NUM_TX_STEREO, SD_AUDIO_SR_48000, SD_AUDIO_SAMPLE_WIDTH_8BITS, SD_AUDIO_I2S_LEFT_JUSTIFIED},
    {SD_AUDIO_TRANSFER_CODEC_SLAVE | SD_AUDIO_DIR_MODE_TRANSMIT | SD_AUDIO_CHANNEL_NUM_TX_STEREO, SD_AUDIO_SR_48000, SD_AUDIO_SAMPLE_WIDTH_8BITS, SD_AUDIO_I2S_RIGHT_JUSTIFIED},
    {SD_AUDIO_TRANSFER_CODEC_SLAVE | SD_AUDIO_DIR_MODE_TRANSMIT | SD_AUDIO_CHANNEL_NUM_TX_STEREO, SD_AUDIO_SR_48000, SD_AUDIO_SAMPLE_WIDTH_8BITS, SD_AUDIO_I2S_DSP_A},
    {SD_AUDIO_TRANSFER_CODEC_SLAVE | SD_AUDIO_DIR_MODE_TRANSMIT | SD_AUDIO_CHANNEL_NUM_TX_STEREO, SD_AUDIO_SR_48000, SD_AUDIO_SAMPLE_WIDTH_8BITS, SD_AUDIO_I2S_DSP_B},

    {SD_AUDIO_TRANSFER_CODEC_SLAVE | SD_AUDIO_DIR_MODE_TRANSMIT | SD_AUDIO_CHANNEL_NUM_TX_STEREO, SD_AUDIO_SR_48000, SD_AUDIO_SAMPLE_WIDTH_16BITS, SD_AUDIO_I2S_STANDARD_PHILLIPS},
    {SD_AUDIO_TRANSFER_CODEC_SLAVE | SD_AUDIO_DIR_MODE_TRANSMIT | SD_AUDIO_CHANNEL_NUM_TX_STEREO, SD_AUDIO_SR_48000, SD_AUDIO_SAMPLE_WIDTH_16BITS, SD_AUDIO_I2S_LEFT_JUSTIFIED},
    {SD_AUDIO_TRANSFER_CODEC_SLAVE | SD_AUDIO_DIR_MODE_TRANSMIT | SD_AUDIO_CHANNEL_NUM_TX_STEREO, SD_AUDIO_SR_48000, SD_AUDIO_SAMPLE_WIDTH_16BITS, SD_AUDIO_I2S_RIGHT_JUSTIFIED},
    {SD_AUDIO_TRANSFER_CODEC_SLAVE | SD_AUDIO_DIR_MODE_TRANSMIT | SD_AUDIO_CHANNEL_NUM_TX_STEREO, SD_AUDIO_SR_48000, SD_AUDIO_SAMPLE_WIDTH_16BITS, SD_AUDIO_I2S_DSP_A},
    {SD_AUDIO_TRANSFER_CODEC_SLAVE | SD_AUDIO_DIR_MODE_TRANSMIT | SD_AUDIO_CHANNEL_NUM_TX_STEREO, SD_AUDIO_SR_48000, SD_AUDIO_SAMPLE_WIDTH_16BITS, SD_AUDIO_I2S_DSP_B},

    {SD_AUDIO_TRANSFER_CODEC_SLAVE | SD_AUDIO_DIR_MODE_TRANSMIT | SD_AUDIO_CHANNEL_NUM_TX_STEREO, SD_AUDIO_SR_48000, SD_AUDIO_SAMPLE_WIDTH_24BITS, SD_AUDIO_I2S_STANDARD_PHILLIPS},
    {SD_AUDIO_TRANSFER_CODEC_SLAVE | SD_AUDIO_DIR_MODE_TRANSMIT | SD_AUDIO_CHANNEL_NUM_TX_STEREO, SD_AUDIO_SR_48000, SD_AUDIO_SAMPLE_WIDTH_24BITS, SD_AUDIO_I2S_LEFT_JUSTIFIED},
    {SD_AUDIO_TRANSFER_CODEC_SLAVE | SD_AUDIO_DIR_MODE_TRANSMIT | SD_AUDIO_CHANNEL_NUM_TX_STEREO, SD_AUDIO_SR_48000, SD_AUDIO_SAMPLE_WIDTH_24BITS, SD_AUDIO_I2S_RIGHT_JUSTIFIED},
    {SD_AUDIO_TRANSFER_CODEC_SLAVE | SD_AUDIO_DIR_MODE_TRANSMIT | SD_AUDIO_CHANNEL_NUM_TX_STEREO, SD_AUDIO_SR_48000, SD_AUDIO_SAMPLE_WIDTH_24BITS, SD_AUDIO_I2S_DSP_A},
    {SD_AUDIO_TRANSFER_CODEC_SLAVE | SD_AUDIO_DIR_MODE_TRANSMIT | SD_AUDIO_CHANNEL_NUM_TX_STEREO, SD_AUDIO_SR_48000, SD_AUDIO_SAMPLE_WIDTH_24BITS, SD_AUDIO_I2S_DSP_B},

    {SD_AUDIO_TRANSFER_CODEC_SLAVE | SD_AUDIO_DIR_MODE_TRANSMIT | SD_AUDIO_CHANNEL_NUM_TX_STEREO, SD_AUDIO_SR_48000, SD_AUDIO_SAMPLE_WIDTH_32BITS, SD_AUDIO_I2S_STANDARD_PHILLIPS},
    {SD_AUDIO_TRANSFER_CODEC_SLAVE | SD_AUDIO_DIR_MODE_TRANSMIT | SD_AUDIO_CHANNEL_NUM_TX_STEREO, SD_AUDIO_SR_48000, SD_AUDIO_SAMPLE_WIDTH_32BITS, SD_AUDIO_I2S_LEFT_JUSTIFIED},
    {SD_AUDIO_TRANSFER_CODEC_SLAVE | SD_AUDIO_DIR_MODE_TRANSMIT | SD_AUDIO_CHANNEL_NUM_TX_STEREO, SD_AUDIO_SR_48000, SD_AUDIO_SAMPLE_WIDTH_32BITS, SD_AUDIO_I2S_RIGHT_JUSTIFIED},
    {SD_AUDIO_TRANSFER_CODEC_SLAVE | SD_AUDIO_DIR_MODE_TRANSMIT | SD_AUDIO_CHANNEL_NUM_TX_STEREO, SD_AUDIO_SR_48000, SD_AUDIO_SAMPLE_WIDTH_32BITS, SD_AUDIO_I2S_DSP_A},
    {SD_AUDIO_TRANSFER_CODEC_SLAVE | SD_AUDIO_DIR_MODE_TRANSMIT | SD_AUDIO_CHANNEL_NUM_TX_STEREO, SD_AUDIO_SR_48000, SD_AUDIO_SAMPLE_WIDTH_32BITS, SD_AUDIO_I2S_DSP_B},


////////////////////////////////////////////////////////////////////////////////////////////////////////////////////////////////////////////////////////////////////////////////
//case 121~140
    {SD_AUDIO_TRANSFER_CODEC_SLAVE | SD_AUDIO_DIR_MODE_TRANSMIT | SD_AUDIO_CHANNEL_NUM_TX_STEREO, SD_AUDIO_SR_96000, SD_AUDIO_SAMPLE_WIDTH_8BITS, SD_AUDIO_I2S_STANDARD_PHILLIPS},
    {SD_AUDIO_TRANSFER_CODEC_SLAVE | SD_AUDIO_DIR_MODE_TRANSMIT | SD_AUDIO_CHANNEL_NUM_TX_STEREO, SD_AUDIO_SR_96000, SD_AUDIO_SAMPLE_WIDTH_8BITS, SD_AUDIO_I2S_LEFT_JUSTIFIED},
    {SD_AUDIO_TRANSFER_CODEC_SLAVE | SD_AUDIO_DIR_MODE_TRANSMIT | SD_AUDIO_CHANNEL_NUM_TX_STEREO, SD_AUDIO_SR_96000, SD_AUDIO_SAMPLE_WIDTH_8BITS, SD_AUDIO_I2S_RIGHT_JUSTIFIED},
    {SD_AUDIO_TRANSFER_CODEC_SLAVE | SD_AUDIO_DIR_MODE_TRANSMIT | SD_AUDIO_CHANNEL_NUM_TX_STEREO, SD_AUDIO_SR_96000, SD_AUDIO_SAMPLE_WIDTH_8BITS, SD_AUDIO_I2S_DSP_A},
    {SD_AUDIO_TRANSFER_CODEC_SLAVE | SD_AUDIO_DIR_MODE_TRANSMIT | SD_AUDIO_CHANNEL_NUM_TX_STEREO, SD_AUDIO_SR_96000, SD_AUDIO_SAMPLE_WIDTH_8BITS, SD_AUDIO_I2S_DSP_B},

    {SD_AUDIO_TRANSFER_CODEC_SLAVE | SD_AUDIO_DIR_MODE_TRANSMIT | SD_AUDIO_CHANNEL_NUM_TX_STEREO, SD_AUDIO_SR_96000, SD_AUDIO_SAMPLE_WIDTH_16BITS, SD_AUDIO_I2S_STANDARD_PHILLIPS},
    {SD_AUDIO_TRANSFER_CODEC_SLAVE | SD_AUDIO_DIR_MODE_TRANSMIT | SD_AUDIO_CHANNEL_NUM_TX_STEREO, SD_AUDIO_SR_96000, SD_AUDIO_SAMPLE_WIDTH_16BITS, SD_AUDIO_I2S_LEFT_JUSTIFIED},
    {SD_AUDIO_TRANSFER_CODEC_SLAVE | SD_AUDIO_DIR_MODE_TRANSMIT | SD_AUDIO_CHANNEL_NUM_TX_STEREO, SD_AUDIO_SR_96000, SD_AUDIO_SAMPLE_WIDTH_16BITS, SD_AUDIO_I2S_RIGHT_JUSTIFIED},
    {SD_AUDIO_TRANSFER_CODEC_SLAVE | SD_AUDIO_DIR_MODE_TRANSMIT | SD_AUDIO_CHANNEL_NUM_TX_STEREO, SD_AUDIO_SR_96000, SD_AUDIO_SAMPLE_WIDTH_16BITS, SD_AUDIO_I2S_DSP_A},
    {SD_AUDIO_TRANSFER_CODEC_SLAVE | SD_AUDIO_DIR_MODE_TRANSMIT | SD_AUDIO_CHANNEL_NUM_TX_STEREO, SD_AUDIO_SR_96000, SD_AUDIO_SAMPLE_WIDTH_16BITS, SD_AUDIO_I2S_DSP_B},

    {SD_AUDIO_TRANSFER_CODEC_SLAVE | SD_AUDIO_DIR_MODE_TRANSMIT | SD_AUDIO_CHANNEL_NUM_TX_STEREO, SD_AUDIO_SR_96000, SD_AUDIO_SAMPLE_WIDTH_24BITS, SD_AUDIO_I2S_STANDARD_PHILLIPS},
    {SD_AUDIO_TRANSFER_CODEC_SLAVE | SD_AUDIO_DIR_MODE_TRANSMIT | SD_AUDIO_CHANNEL_NUM_TX_STEREO, SD_AUDIO_SR_96000, SD_AUDIO_SAMPLE_WIDTH_24BITS, SD_AUDIO_I2S_LEFT_JUSTIFIED},
    {SD_AUDIO_TRANSFER_CODEC_SLAVE | SD_AUDIO_DIR_MODE_TRANSMIT | SD_AUDIO_CHANNEL_NUM_TX_STEREO, SD_AUDIO_SR_96000, SD_AUDIO_SAMPLE_WIDTH_24BITS, SD_AUDIO_I2S_RIGHT_JUSTIFIED},
    {SD_AUDIO_TRANSFER_CODEC_SLAVE | SD_AUDIO_DIR_MODE_TRANSMIT | SD_AUDIO_CHANNEL_NUM_TX_STEREO, SD_AUDIO_SR_96000, SD_AUDIO_SAMPLE_WIDTH_24BITS, SD_AUDIO_I2S_DSP_A},
    {SD_AUDIO_TRANSFER_CODEC_SLAVE | SD_AUDIO_DIR_MODE_TRANSMIT | SD_AUDIO_CHANNEL_NUM_TX_STEREO, SD_AUDIO_SR_96000, SD_AUDIO_SAMPLE_WIDTH_24BITS, SD_AUDIO_I2S_DSP_B},

    {SD_AUDIO_TRANSFER_CODEC_SLAVE | SD_AUDIO_DIR_MODE_TRANSMIT | SD_AUDIO_CHANNEL_NUM_TX_STEREO, SD_AUDIO_SR_96000, SD_AUDIO_SAMPLE_WIDTH_32BITS, SD_AUDIO_I2S_STANDARD_PHILLIPS},
    {SD_AUDIO_TRANSFER_CODEC_SLAVE | SD_AUDIO_DIR_MODE_TRANSMIT | SD_AUDIO_CHANNEL_NUM_TX_STEREO, SD_AUDIO_SR_96000, SD_AUDIO_SAMPLE_WIDTH_32BITS, SD_AUDIO_I2S_LEFT_JUSTIFIED},
    {SD_AUDIO_TRANSFER_CODEC_SLAVE | SD_AUDIO_DIR_MODE_TRANSMIT | SD_AUDIO_CHANNEL_NUM_TX_STEREO, SD_AUDIO_SR_96000, SD_AUDIO_SAMPLE_WIDTH_32BITS, SD_AUDIO_I2S_RIGHT_JUSTIFIED},
    {SD_AUDIO_TRANSFER_CODEC_SLAVE | SD_AUDIO_DIR_MODE_TRANSMIT | SD_AUDIO_CHANNEL_NUM_TX_STEREO, SD_AUDIO_SR_96000, SD_AUDIO_SAMPLE_WIDTH_32BITS, SD_AUDIO_I2S_DSP_A},
    {SD_AUDIO_TRANSFER_CODEC_SLAVE | SD_AUDIO_DIR_MODE_TRANSMIT | SD_AUDIO_CHANNEL_NUM_TX_STEREO, SD_AUDIO_SR_96000, SD_AUDIO_SAMPLE_WIDTH_32BITS, SD_AUDIO_I2S_DSP_B},


////////////////////////////////////////////////////////////////////////////////////////////////////////////////////////////////////////////////////////////////////////////////
//case 141~160
    {SD_AUDIO_TRANSFER_CODEC_SLAVE | SD_AUDIO_DIR_MODE_TRANSMIT | SD_AUDIO_CHANNEL_NUM_TX_STEREO, SD_AUDIO_SR_192000, SD_AUDIO_SAMPLE_WIDTH_8BITS, SD_AUDIO_I2S_STANDARD_PHILLIPS},
    {SD_AUDIO_TRANSFER_CODEC_SLAVE | SD_AUDIO_DIR_MODE_TRANSMIT | SD_AUDIO_CHANNEL_NUM_TX_STEREO, SD_AUDIO_SR_192000, SD_AUDIO_SAMPLE_WIDTH_8BITS, SD_AUDIO_I2S_LEFT_JUSTIFIED},
    {SD_AUDIO_TRANSFER_CODEC_SLAVE | SD_AUDIO_DIR_MODE_TRANSMIT | SD_AUDIO_CHANNEL_NUM_TX_STEREO, SD_AUDIO_SR_192000, SD_AUDIO_SAMPLE_WIDTH_8BITS, SD_AUDIO_I2S_RIGHT_JUSTIFIED},
    {SD_AUDIO_TRANSFER_CODEC_SLAVE | SD_AUDIO_DIR_MODE_TRANSMIT | SD_AUDIO_CHANNEL_NUM_TX_STEREO, SD_AUDIO_SR_192000, SD_AUDIO_SAMPLE_WIDTH_8BITS, SD_AUDIO_I2S_DSP_A},
    {SD_AUDIO_TRANSFER_CODEC_SLAVE | SD_AUDIO_DIR_MODE_TRANSMIT | SD_AUDIO_CHANNEL_NUM_TX_STEREO, SD_AUDIO_SR_192000, SD_AUDIO_SAMPLE_WIDTH_8BITS, SD_AUDIO_I2S_DSP_B},

    {SD_AUDIO_TRANSFER_CODEC_SLAVE | SD_AUDIO_DIR_MODE_TRANSMIT | SD_AUDIO_CHANNEL_NUM_TX_STEREO, SD_AUDIO_SR_192000, SD_AUDIO_SAMPLE_WIDTH_16BITS, SD_AUDIO_I2S_STANDARD_PHILLIPS},
    {SD_AUDIO_TRANSFER_CODEC_SLAVE | SD_AUDIO_DIR_MODE_TRANSMIT | SD_AUDIO_CHANNEL_NUM_TX_STEREO, SD_AUDIO_SR_192000, SD_AUDIO_SAMPLE_WIDTH_16BITS, SD_AUDIO_I2S_LEFT_JUSTIFIED},
    {SD_AUDIO_TRANSFER_CODEC_SLAVE | SD_AUDIO_DIR_MODE_TRANSMIT | SD_AUDIO_CHANNEL_NUM_TX_STEREO, SD_AUDIO_SR_192000, SD_AUDIO_SAMPLE_WIDTH_16BITS, SD_AUDIO_I2S_RIGHT_JUSTIFIED},
    {SD_AUDIO_TRANSFER_CODEC_SLAVE | SD_AUDIO_DIR_MODE_TRANSMIT | SD_AUDIO_CHANNEL_NUM_TX_STEREO, SD_AUDIO_SR_192000, SD_AUDIO_SAMPLE_WIDTH_16BITS, SD_AUDIO_I2S_DSP_A},
    {SD_AUDIO_TRANSFER_CODEC_SLAVE | SD_AUDIO_DIR_MODE_TRANSMIT | SD_AUDIO_CHANNEL_NUM_TX_STEREO, SD_AUDIO_SR_192000, SD_AUDIO_SAMPLE_WIDTH_16BITS, SD_AUDIO_I2S_DSP_B},

    {SD_AUDIO_TRANSFER_CODEC_SLAVE | SD_AUDIO_DIR_MODE_TRANSMIT | SD_AUDIO_CHANNEL_NUM_TX_STEREO, SD_AUDIO_SR_192000, SD_AUDIO_SAMPLE_WIDTH_24BITS, SD_AUDIO_I2S_STANDARD_PHILLIPS},
    {SD_AUDIO_TRANSFER_CODEC_SLAVE | SD_AUDIO_DIR_MODE_TRANSMIT | SD_AUDIO_CHANNEL_NUM_TX_STEREO, SD_AUDIO_SR_192000, SD_AUDIO_SAMPLE_WIDTH_24BITS, SD_AUDIO_I2S_LEFT_JUSTIFIED},
    {SD_AUDIO_TRANSFER_CODEC_SLAVE | SD_AUDIO_DIR_MODE_TRANSMIT | SD_AUDIO_CHANNEL_NUM_TX_STEREO, SD_AUDIO_SR_192000, SD_AUDIO_SAMPLE_WIDTH_24BITS, SD_AUDIO_I2S_RIGHT_JUSTIFIED},
    {SD_AUDIO_TRANSFER_CODEC_SLAVE | SD_AUDIO_DIR_MODE_TRANSMIT | SD_AUDIO_CHANNEL_NUM_TX_STEREO, SD_AUDIO_SR_192000, SD_AUDIO_SAMPLE_WIDTH_24BITS, SD_AUDIO_I2S_DSP_A},
    {SD_AUDIO_TRANSFER_CODEC_SLAVE | SD_AUDIO_DIR_MODE_TRANSMIT | SD_AUDIO_CHANNEL_NUM_TX_STEREO, SD_AUDIO_SR_192000, SD_AUDIO_SAMPLE_WIDTH_24BITS, SD_AUDIO_I2S_DSP_B},

    {SD_AUDIO_TRANSFER_CODEC_SLAVE | SD_AUDIO_DIR_MODE_TRANSMIT | SD_AUDIO_CHANNEL_NUM_TX_STEREO, SD_AUDIO_SR_192000, SD_AUDIO_SAMPLE_WIDTH_32BITS, SD_AUDIO_I2S_STANDARD_PHILLIPS},
    {SD_AUDIO_TRANSFER_CODEC_SLAVE | SD_AUDIO_DIR_MODE_TRANSMIT | SD_AUDIO_CHANNEL_NUM_TX_STEREO, SD_AUDIO_SR_192000, SD_AUDIO_SAMPLE_WIDTH_32BITS, SD_AUDIO_I2S_LEFT_JUSTIFIED},
    {SD_AUDIO_TRANSFER_CODEC_SLAVE | SD_AUDIO_DIR_MODE_TRANSMIT | SD_AUDIO_CHANNEL_NUM_TX_STEREO, SD_AUDIO_SR_192000, SD_AUDIO_SAMPLE_WIDTH_32BITS, SD_AUDIO_I2S_RIGHT_JUSTIFIED},
    {SD_AUDIO_TRANSFER_CODEC_SLAVE | SD_AUDIO_DIR_MODE_TRANSMIT | SD_AUDIO_CHANNEL_NUM_TX_STEREO, SD_AUDIO_SR_192000, SD_AUDIO_SAMPLE_WIDTH_32BITS, SD_AUDIO_I2S_DSP_A},
    {SD_AUDIO_TRANSFER_CODEC_SLAVE | SD_AUDIO_DIR_MODE_TRANSMIT | SD_AUDIO_CHANNEL_NUM_TX_STEREO, SD_AUDIO_SR_192000, SD_AUDIO_SAMPLE_WIDTH_32BITS, SD_AUDIO_I2S_DSP_B},



/////////////////////////////////////////////////////////////////////////////////////////mode 3/////////////////////////////////////////////////////////////////////////////

//case 161~180
    {SD_AUDIO_TRANSFER_CODEC_SLAVE | SD_AUDIO_DIR_MODE_RECEIVE | SD_AUDIO_CHANNEL_NUM_RX_MONO, SD_AUDIO_SR_44100, SD_AUDIO_SAMPLE_WIDTH_8BITS, SD_AUDIO_I2S_STANDARD_PHILLIPS},
    {SD_AUDIO_TRANSFER_CODEC_SLAVE | SD_AUDIO_DIR_MODE_RECEIVE | SD_AUDIO_CHANNEL_NUM_RX_MONO, SD_AUDIO_SR_44100, SD_AUDIO_SAMPLE_WIDTH_8BITS, SD_AUDIO_I2S_LEFT_JUSTIFIED},
    {SD_AUDIO_TRANSFER_CODEC_SLAVE | SD_AUDIO_DIR_MODE_RECEIVE | SD_AUDIO_CHANNEL_NUM_RX_MONO, SD_AUDIO_SR_44100, SD_AUDIO_SAMPLE_WIDTH_8BITS, SD_AUDIO_I2S_RIGHT_JUSTIFIED},
    {SD_AUDIO_TRANSFER_CODEC_SLAVE | SD_AUDIO_DIR_MODE_RECEIVE | SD_AUDIO_CHANNEL_NUM_RX_MONO, SD_AUDIO_SR_44100, SD_AUDIO_SAMPLE_WIDTH_8BITS, SD_AUDIO_I2S_DSP_A},
    {SD_AUDIO_TRANSFER_CODEC_SLAVE | SD_AUDIO_DIR_MODE_RECEIVE | SD_AUDIO_CHANNEL_NUM_RX_MONO, SD_AUDIO_SR_44100, SD_AUDIO_SAMPLE_WIDTH_8BITS, SD_AUDIO_I2S_DSP_B},

    {SD_AUDIO_TRANSFER_CODEC_SLAVE | SD_AUDIO_DIR_MODE_RECEIVE | SD_AUDIO_CHANNEL_NUM_RX_MONO, SD_AUDIO_SR_44100, SD_AUDIO_SAMPLE_WIDTH_16BITS, SD_AUDIO_I2S_STANDARD_PHILLIPS},
    {SD_AUDIO_TRANSFER_CODEC_SLAVE | SD_AUDIO_DIR_MODE_RECEIVE | SD_AUDIO_CHANNEL_NUM_RX_MONO, SD_AUDIO_SR_44100, SD_AUDIO_SAMPLE_WIDTH_16BITS, SD_AUDIO_I2S_LEFT_JUSTIFIED},
    {SD_AUDIO_TRANSFER_CODEC_SLAVE | SD_AUDIO_DIR_MODE_RECEIVE | SD_AUDIO_CHANNEL_NUM_RX_MONO, SD_AUDIO_SR_44100, SD_AUDIO_SAMPLE_WIDTH_16BITS, SD_AUDIO_I2S_RIGHT_JUSTIFIED},
    {SD_AUDIO_TRANSFER_CODEC_SLAVE | SD_AUDIO_DIR_MODE_RECEIVE | SD_AUDIO_CHANNEL_NUM_RX_MONO, SD_AUDIO_SR_44100, SD_AUDIO_SAMPLE_WIDTH_16BITS, SD_AUDIO_I2S_DSP_A},
    {SD_AUDIO_TRANSFER_CODEC_SLAVE | SD_AUDIO_DIR_MODE_RECEIVE | SD_AUDIO_CHANNEL_NUM_RX_MONO, SD_AUDIO_SR_44100, SD_AUDIO_SAMPLE_WIDTH_16BITS, SD_AUDIO_I2S_DSP_B},

    {SD_AUDIO_TRANSFER_CODEC_SLAVE | SD_AUDIO_DIR_MODE_RECEIVE | SD_AUDIO_CHANNEL_NUM_RX_MONO, SD_AUDIO_SR_44100, SD_AUDIO_SAMPLE_WIDTH_24BITS, SD_AUDIO_I2S_STANDARD_PHILLIPS},
    {SD_AUDIO_TRANSFER_CODEC_SLAVE | SD_AUDIO_DIR_MODE_RECEIVE | SD_AUDIO_CHANNEL_NUM_RX_MONO, SD_AUDIO_SR_44100, SD_AUDIO_SAMPLE_WIDTH_24BITS, SD_AUDIO_I2S_LEFT_JUSTIFIED},
    {SD_AUDIO_TRANSFER_CODEC_SLAVE | SD_AUDIO_DIR_MODE_RECEIVE | SD_AUDIO_CHANNEL_NUM_RX_MONO, SD_AUDIO_SR_44100, SD_AUDIO_SAMPLE_WIDTH_24BITS, SD_AUDIO_I2S_RIGHT_JUSTIFIED},
    {SD_AUDIO_TRANSFER_CODEC_SLAVE | SD_AUDIO_DIR_MODE_RECEIVE | SD_AUDIO_CHANNEL_NUM_RX_MONO, SD_AUDIO_SR_44100, SD_AUDIO_SAMPLE_WIDTH_24BITS, SD_AUDIO_I2S_DSP_A},
    {SD_AUDIO_TRANSFER_CODEC_SLAVE | SD_AUDIO_DIR_MODE_RECEIVE | SD_AUDIO_CHANNEL_NUM_RX_MONO, SD_AUDIO_SR_44100, SD_AUDIO_SAMPLE_WIDTH_24BITS, SD_AUDIO_I2S_DSP_B},

    {SD_AUDIO_TRANSFER_CODEC_SLAVE | SD_AUDIO_DIR_MODE_RECEIVE | SD_AUDIO_CHANNEL_NUM_RX_MONO, SD_AUDIO_SR_44100, SD_AUDIO_SAMPLE_WIDTH_32BITS, SD_AUDIO_I2S_STANDARD_PHILLIPS},
    {SD_AUDIO_TRANSFER_CODEC_SLAVE | SD_AUDIO_DIR_MODE_RECEIVE | SD_AUDIO_CHANNEL_NUM_RX_MONO, SD_AUDIO_SR_44100, SD_AUDIO_SAMPLE_WIDTH_32BITS, SD_AUDIO_I2S_LEFT_JUSTIFIED},
    {SD_AUDIO_TRANSFER_CODEC_SLAVE | SD_AUDIO_DIR_MODE_RECEIVE | SD_AUDIO_CHANNEL_NUM_RX_MONO, SD_AUDIO_SR_44100, SD_AUDIO_SAMPLE_WIDTH_32BITS, SD_AUDIO_I2S_RIGHT_JUSTIFIED},
    {SD_AUDIO_TRANSFER_CODEC_SLAVE | SD_AUDIO_DIR_MODE_RECEIVE | SD_AUDIO_CHANNEL_NUM_RX_MONO, SD_AUDIO_SR_44100, SD_AUDIO_SAMPLE_WIDTH_32BITS, SD_AUDIO_I2S_DSP_A},
    {SD_AUDIO_TRANSFER_CODEC_SLAVE | SD_AUDIO_DIR_MODE_RECEIVE | SD_AUDIO_CHANNEL_NUM_RX_MONO, SD_AUDIO_SR_44100, SD_AUDIO_SAMPLE_WIDTH_32BITS, SD_AUDIO_I2S_DSP_B},


//////////////////////////////////////////////////////////////////////////////////////////////////////////////////////////////////////////////////////////////////////////////
//case 181~200
    {SD_AUDIO_TRANSFER_CODEC_SLAVE | SD_AUDIO_DIR_MODE_RECEIVE | SD_AUDIO_CHANNEL_NUM_RX_MONO, SD_AUDIO_SR_48000, SD_AUDIO_SAMPLE_WIDTH_8BITS, SD_AUDIO_I2S_STANDARD_PHILLIPS},
    {SD_AUDIO_TRANSFER_CODEC_SLAVE | SD_AUDIO_DIR_MODE_RECEIVE | SD_AUDIO_CHANNEL_NUM_RX_MONO, SD_AUDIO_SR_48000, SD_AUDIO_SAMPLE_WIDTH_8BITS, SD_AUDIO_I2S_LEFT_JUSTIFIED},
    {SD_AUDIO_TRANSFER_CODEC_SLAVE | SD_AUDIO_DIR_MODE_RECEIVE | SD_AUDIO_CHANNEL_NUM_RX_MONO, SD_AUDIO_SR_48000, SD_AUDIO_SAMPLE_WIDTH_8BITS, SD_AUDIO_I2S_RIGHT_JUSTIFIED},
    {SD_AUDIO_TRANSFER_CODEC_SLAVE | SD_AUDIO_DIR_MODE_RECEIVE | SD_AUDIO_CHANNEL_NUM_RX_MONO, SD_AUDIO_SR_48000, SD_AUDIO_SAMPLE_WIDTH_8BITS, SD_AUDIO_I2S_DSP_A},
    {SD_AUDIO_TRANSFER_CODEC_SLAVE | SD_AUDIO_DIR_MODE_RECEIVE | SD_AUDIO_CHANNEL_NUM_RX_MONO, SD_AUDIO_SR_48000, SD_AUDIO_SAMPLE_WIDTH_8BITS, SD_AUDIO_I2S_DSP_B},

    {SD_AUDIO_TRANSFER_CODEC_SLAVE | SD_AUDIO_DIR_MODE_RECEIVE | SD_AUDIO_CHANNEL_NUM_RX_MONO, SD_AUDIO_SR_48000, SD_AUDIO_SAMPLE_WIDTH_16BITS, SD_AUDIO_I2S_STANDARD_PHILLIPS},
    {SD_AUDIO_TRANSFER_CODEC_SLAVE | SD_AUDIO_DIR_MODE_RECEIVE | SD_AUDIO_CHANNEL_NUM_RX_MONO, SD_AUDIO_SR_48000, SD_AUDIO_SAMPLE_WIDTH_16BITS, SD_AUDIO_I2S_LEFT_JUSTIFIED},
    {SD_AUDIO_TRANSFER_CODEC_SLAVE | SD_AUDIO_DIR_MODE_RECEIVE | SD_AUDIO_CHANNEL_NUM_RX_MONO, SD_AUDIO_SR_48000, SD_AUDIO_SAMPLE_WIDTH_16BITS, SD_AUDIO_I2S_RIGHT_JUSTIFIED},
    {SD_AUDIO_TRANSFER_CODEC_SLAVE | SD_AUDIO_DIR_MODE_RECEIVE | SD_AUDIO_CHANNEL_NUM_RX_MONO, SD_AUDIO_SR_48000, SD_AUDIO_SAMPLE_WIDTH_16BITS, SD_AUDIO_I2S_DSP_A},
    {SD_AUDIO_TRANSFER_CODEC_SLAVE | SD_AUDIO_DIR_MODE_RECEIVE | SD_AUDIO_CHANNEL_NUM_RX_MONO, SD_AUDIO_SR_48000, SD_AUDIO_SAMPLE_WIDTH_16BITS, SD_AUDIO_I2S_DSP_B},

    {SD_AUDIO_TRANSFER_CODEC_SLAVE | SD_AUDIO_DIR_MODE_RECEIVE | SD_AUDIO_CHANNEL_NUM_RX_MONO, SD_AUDIO_SR_48000, SD_AUDIO_SAMPLE_WIDTH_24BITS, SD_AUDIO_I2S_STANDARD_PHILLIPS},
    {SD_AUDIO_TRANSFER_CODEC_SLAVE | SD_AUDIO_DIR_MODE_RECEIVE | SD_AUDIO_CHANNEL_NUM_RX_MONO, SD_AUDIO_SR_48000, SD_AUDIO_SAMPLE_WIDTH_24BITS, SD_AUDIO_I2S_LEFT_JUSTIFIED},
    {SD_AUDIO_TRANSFER_CODEC_SLAVE | SD_AUDIO_DIR_MODE_RECEIVE | SD_AUDIO_CHANNEL_NUM_RX_MONO, SD_AUDIO_SR_48000, SD_AUDIO_SAMPLE_WIDTH_24BITS, SD_AUDIO_I2S_RIGHT_JUSTIFIED},
    {SD_AUDIO_TRANSFER_CODEC_SLAVE | SD_AUDIO_DIR_MODE_RECEIVE | SD_AUDIO_CHANNEL_NUM_RX_MONO, SD_AUDIO_SR_48000, SD_AUDIO_SAMPLE_WIDTH_24BITS, SD_AUDIO_I2S_DSP_A},
    {SD_AUDIO_TRANSFER_CODEC_SLAVE | SD_AUDIO_DIR_MODE_RECEIVE | SD_AUDIO_CHANNEL_NUM_RX_MONO, SD_AUDIO_SR_48000, SD_AUDIO_SAMPLE_WIDTH_24BITS, SD_AUDIO_I2S_DSP_B},

    {SD_AUDIO_TRANSFER_CODEC_SLAVE | SD_AUDIO_DIR_MODE_RECEIVE | SD_AUDIO_CHANNEL_NUM_RX_MONO, SD_AUDIO_SR_48000, SD_AUDIO_SAMPLE_WIDTH_32BITS, SD_AUDIO_I2S_STANDARD_PHILLIPS},
    {SD_AUDIO_TRANSFER_CODEC_SLAVE | SD_AUDIO_DIR_MODE_RECEIVE | SD_AUDIO_CHANNEL_NUM_RX_MONO, SD_AUDIO_SR_48000, SD_AUDIO_SAMPLE_WIDTH_32BITS, SD_AUDIO_I2S_LEFT_JUSTIFIED},
    {SD_AUDIO_TRANSFER_CODEC_SLAVE | SD_AUDIO_DIR_MODE_RECEIVE | SD_AUDIO_CHANNEL_NUM_RX_MONO, SD_AUDIO_SR_48000, SD_AUDIO_SAMPLE_WIDTH_32BITS, SD_AUDIO_I2S_RIGHT_JUSTIFIED},
    {SD_AUDIO_TRANSFER_CODEC_SLAVE | SD_AUDIO_DIR_MODE_RECEIVE | SD_AUDIO_CHANNEL_NUM_RX_MONO, SD_AUDIO_SR_48000, SD_AUDIO_SAMPLE_WIDTH_32BITS, SD_AUDIO_I2S_DSP_A},
    {SD_AUDIO_TRANSFER_CODEC_SLAVE | SD_AUDIO_DIR_MODE_RECEIVE | SD_AUDIO_CHANNEL_NUM_RX_MONO, SD_AUDIO_SR_48000, SD_AUDIO_SAMPLE_WIDTH_32BITS, SD_AUDIO_I2S_DSP_B},


//////////////////////////////////////////////////////////////////////////////////////////////////////////////////////////////////////////////////////////////////////////////
//case 201~220
    {SD_AUDIO_TRANSFER_CODEC_SLAVE | SD_AUDIO_DIR_MODE_RECEIVE | SD_AUDIO_CHANNEL_NUM_RX_MONO, SD_AUDIO_SR_96000, SD_AUDIO_SAMPLE_WIDTH_8BITS, SD_AUDIO_I2S_STANDARD_PHILLIPS},
    {SD_AUDIO_TRANSFER_CODEC_SLAVE | SD_AUDIO_DIR_MODE_RECEIVE | SD_AUDIO_CHANNEL_NUM_RX_MONO, SD_AUDIO_SR_96000, SD_AUDIO_SAMPLE_WIDTH_8BITS, SD_AUDIO_I2S_LEFT_JUSTIFIED},
    {SD_AUDIO_TRANSFER_CODEC_SLAVE | SD_AUDIO_DIR_MODE_RECEIVE | SD_AUDIO_CHANNEL_NUM_RX_MONO, SD_AUDIO_SR_96000, SD_AUDIO_SAMPLE_WIDTH_8BITS, SD_AUDIO_I2S_RIGHT_JUSTIFIED},
    {SD_AUDIO_TRANSFER_CODEC_SLAVE | SD_AUDIO_DIR_MODE_RECEIVE | SD_AUDIO_CHANNEL_NUM_RX_MONO, SD_AUDIO_SR_96000, SD_AUDIO_SAMPLE_WIDTH_8BITS, SD_AUDIO_I2S_DSP_A},
    {SD_AUDIO_TRANSFER_CODEC_SLAVE | SD_AUDIO_DIR_MODE_RECEIVE | SD_AUDIO_CHANNEL_NUM_RX_MONO, SD_AUDIO_SR_96000, SD_AUDIO_SAMPLE_WIDTH_8BITS, SD_AUDIO_I2S_DSP_B},

    {SD_AUDIO_TRANSFER_CODEC_SLAVE | SD_AUDIO_DIR_MODE_RECEIVE | SD_AUDIO_CHANNEL_NUM_RX_MONO, SD_AUDIO_SR_96000, SD_AUDIO_SAMPLE_WIDTH_16BITS, SD_AUDIO_I2S_STANDARD_PHILLIPS},
    {SD_AUDIO_TRANSFER_CODEC_SLAVE | SD_AUDIO_DIR_MODE_RECEIVE | SD_AUDIO_CHANNEL_NUM_RX_MONO, SD_AUDIO_SR_96000, SD_AUDIO_SAMPLE_WIDTH_16BITS, SD_AUDIO_I2S_LEFT_JUSTIFIED},
    {SD_AUDIO_TRANSFER_CODEC_SLAVE | SD_AUDIO_DIR_MODE_RECEIVE | SD_AUDIO_CHANNEL_NUM_RX_MONO, SD_AUDIO_SR_96000, SD_AUDIO_SAMPLE_WIDTH_16BITS, SD_AUDIO_I2S_RIGHT_JUSTIFIED},
    {SD_AUDIO_TRANSFER_CODEC_SLAVE | SD_AUDIO_DIR_MODE_RECEIVE | SD_AUDIO_CHANNEL_NUM_RX_MONO, SD_AUDIO_SR_96000, SD_AUDIO_SAMPLE_WIDTH_16BITS, SD_AUDIO_I2S_DSP_A},
    {SD_AUDIO_TRANSFER_CODEC_SLAVE | SD_AUDIO_DIR_MODE_RECEIVE | SD_AUDIO_CHANNEL_NUM_RX_MONO, SD_AUDIO_SR_96000, SD_AUDIO_SAMPLE_WIDTH_16BITS, SD_AUDIO_I2S_DSP_B},

    {SD_AUDIO_TRANSFER_CODEC_SLAVE | SD_AUDIO_DIR_MODE_RECEIVE | SD_AUDIO_CHANNEL_NUM_RX_MONO, SD_AUDIO_SR_96000, SD_AUDIO_SAMPLE_WIDTH_24BITS, SD_AUDIO_I2S_STANDARD_PHILLIPS},
    {SD_AUDIO_TRANSFER_CODEC_SLAVE | SD_AUDIO_DIR_MODE_RECEIVE | SD_AUDIO_CHANNEL_NUM_RX_MONO, SD_AUDIO_SR_96000, SD_AUDIO_SAMPLE_WIDTH_24BITS, SD_AUDIO_I2S_LEFT_JUSTIFIED},
    {SD_AUDIO_TRANSFER_CODEC_SLAVE | SD_AUDIO_DIR_MODE_RECEIVE | SD_AUDIO_CHANNEL_NUM_RX_MONO, SD_AUDIO_SR_96000, SD_AUDIO_SAMPLE_WIDTH_24BITS, SD_AUDIO_I2S_RIGHT_JUSTIFIED},
    {SD_AUDIO_TRANSFER_CODEC_SLAVE | SD_AUDIO_DIR_MODE_RECEIVE | SD_AUDIO_CHANNEL_NUM_RX_MONO, SD_AUDIO_SR_96000, SD_AUDIO_SAMPLE_WIDTH_24BITS, SD_AUDIO_I2S_DSP_A},
    {SD_AUDIO_TRANSFER_CODEC_SLAVE | SD_AUDIO_DIR_MODE_RECEIVE | SD_AUDIO_CHANNEL_NUM_RX_MONO, SD_AUDIO_SR_96000, SD_AUDIO_SAMPLE_WIDTH_24BITS, SD_AUDIO_I2S_DSP_B},

    {SD_AUDIO_TRANSFER_CODEC_SLAVE | SD_AUDIO_DIR_MODE_RECEIVE | SD_AUDIO_CHANNEL_NUM_RX_MONO, SD_AUDIO_SR_96000, SD_AUDIO_SAMPLE_WIDTH_32BITS, SD_AUDIO_I2S_STANDARD_PHILLIPS},
    {SD_AUDIO_TRANSFER_CODEC_SLAVE | SD_AUDIO_DIR_MODE_RECEIVE | SD_AUDIO_CHANNEL_NUM_RX_MONO, SD_AUDIO_SR_96000, SD_AUDIO_SAMPLE_WIDTH_32BITS, SD_AUDIO_I2S_LEFT_JUSTIFIED},
    {SD_AUDIO_TRANSFER_CODEC_SLAVE | SD_AUDIO_DIR_MODE_RECEIVE | SD_AUDIO_CHANNEL_NUM_RX_MONO, SD_AUDIO_SR_96000, SD_AUDIO_SAMPLE_WIDTH_32BITS, SD_AUDIO_I2S_RIGHT_JUSTIFIED},
    {SD_AUDIO_TRANSFER_CODEC_SLAVE | SD_AUDIO_DIR_MODE_RECEIVE | SD_AUDIO_CHANNEL_NUM_RX_MONO, SD_AUDIO_SR_96000, SD_AUDIO_SAMPLE_WIDTH_32BITS, SD_AUDIO_I2S_DSP_A},
    {SD_AUDIO_TRANSFER_CODEC_SLAVE | SD_AUDIO_DIR_MODE_RECEIVE | SD_AUDIO_CHANNEL_NUM_RX_MONO, SD_AUDIO_SR_96000, SD_AUDIO_SAMPLE_WIDTH_32BITS, SD_AUDIO_I2S_DSP_B},


//////////////////////////////////////////////////////////////////////////////////////////////////////////////////////////////////////////////////////////////////////////////
//case 221~240
    {SD_AUDIO_TRANSFER_CODEC_SLAVE | SD_AUDIO_DIR_MODE_RECEIVE | SD_AUDIO_CHANNEL_NUM_RX_MONO, SD_AUDIO_SR_192000, SD_AUDIO_SAMPLE_WIDTH_8BITS, SD_AUDIO_I2S_STANDARD_PHILLIPS},
    {SD_AUDIO_TRANSFER_CODEC_SLAVE | SD_AUDIO_DIR_MODE_RECEIVE | SD_AUDIO_CHANNEL_NUM_RX_MONO, SD_AUDIO_SR_192000, SD_AUDIO_SAMPLE_WIDTH_8BITS, SD_AUDIO_I2S_LEFT_JUSTIFIED},
    {SD_AUDIO_TRANSFER_CODEC_SLAVE | SD_AUDIO_DIR_MODE_RECEIVE | SD_AUDIO_CHANNEL_NUM_RX_MONO, SD_AUDIO_SR_192000, SD_AUDIO_SAMPLE_WIDTH_8BITS, SD_AUDIO_I2S_RIGHT_JUSTIFIED},
    {SD_AUDIO_TRANSFER_CODEC_SLAVE | SD_AUDIO_DIR_MODE_RECEIVE | SD_AUDIO_CHANNEL_NUM_RX_MONO, SD_AUDIO_SR_192000, SD_AUDIO_SAMPLE_WIDTH_8BITS, SD_AUDIO_I2S_DSP_A},
    {SD_AUDIO_TRANSFER_CODEC_SLAVE | SD_AUDIO_DIR_MODE_RECEIVE | SD_AUDIO_CHANNEL_NUM_RX_MONO, SD_AUDIO_SR_192000, SD_AUDIO_SAMPLE_WIDTH_8BITS, SD_AUDIO_I2S_DSP_B},

    {SD_AUDIO_TRANSFER_CODEC_SLAVE | SD_AUDIO_DIR_MODE_RECEIVE | SD_AUDIO_CHANNEL_NUM_RX_MONO, SD_AUDIO_SR_192000, SD_AUDIO_SAMPLE_WIDTH_16BITS, SD_AUDIO_I2S_STANDARD_PHILLIPS},
    {SD_AUDIO_TRANSFER_CODEC_SLAVE | SD_AUDIO_DIR_MODE_RECEIVE | SD_AUDIO_CHANNEL_NUM_RX_MONO, SD_AUDIO_SR_192000, SD_AUDIO_SAMPLE_WIDTH_16BITS, SD_AUDIO_I2S_LEFT_JUSTIFIED},
    {SD_AUDIO_TRANSFER_CODEC_SLAVE | SD_AUDIO_DIR_MODE_RECEIVE | SD_AUDIO_CHANNEL_NUM_RX_MONO, SD_AUDIO_SR_192000, SD_AUDIO_SAMPLE_WIDTH_16BITS, SD_AUDIO_I2S_RIGHT_JUSTIFIED},
    {SD_AUDIO_TRANSFER_CODEC_SLAVE | SD_AUDIO_DIR_MODE_RECEIVE | SD_AUDIO_CHANNEL_NUM_RX_MONO, SD_AUDIO_SR_192000, SD_AUDIO_SAMPLE_WIDTH_16BITS, SD_AUDIO_I2S_DSP_A},
    {SD_AUDIO_TRANSFER_CODEC_SLAVE | SD_AUDIO_DIR_MODE_RECEIVE | SD_AUDIO_CHANNEL_NUM_RX_MONO, SD_AUDIO_SR_192000, SD_AUDIO_SAMPLE_WIDTH_16BITS, SD_AUDIO_I2S_DSP_B},

    {SD_AUDIO_TRANSFER_CODEC_SLAVE | SD_AUDIO_DIR_MODE_RECEIVE | SD_AUDIO_CHANNEL_NUM_RX_MONO, SD_AUDIO_SR_192000, SD_AUDIO_SAMPLE_WIDTH_24BITS, SD_AUDIO_I2S_STANDARD_PHILLIPS},
    {SD_AUDIO_TRANSFER_CODEC_SLAVE | SD_AUDIO_DIR_MODE_RECEIVE | SD_AUDIO_CHANNEL_NUM_RX_MONO, SD_AUDIO_SR_192000, SD_AUDIO_SAMPLE_WIDTH_24BITS, SD_AUDIO_I2S_LEFT_JUSTIFIED},
    {SD_AUDIO_TRANSFER_CODEC_SLAVE | SD_AUDIO_DIR_MODE_RECEIVE | SD_AUDIO_CHANNEL_NUM_RX_MONO, SD_AUDIO_SR_192000, SD_AUDIO_SAMPLE_WIDTH_24BITS, SD_AUDIO_I2S_RIGHT_JUSTIFIED},
    {SD_AUDIO_TRANSFER_CODEC_SLAVE | SD_AUDIO_DIR_MODE_RECEIVE | SD_AUDIO_CHANNEL_NUM_RX_MONO, SD_AUDIO_SR_192000, SD_AUDIO_SAMPLE_WIDTH_24BITS, SD_AUDIO_I2S_DSP_A},
    {SD_AUDIO_TRANSFER_CODEC_SLAVE | SD_AUDIO_DIR_MODE_RECEIVE | SD_AUDIO_CHANNEL_NUM_RX_MONO, SD_AUDIO_SR_192000, SD_AUDIO_SAMPLE_WIDTH_24BITS, SD_AUDIO_I2S_DSP_B},

    {SD_AUDIO_TRANSFER_CODEC_SLAVE | SD_AUDIO_DIR_MODE_RECEIVE | SD_AUDIO_CHANNEL_NUM_RX_MONO, SD_AUDIO_SR_192000, SD_AUDIO_SAMPLE_WIDTH_32BITS, SD_AUDIO_I2S_STANDARD_PHILLIPS},
    {SD_AUDIO_TRANSFER_CODEC_SLAVE | SD_AUDIO_DIR_MODE_RECEIVE | SD_AUDIO_CHANNEL_NUM_RX_MONO, SD_AUDIO_SR_192000, SD_AUDIO_SAMPLE_WIDTH_32BITS, SD_AUDIO_I2S_LEFT_JUSTIFIED},
    {SD_AUDIO_TRANSFER_CODEC_SLAVE | SD_AUDIO_DIR_MODE_RECEIVE | SD_AUDIO_CHANNEL_NUM_RX_MONO, SD_AUDIO_SR_192000, SD_AUDIO_SAMPLE_WIDTH_32BITS, SD_AUDIO_I2S_RIGHT_JUSTIFIED},
    {SD_AUDIO_TRANSFER_CODEC_SLAVE | SD_AUDIO_DIR_MODE_RECEIVE | SD_AUDIO_CHANNEL_NUM_RX_MONO, SD_AUDIO_SR_192000, SD_AUDIO_SAMPLE_WIDTH_32BITS, SD_AUDIO_I2S_DSP_A},
    {SD_AUDIO_TRANSFER_CODEC_SLAVE | SD_AUDIO_DIR_MODE_RECEIVE | SD_AUDIO_CHANNEL_NUM_RX_MONO, SD_AUDIO_SR_192000, SD_AUDIO_SAMPLE_WIDTH_32BITS, SD_AUDIO_I2S_DSP_B},



/////////////////////////////////////////////////////////////////////////////////////////mode 4/////////////////////////////////////////////////////////////////////////////

//case 241~260
    {SD_AUDIO_TRANSFER_CODEC_SLAVE | SD_AUDIO_DIR_MODE_RECEIVE | SD_AUDIO_CHANNEL_NUM_RX_STEREO, SD_AUDIO_SR_44100, SD_AUDIO_SAMPLE_WIDTH_8BITS, SD_AUDIO_I2S_STANDARD_PHILLIPS},
    {SD_AUDIO_TRANSFER_CODEC_SLAVE | SD_AUDIO_DIR_MODE_RECEIVE | SD_AUDIO_CHANNEL_NUM_RX_STEREO, SD_AUDIO_SR_44100, SD_AUDIO_SAMPLE_WIDTH_8BITS, SD_AUDIO_I2S_LEFT_JUSTIFIED},
    {SD_AUDIO_TRANSFER_CODEC_SLAVE | SD_AUDIO_DIR_MODE_RECEIVE | SD_AUDIO_CHANNEL_NUM_RX_STEREO, SD_AUDIO_SR_44100, SD_AUDIO_SAMPLE_WIDTH_8BITS, SD_AUDIO_I2S_RIGHT_JUSTIFIED},
    {SD_AUDIO_TRANSFER_CODEC_SLAVE | SD_AUDIO_DIR_MODE_RECEIVE | SD_AUDIO_CHANNEL_NUM_RX_STEREO, SD_AUDIO_SR_44100, SD_AUDIO_SAMPLE_WIDTH_8BITS, SD_AUDIO_I2S_DSP_A},
    {SD_AUDIO_TRANSFER_CODEC_SLAVE | SD_AUDIO_DIR_MODE_RECEIVE | SD_AUDIO_CHANNEL_NUM_RX_STEREO, SD_AUDIO_SR_44100, SD_AUDIO_SAMPLE_WIDTH_8BITS, SD_AUDIO_I2S_DSP_B},

    {SD_AUDIO_TRANSFER_CODEC_SLAVE | SD_AUDIO_DIR_MODE_RECEIVE | SD_AUDIO_CHANNEL_NUM_RX_STEREO, SD_AUDIO_SR_44100, SD_AUDIO_SAMPLE_WIDTH_16BITS, SD_AUDIO_I2S_STANDARD_PHILLIPS},
    {SD_AUDIO_TRANSFER_CODEC_SLAVE | SD_AUDIO_DIR_MODE_RECEIVE | SD_AUDIO_CHANNEL_NUM_RX_STEREO, SD_AUDIO_SR_44100, SD_AUDIO_SAMPLE_WIDTH_16BITS, SD_AUDIO_I2S_LEFT_JUSTIFIED},
    {SD_AUDIO_TRANSFER_CODEC_SLAVE | SD_AUDIO_DIR_MODE_RECEIVE | SD_AUDIO_CHANNEL_NUM_RX_STEREO, SD_AUDIO_SR_44100, SD_AUDIO_SAMPLE_WIDTH_16BITS, SD_AUDIO_I2S_RIGHT_JUSTIFIED},
    {SD_AUDIO_TRANSFER_CODEC_SLAVE | SD_AUDIO_DIR_MODE_RECEIVE | SD_AUDIO_CHANNEL_NUM_RX_STEREO, SD_AUDIO_SR_44100, SD_AUDIO_SAMPLE_WIDTH_16BITS, SD_AUDIO_I2S_DSP_A},
    {SD_AUDIO_TRANSFER_CODEC_SLAVE | SD_AUDIO_DIR_MODE_RECEIVE | SD_AUDIO_CHANNEL_NUM_RX_STEREO, SD_AUDIO_SR_44100, SD_AUDIO_SAMPLE_WIDTH_16BITS, SD_AUDIO_I2S_DSP_B},

    {SD_AUDIO_TRANSFER_CODEC_SLAVE | SD_AUDIO_DIR_MODE_RECEIVE | SD_AUDIO_CHANNEL_NUM_RX_STEREO, SD_AUDIO_SR_44100, SD_AUDIO_SAMPLE_WIDTH_24BITS, SD_AUDIO_I2S_STANDARD_PHILLIPS},
    {SD_AUDIO_TRANSFER_CODEC_SLAVE | SD_AUDIO_DIR_MODE_RECEIVE | SD_AUDIO_CHANNEL_NUM_RX_STEREO, SD_AUDIO_SR_44100, SD_AUDIO_SAMPLE_WIDTH_24BITS, SD_AUDIO_I2S_LEFT_JUSTIFIED},
    {SD_AUDIO_TRANSFER_CODEC_SLAVE | SD_AUDIO_DIR_MODE_RECEIVE | SD_AUDIO_CHANNEL_NUM_RX_STEREO, SD_AUDIO_SR_44100, SD_AUDIO_SAMPLE_WIDTH_24BITS, SD_AUDIO_I2S_RIGHT_JUSTIFIED},
    {SD_AUDIO_TRANSFER_CODEC_SLAVE | SD_AUDIO_DIR_MODE_RECEIVE | SD_AUDIO_CHANNEL_NUM_RX_STEREO, SD_AUDIO_SR_44100, SD_AUDIO_SAMPLE_WIDTH_24BITS, SD_AUDIO_I2S_DSP_A},
    {SD_AUDIO_TRANSFER_CODEC_SLAVE | SD_AUDIO_DIR_MODE_RECEIVE | SD_AUDIO_CHANNEL_NUM_RX_STEREO, SD_AUDIO_SR_44100, SD_AUDIO_SAMPLE_WIDTH_24BITS, SD_AUDIO_I2S_DSP_B},

    {SD_AUDIO_TRANSFER_CODEC_SLAVE | SD_AUDIO_DIR_MODE_RECEIVE | SD_AUDIO_CHANNEL_NUM_RX_STEREO, SD_AUDIO_SR_44100, SD_AUDIO_SAMPLE_WIDTH_32BITS, SD_AUDIO_I2S_STANDARD_PHILLIPS},
    {SD_AUDIO_TRANSFER_CODEC_SLAVE | SD_AUDIO_DIR_MODE_RECEIVE | SD_AUDIO_CHANNEL_NUM_RX_STEREO, SD_AUDIO_SR_44100, SD_AUDIO_SAMPLE_WIDTH_32BITS, SD_AUDIO_I2S_LEFT_JUSTIFIED},
    {SD_AUDIO_TRANSFER_CODEC_SLAVE | SD_AUDIO_DIR_MODE_RECEIVE | SD_AUDIO_CHANNEL_NUM_RX_STEREO, SD_AUDIO_SR_44100, SD_AUDIO_SAMPLE_WIDTH_32BITS, SD_AUDIO_I2S_RIGHT_JUSTIFIED},
    {SD_AUDIO_TRANSFER_CODEC_SLAVE | SD_AUDIO_DIR_MODE_RECEIVE | SD_AUDIO_CHANNEL_NUM_RX_STEREO, SD_AUDIO_SR_44100, SD_AUDIO_SAMPLE_WIDTH_32BITS, SD_AUDIO_I2S_DSP_A},
    {SD_AUDIO_TRANSFER_CODEC_SLAVE | SD_AUDIO_DIR_MODE_RECEIVE | SD_AUDIO_CHANNEL_NUM_RX_STEREO, SD_AUDIO_SR_44100, SD_AUDIO_SAMPLE_WIDTH_32BITS, SD_AUDIO_I2S_DSP_B},


////////////////////////////////////////////////////////////////////////////////////////////////////////////////////////////////////////////////////////////////////////////////
//case 261~280
    {SD_AUDIO_TRANSFER_CODEC_SLAVE | SD_AUDIO_DIR_MODE_RECEIVE | SD_AUDIO_CHANNEL_NUM_RX_STEREO, SD_AUDIO_SR_48000, SD_AUDIO_SAMPLE_WIDTH_8BITS, SD_AUDIO_I2S_STANDARD_PHILLIPS},
    {SD_AUDIO_TRANSFER_CODEC_SLAVE | SD_AUDIO_DIR_MODE_RECEIVE | SD_AUDIO_CHANNEL_NUM_RX_STEREO, SD_AUDIO_SR_48000, SD_AUDIO_SAMPLE_WIDTH_8BITS, SD_AUDIO_I2S_LEFT_JUSTIFIED},
    {SD_AUDIO_TRANSFER_CODEC_SLAVE | SD_AUDIO_DIR_MODE_RECEIVE | SD_AUDIO_CHANNEL_NUM_RX_STEREO, SD_AUDIO_SR_48000, SD_AUDIO_SAMPLE_WIDTH_8BITS, SD_AUDIO_I2S_RIGHT_JUSTIFIED},
    {SD_AUDIO_TRANSFER_CODEC_SLAVE | SD_AUDIO_DIR_MODE_RECEIVE | SD_AUDIO_CHANNEL_NUM_RX_STEREO, SD_AUDIO_SR_48000, SD_AUDIO_SAMPLE_WIDTH_8BITS, SD_AUDIO_I2S_DSP_A},
    {SD_AUDIO_TRANSFER_CODEC_SLAVE | SD_AUDIO_DIR_MODE_RECEIVE | SD_AUDIO_CHANNEL_NUM_RX_STEREO, SD_AUDIO_SR_48000, SD_AUDIO_SAMPLE_WIDTH_8BITS, SD_AUDIO_I2S_DSP_B},

    {SD_AUDIO_TRANSFER_CODEC_SLAVE | SD_AUDIO_DIR_MODE_RECEIVE | SD_AUDIO_CHANNEL_NUM_RX_STEREO, SD_AUDIO_SR_48000, SD_AUDIO_SAMPLE_WIDTH_16BITS, SD_AUDIO_I2S_STANDARD_PHILLIPS},
    {SD_AUDIO_TRANSFER_CODEC_SLAVE | SD_AUDIO_DIR_MODE_RECEIVE | SD_AUDIO_CHANNEL_NUM_RX_STEREO, SD_AUDIO_SR_48000, SD_AUDIO_SAMPLE_WIDTH_16BITS, SD_AUDIO_I2S_LEFT_JUSTIFIED},
    {SD_AUDIO_TRANSFER_CODEC_SLAVE | SD_AUDIO_DIR_MODE_RECEIVE | SD_AUDIO_CHANNEL_NUM_RX_STEREO, SD_AUDIO_SR_48000, SD_AUDIO_SAMPLE_WIDTH_16BITS, SD_AUDIO_I2S_RIGHT_JUSTIFIED},
    {SD_AUDIO_TRANSFER_CODEC_SLAVE | SD_AUDIO_DIR_MODE_RECEIVE | SD_AUDIO_CHANNEL_NUM_RX_STEREO, SD_AUDIO_SR_48000, SD_AUDIO_SAMPLE_WIDTH_16BITS, SD_AUDIO_I2S_DSP_A},
    {SD_AUDIO_TRANSFER_CODEC_SLAVE | SD_AUDIO_DIR_MODE_RECEIVE | SD_AUDIO_CHANNEL_NUM_RX_STEREO, SD_AUDIO_SR_48000, SD_AUDIO_SAMPLE_WIDTH_16BITS, SD_AUDIO_I2S_DSP_B},

    {SD_AUDIO_TRANSFER_CODEC_SLAVE | SD_AUDIO_DIR_MODE_RECEIVE | SD_AUDIO_CHANNEL_NUM_RX_STEREO, SD_AUDIO_SR_48000, SD_AUDIO_SAMPLE_WIDTH_24BITS, SD_AUDIO_I2S_STANDARD_PHILLIPS},
    {SD_AUDIO_TRANSFER_CODEC_SLAVE | SD_AUDIO_DIR_MODE_RECEIVE | SD_AUDIO_CHANNEL_NUM_RX_STEREO, SD_AUDIO_SR_48000, SD_AUDIO_SAMPLE_WIDTH_24BITS, SD_AUDIO_I2S_LEFT_JUSTIFIED},
    {SD_AUDIO_TRANSFER_CODEC_SLAVE | SD_AUDIO_DIR_MODE_RECEIVE | SD_AUDIO_CHANNEL_NUM_RX_STEREO, SD_AUDIO_SR_48000, SD_AUDIO_SAMPLE_WIDTH_24BITS, SD_AUDIO_I2S_RIGHT_JUSTIFIED},
    {SD_AUDIO_TRANSFER_CODEC_SLAVE | SD_AUDIO_DIR_MODE_RECEIVE | SD_AUDIO_CHANNEL_NUM_RX_STEREO, SD_AUDIO_SR_48000, SD_AUDIO_SAMPLE_WIDTH_24BITS, SD_AUDIO_I2S_DSP_A},
    {SD_AUDIO_TRANSFER_CODEC_SLAVE | SD_AUDIO_DIR_MODE_RECEIVE | SD_AUDIO_CHANNEL_NUM_RX_STEREO, SD_AUDIO_SR_48000, SD_AUDIO_SAMPLE_WIDTH_24BITS, SD_AUDIO_I2S_DSP_B},

    {SD_AUDIO_TRANSFER_CODEC_SLAVE | SD_AUDIO_DIR_MODE_RECEIVE | SD_AUDIO_CHANNEL_NUM_RX_STEREO, SD_AUDIO_SR_48000, SD_AUDIO_SAMPLE_WIDTH_32BITS, SD_AUDIO_I2S_STANDARD_PHILLIPS},
    {SD_AUDIO_TRANSFER_CODEC_SLAVE | SD_AUDIO_DIR_MODE_RECEIVE | SD_AUDIO_CHANNEL_NUM_RX_STEREO, SD_AUDIO_SR_48000, SD_AUDIO_SAMPLE_WIDTH_32BITS, SD_AUDIO_I2S_LEFT_JUSTIFIED},
    {SD_AUDIO_TRANSFER_CODEC_SLAVE | SD_AUDIO_DIR_MODE_RECEIVE | SD_AUDIO_CHANNEL_NUM_RX_STEREO, SD_AUDIO_SR_48000, SD_AUDIO_SAMPLE_WIDTH_32BITS, SD_AUDIO_I2S_RIGHT_JUSTIFIED},
    {SD_AUDIO_TRANSFER_CODEC_SLAVE | SD_AUDIO_DIR_MODE_RECEIVE | SD_AUDIO_CHANNEL_NUM_RX_STEREO, SD_AUDIO_SR_48000, SD_AUDIO_SAMPLE_WIDTH_32BITS, SD_AUDIO_I2S_DSP_A},
    {SD_AUDIO_TRANSFER_CODEC_SLAVE | SD_AUDIO_DIR_MODE_RECEIVE | SD_AUDIO_CHANNEL_NUM_RX_STEREO, SD_AUDIO_SR_48000, SD_AUDIO_SAMPLE_WIDTH_32BITS, SD_AUDIO_I2S_DSP_B},


////////////////////////////////////////////////////////////////////////////////////////////////////////////////////////////////////////////////////////////////////////////////
//case 281~300
    {SD_AUDIO_TRANSFER_CODEC_SLAVE | SD_AUDIO_DIR_MODE_RECEIVE | SD_AUDIO_CHANNEL_NUM_RX_STEREO, SD_AUDIO_SR_96000, SD_AUDIO_SAMPLE_WIDTH_8BITS, SD_AUDIO_I2S_STANDARD_PHILLIPS},
    {SD_AUDIO_TRANSFER_CODEC_SLAVE | SD_AUDIO_DIR_MODE_RECEIVE | SD_AUDIO_CHANNEL_NUM_RX_STEREO, SD_AUDIO_SR_96000, SD_AUDIO_SAMPLE_WIDTH_8BITS, SD_AUDIO_I2S_LEFT_JUSTIFIED},
    {SD_AUDIO_TRANSFER_CODEC_SLAVE | SD_AUDIO_DIR_MODE_RECEIVE | SD_AUDIO_CHANNEL_NUM_RX_STEREO, SD_AUDIO_SR_96000, SD_AUDIO_SAMPLE_WIDTH_8BITS, SD_AUDIO_I2S_RIGHT_JUSTIFIED},
    {SD_AUDIO_TRANSFER_CODEC_SLAVE | SD_AUDIO_DIR_MODE_RECEIVE | SD_AUDIO_CHANNEL_NUM_RX_STEREO, SD_AUDIO_SR_96000, SD_AUDIO_SAMPLE_WIDTH_8BITS, SD_AUDIO_I2S_DSP_A},
    {SD_AUDIO_TRANSFER_CODEC_SLAVE | SD_AUDIO_DIR_MODE_RECEIVE | SD_AUDIO_CHANNEL_NUM_RX_STEREO, SD_AUDIO_SR_96000, SD_AUDIO_SAMPLE_WIDTH_8BITS, SD_AUDIO_I2S_DSP_B},

    {SD_AUDIO_TRANSFER_CODEC_SLAVE | SD_AUDIO_DIR_MODE_RECEIVE | SD_AUDIO_CHANNEL_NUM_RX_STEREO, SD_AUDIO_SR_96000, SD_AUDIO_SAMPLE_WIDTH_16BITS, SD_AUDIO_I2S_STANDARD_PHILLIPS},
    {SD_AUDIO_TRANSFER_CODEC_SLAVE | SD_AUDIO_DIR_MODE_RECEIVE | SD_AUDIO_CHANNEL_NUM_RX_STEREO, SD_AUDIO_SR_96000, SD_AUDIO_SAMPLE_WIDTH_16BITS, SD_AUDIO_I2S_LEFT_JUSTIFIED},
    {SD_AUDIO_TRANSFER_CODEC_SLAVE | SD_AUDIO_DIR_MODE_RECEIVE | SD_AUDIO_CHANNEL_NUM_RX_STEREO, SD_AUDIO_SR_96000, SD_AUDIO_SAMPLE_WIDTH_16BITS, SD_AUDIO_I2S_RIGHT_JUSTIFIED},
    {SD_AUDIO_TRANSFER_CODEC_SLAVE | SD_AUDIO_DIR_MODE_RECEIVE | SD_AUDIO_CHANNEL_NUM_RX_STEREO, SD_AUDIO_SR_96000, SD_AUDIO_SAMPLE_WIDTH_16BITS, SD_AUDIO_I2S_DSP_A},
    {SD_AUDIO_TRANSFER_CODEC_SLAVE | SD_AUDIO_DIR_MODE_RECEIVE | SD_AUDIO_CHANNEL_NUM_RX_STEREO, SD_AUDIO_SR_96000, SD_AUDIO_SAMPLE_WIDTH_16BITS, SD_AUDIO_I2S_DSP_B},

    {SD_AUDIO_TRANSFER_CODEC_SLAVE | SD_AUDIO_DIR_MODE_RECEIVE | SD_AUDIO_CHANNEL_NUM_RX_STEREO, SD_AUDIO_SR_96000, SD_AUDIO_SAMPLE_WIDTH_24BITS, SD_AUDIO_I2S_STANDARD_PHILLIPS},
    {SD_AUDIO_TRANSFER_CODEC_SLAVE | SD_AUDIO_DIR_MODE_RECEIVE | SD_AUDIO_CHANNEL_NUM_RX_STEREO, SD_AUDIO_SR_96000, SD_AUDIO_SAMPLE_WIDTH_24BITS, SD_AUDIO_I2S_LEFT_JUSTIFIED},
    {SD_AUDIO_TRANSFER_CODEC_SLAVE | SD_AUDIO_DIR_MODE_RECEIVE | SD_AUDIO_CHANNEL_NUM_RX_STEREO, SD_AUDIO_SR_96000, SD_AUDIO_SAMPLE_WIDTH_24BITS, SD_AUDIO_I2S_RIGHT_JUSTIFIED},
    {SD_AUDIO_TRANSFER_CODEC_SLAVE | SD_AUDIO_DIR_MODE_RECEIVE | SD_AUDIO_CHANNEL_NUM_RX_STEREO, SD_AUDIO_SR_96000, SD_AUDIO_SAMPLE_WIDTH_24BITS, SD_AUDIO_I2S_DSP_A},
    {SD_AUDIO_TRANSFER_CODEC_SLAVE | SD_AUDIO_DIR_MODE_RECEIVE | SD_AUDIO_CHANNEL_NUM_RX_STEREO, SD_AUDIO_SR_96000, SD_AUDIO_SAMPLE_WIDTH_24BITS, SD_AUDIO_I2S_DSP_B},

    {SD_AUDIO_TRANSFER_CODEC_SLAVE | SD_AUDIO_DIR_MODE_RECEIVE | SD_AUDIO_CHANNEL_NUM_RX_STEREO, SD_AUDIO_SR_96000, SD_AUDIO_SAMPLE_WIDTH_32BITS, SD_AUDIO_I2S_STANDARD_PHILLIPS},
    {SD_AUDIO_TRANSFER_CODEC_SLAVE | SD_AUDIO_DIR_MODE_RECEIVE | SD_AUDIO_CHANNEL_NUM_RX_STEREO, SD_AUDIO_SR_96000, SD_AUDIO_SAMPLE_WIDTH_32BITS, SD_AUDIO_I2S_LEFT_JUSTIFIED},
    {SD_AUDIO_TRANSFER_CODEC_SLAVE | SD_AUDIO_DIR_MODE_RECEIVE | SD_AUDIO_CHANNEL_NUM_RX_STEREO, SD_AUDIO_SR_96000, SD_AUDIO_SAMPLE_WIDTH_32BITS, SD_AUDIO_I2S_RIGHT_JUSTIFIED},
    {SD_AUDIO_TRANSFER_CODEC_SLAVE | SD_AUDIO_DIR_MODE_RECEIVE | SD_AUDIO_CHANNEL_NUM_RX_STEREO, SD_AUDIO_SR_96000, SD_AUDIO_SAMPLE_WIDTH_32BITS, SD_AUDIO_I2S_DSP_A},
    {SD_AUDIO_TRANSFER_CODEC_SLAVE | SD_AUDIO_DIR_MODE_RECEIVE | SD_AUDIO_CHANNEL_NUM_RX_STEREO, SD_AUDIO_SR_96000, SD_AUDIO_SAMPLE_WIDTH_32BITS, SD_AUDIO_I2S_DSP_B},


////////////////////////////////////////////////////////////////////////////////////////////////////////////////////////////////////////////////////////////////////////////////
//case 301~320
    {SD_AUDIO_TRANSFER_CODEC_SLAVE | SD_AUDIO_DIR_MODE_RECEIVE | SD_AUDIO_CHANNEL_NUM_RX_STEREO, SD_AUDIO_SR_192000, SD_AUDIO_SAMPLE_WIDTH_8BITS, SD_AUDIO_I2S_STANDARD_PHILLIPS},
    {SD_AUDIO_TRANSFER_CODEC_SLAVE | SD_AUDIO_DIR_MODE_RECEIVE | SD_AUDIO_CHANNEL_NUM_RX_STEREO, SD_AUDIO_SR_192000, SD_AUDIO_SAMPLE_WIDTH_8BITS, SD_AUDIO_I2S_LEFT_JUSTIFIED},
    {SD_AUDIO_TRANSFER_CODEC_SLAVE | SD_AUDIO_DIR_MODE_RECEIVE | SD_AUDIO_CHANNEL_NUM_RX_STEREO, SD_AUDIO_SR_192000, SD_AUDIO_SAMPLE_WIDTH_8BITS, SD_AUDIO_I2S_RIGHT_JUSTIFIED},
    {SD_AUDIO_TRANSFER_CODEC_SLAVE | SD_AUDIO_DIR_MODE_RECEIVE | SD_AUDIO_CHANNEL_NUM_RX_STEREO, SD_AUDIO_SR_192000, SD_AUDIO_SAMPLE_WIDTH_8BITS, SD_AUDIO_I2S_DSP_A},
    {SD_AUDIO_TRANSFER_CODEC_SLAVE | SD_AUDIO_DIR_MODE_RECEIVE | SD_AUDIO_CHANNEL_NUM_RX_STEREO, SD_AUDIO_SR_192000, SD_AUDIO_SAMPLE_WIDTH_8BITS, SD_AUDIO_I2S_DSP_B},

    {SD_AUDIO_TRANSFER_CODEC_SLAVE | SD_AUDIO_DIR_MODE_RECEIVE | SD_AUDIO_CHANNEL_NUM_RX_STEREO, SD_AUDIO_SR_192000, SD_AUDIO_SAMPLE_WIDTH_16BITS, SD_AUDIO_I2S_STANDARD_PHILLIPS},
    {SD_AUDIO_TRANSFER_CODEC_SLAVE | SD_AUDIO_DIR_MODE_RECEIVE | SD_AUDIO_CHANNEL_NUM_RX_STEREO, SD_AUDIO_SR_192000, SD_AUDIO_SAMPLE_WIDTH_16BITS, SD_AUDIO_I2S_LEFT_JUSTIFIED},
    {SD_AUDIO_TRANSFER_CODEC_SLAVE | SD_AUDIO_DIR_MODE_RECEIVE | SD_AUDIO_CHANNEL_NUM_RX_STEREO, SD_AUDIO_SR_192000, SD_AUDIO_SAMPLE_WIDTH_16BITS, SD_AUDIO_I2S_RIGHT_JUSTIFIED},
    {SD_AUDIO_TRANSFER_CODEC_SLAVE | SD_AUDIO_DIR_MODE_RECEIVE | SD_AUDIO_CHANNEL_NUM_RX_STEREO, SD_AUDIO_SR_192000, SD_AUDIO_SAMPLE_WIDTH_16BITS, SD_AUDIO_I2S_DSP_A},
    {SD_AUDIO_TRANSFER_CODEC_SLAVE | SD_AUDIO_DIR_MODE_RECEIVE | SD_AUDIO_CHANNEL_NUM_RX_STEREO, SD_AUDIO_SR_192000, SD_AUDIO_SAMPLE_WIDTH_16BITS, SD_AUDIO_I2S_DSP_B},

    {SD_AUDIO_TRANSFER_CODEC_SLAVE | SD_AUDIO_DIR_MODE_RECEIVE | SD_AUDIO_CHANNEL_NUM_RX_STEREO, SD_AUDIO_SR_192000, SD_AUDIO_SAMPLE_WIDTH_24BITS, SD_AUDIO_I2S_STANDARD_PHILLIPS},
    {SD_AUDIO_TRANSFER_CODEC_SLAVE | SD_AUDIO_DIR_MODE_RECEIVE | SD_AUDIO_CHANNEL_NUM_RX_STEREO, SD_AUDIO_SR_192000, SD_AUDIO_SAMPLE_WIDTH_24BITS, SD_AUDIO_I2S_LEFT_JUSTIFIED},
    {SD_AUDIO_TRANSFER_CODEC_SLAVE | SD_AUDIO_DIR_MODE_RECEIVE | SD_AUDIO_CHANNEL_NUM_RX_STEREO, SD_AUDIO_SR_192000, SD_AUDIO_SAMPLE_WIDTH_24BITS, SD_AUDIO_I2S_RIGHT_JUSTIFIED},
    {SD_AUDIO_TRANSFER_CODEC_SLAVE | SD_AUDIO_DIR_MODE_RECEIVE | SD_AUDIO_CHANNEL_NUM_RX_STEREO, SD_AUDIO_SR_192000, SD_AUDIO_SAMPLE_WIDTH_24BITS, SD_AUDIO_I2S_DSP_A},
    {SD_AUDIO_TRANSFER_CODEC_SLAVE | SD_AUDIO_DIR_MODE_RECEIVE | SD_AUDIO_CHANNEL_NUM_RX_STEREO, SD_AUDIO_SR_192000, SD_AUDIO_SAMPLE_WIDTH_24BITS, SD_AUDIO_I2S_DSP_B},

    {SD_AUDIO_TRANSFER_CODEC_SLAVE | SD_AUDIO_DIR_MODE_RECEIVE | SD_AUDIO_CHANNEL_NUM_RX_STEREO, SD_AUDIO_SR_192000, SD_AUDIO_SAMPLE_WIDTH_32BITS, SD_AUDIO_I2S_STANDARD_PHILLIPS},
    {SD_AUDIO_TRANSFER_CODEC_SLAVE | SD_AUDIO_DIR_MODE_RECEIVE | SD_AUDIO_CHANNEL_NUM_RX_STEREO, SD_AUDIO_SR_192000, SD_AUDIO_SAMPLE_WIDTH_32BITS, SD_AUDIO_I2S_LEFT_JUSTIFIED},
    {SD_AUDIO_TRANSFER_CODEC_SLAVE | SD_AUDIO_DIR_MODE_RECEIVE | SD_AUDIO_CHANNEL_NUM_RX_STEREO, SD_AUDIO_SR_192000, SD_AUDIO_SAMPLE_WIDTH_32BITS, SD_AUDIO_I2S_RIGHT_JUSTIFIED},
    {SD_AUDIO_TRANSFER_CODEC_SLAVE | SD_AUDIO_DIR_MODE_RECEIVE | SD_AUDIO_CHANNEL_NUM_RX_STEREO, SD_AUDIO_SR_192000, SD_AUDIO_SAMPLE_WIDTH_32BITS, SD_AUDIO_I2S_DSP_A},
    {SD_AUDIO_TRANSFER_CODEC_SLAVE | SD_AUDIO_DIR_MODE_RECEIVE | SD_AUDIO_CHANNEL_NUM_RX_STEREO, SD_AUDIO_SR_192000, SD_AUDIO_SAMPLE_WIDTH_32BITS, SD_AUDIO_I2S_DSP_B},



/////////////////////////////////////////////////////////////////////////////////mode 5///////////////////////////////////////////////////////////////////////////////////////

//case 321~340
    {SD_AUDIO_TRANSFER_CODEC_SLAVE | SD_AUDIO_DIR_MODE_FULL_DUPLEX | SD_AUDIO_CHANNEL_NUM_TX_MONO, SD_AUDIO_SR_44100, SD_AUDIO_SAMPLE_WIDTH_8BITS, SD_AUDIO_I2S_STANDARD_PHILLIPS},
    {SD_AUDIO_TRANSFER_CODEC_SLAVE | SD_AUDIO_DIR_MODE_FULL_DUPLEX | SD_AUDIO_CHANNEL_NUM_TX_MONO, SD_AUDIO_SR_44100, SD_AUDIO_SAMPLE_WIDTH_8BITS, SD_AUDIO_I2S_LEFT_JUSTIFIED},
    {SD_AUDIO_TRANSFER_CODEC_SLAVE | SD_AUDIO_DIR_MODE_FULL_DUPLEX | SD_AUDIO_CHANNEL_NUM_TX_MONO, SD_AUDIO_SR_44100, SD_AUDIO_SAMPLE_WIDTH_8BITS, SD_AUDIO_I2S_RIGHT_JUSTIFIED},
    {SD_AUDIO_TRANSFER_CODEC_SLAVE | SD_AUDIO_DIR_MODE_FULL_DUPLEX | SD_AUDIO_CHANNEL_NUM_TX_MONO, SD_AUDIO_SR_44100, SD_AUDIO_SAMPLE_WIDTH_8BITS, SD_AUDIO_I2S_DSP_A},
    {SD_AUDIO_TRANSFER_CODEC_SLAVE | SD_AUDIO_DIR_MODE_FULL_DUPLEX | SD_AUDIO_CHANNEL_NUM_TX_MONO, SD_AUDIO_SR_44100, SD_AUDIO_SAMPLE_WIDTH_8BITS, SD_AUDIO_I2S_DSP_B},

    {SD_AUDIO_TRANSFER_CODEC_SLAVE | SD_AUDIO_DIR_MODE_FULL_DUPLEX | SD_AUDIO_CHANNEL_NUM_TX_MONO, SD_AUDIO_SR_44100, SD_AUDIO_SAMPLE_WIDTH_16BITS, SD_AUDIO_I2S_STANDARD_PHILLIPS},
    {SD_AUDIO_TRANSFER_CODEC_SLAVE | SD_AUDIO_DIR_MODE_FULL_DUPLEX | SD_AUDIO_CHANNEL_NUM_TX_MONO, SD_AUDIO_SR_44100, SD_AUDIO_SAMPLE_WIDTH_16BITS, SD_AUDIO_I2S_LEFT_JUSTIFIED},
    {SD_AUDIO_TRANSFER_CODEC_SLAVE | SD_AUDIO_DIR_MODE_FULL_DUPLEX | SD_AUDIO_CHANNEL_NUM_TX_MONO, SD_AUDIO_SR_44100, SD_AUDIO_SAMPLE_WIDTH_16BITS, SD_AUDIO_I2S_RIGHT_JUSTIFIED},
    {SD_AUDIO_TRANSFER_CODEC_SLAVE | SD_AUDIO_DIR_MODE_FULL_DUPLEX | SD_AUDIO_CHANNEL_NUM_TX_MONO, SD_AUDIO_SR_44100, SD_AUDIO_SAMPLE_WIDTH_16BITS, SD_AUDIO_I2S_DSP_A},
    {SD_AUDIO_TRANSFER_CODEC_SLAVE | SD_AUDIO_DIR_MODE_FULL_DUPLEX | SD_AUDIO_CHANNEL_NUM_TX_MONO, SD_AUDIO_SR_44100, SD_AUDIO_SAMPLE_WIDTH_16BITS, SD_AUDIO_I2S_DSP_B},

    {SD_AUDIO_TRANSFER_CODEC_SLAVE | SD_AUDIO_DIR_MODE_FULL_DUPLEX | SD_AUDIO_CHANNEL_NUM_TX_MONO, SD_AUDIO_SR_44100, SD_AUDIO_SAMPLE_WIDTH_24BITS, SD_AUDIO_I2S_STANDARD_PHILLIPS},
    {SD_AUDIO_TRANSFER_CODEC_SLAVE | SD_AUDIO_DIR_MODE_FULL_DUPLEX | SD_AUDIO_CHANNEL_NUM_TX_MONO, SD_AUDIO_SR_44100, SD_AUDIO_SAMPLE_WIDTH_24BITS, SD_AUDIO_I2S_LEFT_JUSTIFIED},
    {SD_AUDIO_TRANSFER_CODEC_SLAVE | SD_AUDIO_DIR_MODE_FULL_DUPLEX | SD_AUDIO_CHANNEL_NUM_TX_MONO, SD_AUDIO_SR_44100, SD_AUDIO_SAMPLE_WIDTH_24BITS, SD_AUDIO_I2S_RIGHT_JUSTIFIED},
    {SD_AUDIO_TRANSFER_CODEC_SLAVE | SD_AUDIO_DIR_MODE_FULL_DUPLEX | SD_AUDIO_CHANNEL_NUM_TX_MONO, SD_AUDIO_SR_44100, SD_AUDIO_SAMPLE_WIDTH_24BITS, SD_AUDIO_I2S_DSP_A},
    {SD_AUDIO_TRANSFER_CODEC_SLAVE | SD_AUDIO_DIR_MODE_FULL_DUPLEX | SD_AUDIO_CHANNEL_NUM_TX_MONO, SD_AUDIO_SR_44100, SD_AUDIO_SAMPLE_WIDTH_24BITS, SD_AUDIO_I2S_DSP_B},

    {SD_AUDIO_TRANSFER_CODEC_SLAVE | SD_AUDIO_DIR_MODE_FULL_DUPLEX | SD_AUDIO_CHANNEL_NUM_TX_MONO, SD_AUDIO_SR_44100, SD_AUDIO_SAMPLE_WIDTH_32BITS, SD_AUDIO_I2S_STANDARD_PHILLIPS},
    {SD_AUDIO_TRANSFER_CODEC_SLAVE | SD_AUDIO_DIR_MODE_FULL_DUPLEX | SD_AUDIO_CHANNEL_NUM_TX_MONO, SD_AUDIO_SR_44100, SD_AUDIO_SAMPLE_WIDTH_32BITS, SD_AUDIO_I2S_LEFT_JUSTIFIED},
    {SD_AUDIO_TRANSFER_CODEC_SLAVE | SD_AUDIO_DIR_MODE_FULL_DUPLEX | SD_AUDIO_CHANNEL_NUM_TX_MONO, SD_AUDIO_SR_44100, SD_AUDIO_SAMPLE_WIDTH_32BITS, SD_AUDIO_I2S_RIGHT_JUSTIFIED},
    {SD_AUDIO_TRANSFER_CODEC_SLAVE | SD_AUDIO_DIR_MODE_FULL_DUPLEX | SD_AUDIO_CHANNEL_NUM_TX_MONO, SD_AUDIO_SR_44100, SD_AUDIO_SAMPLE_WIDTH_32BITS, SD_AUDIO_I2S_DSP_A},
    {SD_AUDIO_TRANSFER_CODEC_SLAVE | SD_AUDIO_DIR_MODE_FULL_DUPLEX | SD_AUDIO_CHANNEL_NUM_TX_MONO, SD_AUDIO_SR_44100, SD_AUDIO_SAMPLE_WIDTH_32BITS, SD_AUDIO_I2S_DSP_B},


//////////////////////////////////////////////////////////////////////////////////////////////////////////////////////////////////////////////////////////////////////////////////
//case 341~360
    {SD_AUDIO_TRANSFER_CODEC_SLAVE | SD_AUDIO_DIR_MODE_FULL_DUPLEX | SD_AUDIO_CHANNEL_NUM_TX_MONO, SD_AUDIO_SR_48000, SD_AUDIO_SAMPLE_WIDTH_8BITS, SD_AUDIO_I2S_STANDARD_PHILLIPS},
    {SD_AUDIO_TRANSFER_CODEC_SLAVE | SD_AUDIO_DIR_MODE_FULL_DUPLEX | SD_AUDIO_CHANNEL_NUM_TX_MONO, SD_AUDIO_SR_48000, SD_AUDIO_SAMPLE_WIDTH_8BITS, SD_AUDIO_I2S_LEFT_JUSTIFIED},
    {SD_AUDIO_TRANSFER_CODEC_SLAVE | SD_AUDIO_DIR_MODE_FULL_DUPLEX | SD_AUDIO_CHANNEL_NUM_TX_MONO, SD_AUDIO_SR_48000, SD_AUDIO_SAMPLE_WIDTH_8BITS, SD_AUDIO_I2S_RIGHT_JUSTIFIED},
    {SD_AUDIO_TRANSFER_CODEC_SLAVE | SD_AUDIO_DIR_MODE_FULL_DUPLEX | SD_AUDIO_CHANNEL_NUM_TX_MONO, SD_AUDIO_SR_48000, SD_AUDIO_SAMPLE_WIDTH_8BITS, SD_AUDIO_I2S_DSP_A},
    {SD_AUDIO_TRANSFER_CODEC_SLAVE | SD_AUDIO_DIR_MODE_FULL_DUPLEX | SD_AUDIO_CHANNEL_NUM_TX_MONO, SD_AUDIO_SR_48000, SD_AUDIO_SAMPLE_WIDTH_8BITS, SD_AUDIO_I2S_DSP_B},

    {SD_AUDIO_TRANSFER_CODEC_SLAVE | SD_AUDIO_DIR_MODE_FULL_DUPLEX | SD_AUDIO_CHANNEL_NUM_TX_MONO, SD_AUDIO_SR_48000, SD_AUDIO_SAMPLE_WIDTH_16BITS, SD_AUDIO_I2S_STANDARD_PHILLIPS},
    {SD_AUDIO_TRANSFER_CODEC_SLAVE | SD_AUDIO_DIR_MODE_FULL_DUPLEX | SD_AUDIO_CHANNEL_NUM_TX_MONO, SD_AUDIO_SR_48000, SD_AUDIO_SAMPLE_WIDTH_16BITS, SD_AUDIO_I2S_LEFT_JUSTIFIED},
    {SD_AUDIO_TRANSFER_CODEC_SLAVE | SD_AUDIO_DIR_MODE_FULL_DUPLEX | SD_AUDIO_CHANNEL_NUM_TX_MONO, SD_AUDIO_SR_48000, SD_AUDIO_SAMPLE_WIDTH_16BITS, SD_AUDIO_I2S_RIGHT_JUSTIFIED},
    {SD_AUDIO_TRANSFER_CODEC_SLAVE | SD_AUDIO_DIR_MODE_FULL_DUPLEX | SD_AUDIO_CHANNEL_NUM_TX_MONO, SD_AUDIO_SR_48000, SD_AUDIO_SAMPLE_WIDTH_16BITS, SD_AUDIO_I2S_DSP_A},
    {SD_AUDIO_TRANSFER_CODEC_SLAVE | SD_AUDIO_DIR_MODE_FULL_DUPLEX | SD_AUDIO_CHANNEL_NUM_TX_MONO, SD_AUDIO_SR_48000, SD_AUDIO_SAMPLE_WIDTH_16BITS, SD_AUDIO_I2S_DSP_B},

    {SD_AUDIO_TRANSFER_CODEC_SLAVE | SD_AUDIO_DIR_MODE_FULL_DUPLEX | SD_AUDIO_CHANNEL_NUM_TX_MONO, SD_AUDIO_SR_48000, SD_AUDIO_SAMPLE_WIDTH_24BITS, SD_AUDIO_I2S_STANDARD_PHILLIPS},
    {SD_AUDIO_TRANSFER_CODEC_SLAVE | SD_AUDIO_DIR_MODE_FULL_DUPLEX | SD_AUDIO_CHANNEL_NUM_TX_MONO, SD_AUDIO_SR_48000, SD_AUDIO_SAMPLE_WIDTH_24BITS, SD_AUDIO_I2S_LEFT_JUSTIFIED},
    {SD_AUDIO_TRANSFER_CODEC_SLAVE | SD_AUDIO_DIR_MODE_FULL_DUPLEX | SD_AUDIO_CHANNEL_NUM_TX_MONO, SD_AUDIO_SR_48000, SD_AUDIO_SAMPLE_WIDTH_24BITS, SD_AUDIO_I2S_RIGHT_JUSTIFIED},
    {SD_AUDIO_TRANSFER_CODEC_SLAVE | SD_AUDIO_DIR_MODE_FULL_DUPLEX | SD_AUDIO_CHANNEL_NUM_TX_MONO, SD_AUDIO_SR_48000, SD_AUDIO_SAMPLE_WIDTH_24BITS, SD_AUDIO_I2S_DSP_A},
    {SD_AUDIO_TRANSFER_CODEC_SLAVE | SD_AUDIO_DIR_MODE_FULL_DUPLEX | SD_AUDIO_CHANNEL_NUM_TX_MONO, SD_AUDIO_SR_48000, SD_AUDIO_SAMPLE_WIDTH_24BITS, SD_AUDIO_I2S_DSP_B},

    {SD_AUDIO_TRANSFER_CODEC_SLAVE | SD_AUDIO_DIR_MODE_FULL_DUPLEX | SD_AUDIO_CHANNEL_NUM_TX_MONO, SD_AUDIO_SR_48000, SD_AUDIO_SAMPLE_WIDTH_32BITS, SD_AUDIO_I2S_STANDARD_PHILLIPS},
    {SD_AUDIO_TRANSFER_CODEC_SLAVE | SD_AUDIO_DIR_MODE_FULL_DUPLEX | SD_AUDIO_CHANNEL_NUM_TX_MONO, SD_AUDIO_SR_48000, SD_AUDIO_SAMPLE_WIDTH_32BITS, SD_AUDIO_I2S_LEFT_JUSTIFIED},
    {SD_AUDIO_TRANSFER_CODEC_SLAVE | SD_AUDIO_DIR_MODE_FULL_DUPLEX | SD_AUDIO_CHANNEL_NUM_TX_MONO, SD_AUDIO_SR_48000, SD_AUDIO_SAMPLE_WIDTH_32BITS, SD_AUDIO_I2S_RIGHT_JUSTIFIED},
    {SD_AUDIO_TRANSFER_CODEC_SLAVE | SD_AUDIO_DIR_MODE_FULL_DUPLEX | SD_AUDIO_CHANNEL_NUM_TX_MONO, SD_AUDIO_SR_48000, SD_AUDIO_SAMPLE_WIDTH_32BITS, SD_AUDIO_I2S_DSP_A},
    {SD_AUDIO_TRANSFER_CODEC_SLAVE | SD_AUDIO_DIR_MODE_FULL_DUPLEX | SD_AUDIO_CHANNEL_NUM_TX_MONO, SD_AUDIO_SR_48000, SD_AUDIO_SAMPLE_WIDTH_32BITS, SD_AUDIO_I2S_DSP_B},


//////////////////////////////////////////////////////////////////////////////////////////////////////////////////////////////////////////////////////////////////////////////////
//case 361~380
    {SD_AUDIO_TRANSFER_CODEC_SLAVE | SD_AUDIO_DIR_MODE_FULL_DUPLEX | SD_AUDIO_CHANNEL_NUM_TX_MONO, SD_AUDIO_SR_96000, SD_AUDIO_SAMPLE_WIDTH_8BITS, SD_AUDIO_I2S_STANDARD_PHILLIPS},
    {SD_AUDIO_TRANSFER_CODEC_SLAVE | SD_AUDIO_DIR_MODE_FULL_DUPLEX | SD_AUDIO_CHANNEL_NUM_TX_MONO, SD_AUDIO_SR_96000, SD_AUDIO_SAMPLE_WIDTH_8BITS, SD_AUDIO_I2S_LEFT_JUSTIFIED},
    {SD_AUDIO_TRANSFER_CODEC_SLAVE | SD_AUDIO_DIR_MODE_FULL_DUPLEX | SD_AUDIO_CHANNEL_NUM_TX_MONO, SD_AUDIO_SR_96000, SD_AUDIO_SAMPLE_WIDTH_8BITS, SD_AUDIO_I2S_RIGHT_JUSTIFIED},
    {SD_AUDIO_TRANSFER_CODEC_SLAVE | SD_AUDIO_DIR_MODE_FULL_DUPLEX | SD_AUDIO_CHANNEL_NUM_TX_MONO, SD_AUDIO_SR_96000, SD_AUDIO_SAMPLE_WIDTH_8BITS, SD_AUDIO_I2S_DSP_A},
    {SD_AUDIO_TRANSFER_CODEC_SLAVE | SD_AUDIO_DIR_MODE_FULL_DUPLEX | SD_AUDIO_CHANNEL_NUM_TX_MONO, SD_AUDIO_SR_96000, SD_AUDIO_SAMPLE_WIDTH_8BITS, SD_AUDIO_I2S_DSP_B},

    {SD_AUDIO_TRANSFER_CODEC_SLAVE | SD_AUDIO_DIR_MODE_FULL_DUPLEX | SD_AUDIO_CHANNEL_NUM_TX_MONO, SD_AUDIO_SR_96000, SD_AUDIO_SAMPLE_WIDTH_16BITS, SD_AUDIO_I2S_STANDARD_PHILLIPS},
    {SD_AUDIO_TRANSFER_CODEC_SLAVE | SD_AUDIO_DIR_MODE_FULL_DUPLEX | SD_AUDIO_CHANNEL_NUM_TX_MONO, SD_AUDIO_SR_96000, SD_AUDIO_SAMPLE_WIDTH_16BITS, SD_AUDIO_I2S_LEFT_JUSTIFIED},
    {SD_AUDIO_TRANSFER_CODEC_SLAVE | SD_AUDIO_DIR_MODE_FULL_DUPLEX | SD_AUDIO_CHANNEL_NUM_TX_MONO, SD_AUDIO_SR_96000, SD_AUDIO_SAMPLE_WIDTH_16BITS, SD_AUDIO_I2S_RIGHT_JUSTIFIED},
    {SD_AUDIO_TRANSFER_CODEC_SLAVE | SD_AUDIO_DIR_MODE_FULL_DUPLEX | SD_AUDIO_CHANNEL_NUM_TX_MONO, SD_AUDIO_SR_96000, SD_AUDIO_SAMPLE_WIDTH_16BITS, SD_AUDIO_I2S_DSP_A},
    {SD_AUDIO_TRANSFER_CODEC_SLAVE | SD_AUDIO_DIR_MODE_FULL_DUPLEX | SD_AUDIO_CHANNEL_NUM_TX_MONO, SD_AUDIO_SR_96000, SD_AUDIO_SAMPLE_WIDTH_16BITS, SD_AUDIO_I2S_DSP_B},

    {SD_AUDIO_TRANSFER_CODEC_SLAVE | SD_AUDIO_DIR_MODE_FULL_DUPLEX | SD_AUDIO_CHANNEL_NUM_TX_MONO, SD_AUDIO_SR_96000, SD_AUDIO_SAMPLE_WIDTH_24BITS, SD_AUDIO_I2S_STANDARD_PHILLIPS},
    {SD_AUDIO_TRANSFER_CODEC_SLAVE | SD_AUDIO_DIR_MODE_FULL_DUPLEX | SD_AUDIO_CHANNEL_NUM_TX_MONO, SD_AUDIO_SR_96000, SD_AUDIO_SAMPLE_WIDTH_24BITS, SD_AUDIO_I2S_LEFT_JUSTIFIED},
    {SD_AUDIO_TRANSFER_CODEC_SLAVE | SD_AUDIO_DIR_MODE_FULL_DUPLEX | SD_AUDIO_CHANNEL_NUM_TX_MONO, SD_AUDIO_SR_96000, SD_AUDIO_SAMPLE_WIDTH_24BITS, SD_AUDIO_I2S_RIGHT_JUSTIFIED},
    {SD_AUDIO_TRANSFER_CODEC_SLAVE | SD_AUDIO_DIR_MODE_FULL_DUPLEX | SD_AUDIO_CHANNEL_NUM_TX_MONO, SD_AUDIO_SR_96000, SD_AUDIO_SAMPLE_WIDTH_24BITS, SD_AUDIO_I2S_DSP_A},
    {SD_AUDIO_TRANSFER_CODEC_SLAVE | SD_AUDIO_DIR_MODE_FULL_DUPLEX | SD_AUDIO_CHANNEL_NUM_TX_MONO, SD_AUDIO_SR_96000, SD_AUDIO_SAMPLE_WIDTH_24BITS, SD_AUDIO_I2S_DSP_B},

    {SD_AUDIO_TRANSFER_CODEC_SLAVE | SD_AUDIO_DIR_MODE_FULL_DUPLEX | SD_AUDIO_CHANNEL_NUM_TX_MONO, SD_AUDIO_SR_96000, SD_AUDIO_SAMPLE_WIDTH_32BITS, SD_AUDIO_I2S_STANDARD_PHILLIPS},
    {SD_AUDIO_TRANSFER_CODEC_SLAVE | SD_AUDIO_DIR_MODE_FULL_DUPLEX | SD_AUDIO_CHANNEL_NUM_TX_MONO, SD_AUDIO_SR_96000, SD_AUDIO_SAMPLE_WIDTH_32BITS, SD_AUDIO_I2S_LEFT_JUSTIFIED},
    {SD_AUDIO_TRANSFER_CODEC_SLAVE | SD_AUDIO_DIR_MODE_FULL_DUPLEX | SD_AUDIO_CHANNEL_NUM_TX_MONO, SD_AUDIO_SR_96000, SD_AUDIO_SAMPLE_WIDTH_32BITS, SD_AUDIO_I2S_RIGHT_JUSTIFIED},
    {SD_AUDIO_TRANSFER_CODEC_SLAVE | SD_AUDIO_DIR_MODE_FULL_DUPLEX | SD_AUDIO_CHANNEL_NUM_TX_MONO, SD_AUDIO_SR_96000, SD_AUDIO_SAMPLE_WIDTH_32BITS, SD_AUDIO_I2S_DSP_A},
    {SD_AUDIO_TRANSFER_CODEC_SLAVE | SD_AUDIO_DIR_MODE_FULL_DUPLEX | SD_AUDIO_CHANNEL_NUM_TX_MONO, SD_AUDIO_SR_96000, SD_AUDIO_SAMPLE_WIDTH_32BITS, SD_AUDIO_I2S_DSP_B},


//////////////////////////////////////////////////////////////////////////////////////////////////////////////////////////////////////////////////////////////////////////////////
//case 381~400
    {SD_AUDIO_TRANSFER_CODEC_SLAVE | SD_AUDIO_DIR_MODE_FULL_DUPLEX | SD_AUDIO_CHANNEL_NUM_TX_MONO, SD_AUDIO_SR_192000, SD_AUDIO_SAMPLE_WIDTH_8BITS, SD_AUDIO_I2S_STANDARD_PHILLIPS},
    {SD_AUDIO_TRANSFER_CODEC_SLAVE | SD_AUDIO_DIR_MODE_FULL_DUPLEX | SD_AUDIO_CHANNEL_NUM_TX_MONO, SD_AUDIO_SR_192000, SD_AUDIO_SAMPLE_WIDTH_8BITS, SD_AUDIO_I2S_LEFT_JUSTIFIED},
    {SD_AUDIO_TRANSFER_CODEC_SLAVE | SD_AUDIO_DIR_MODE_FULL_DUPLEX | SD_AUDIO_CHANNEL_NUM_TX_MONO, SD_AUDIO_SR_192000, SD_AUDIO_SAMPLE_WIDTH_8BITS, SD_AUDIO_I2S_RIGHT_JUSTIFIED},
    {SD_AUDIO_TRANSFER_CODEC_SLAVE | SD_AUDIO_DIR_MODE_FULL_DUPLEX | SD_AUDIO_CHANNEL_NUM_TX_MONO, SD_AUDIO_SR_192000, SD_AUDIO_SAMPLE_WIDTH_8BITS, SD_AUDIO_I2S_DSP_A},
    {SD_AUDIO_TRANSFER_CODEC_SLAVE | SD_AUDIO_DIR_MODE_FULL_DUPLEX | SD_AUDIO_CHANNEL_NUM_TX_MONO, SD_AUDIO_SR_192000, SD_AUDIO_SAMPLE_WIDTH_8BITS, SD_AUDIO_I2S_DSP_B},

    {SD_AUDIO_TRANSFER_CODEC_SLAVE | SD_AUDIO_DIR_MODE_FULL_DUPLEX | SD_AUDIO_CHANNEL_NUM_TX_MONO, SD_AUDIO_SR_192000, SD_AUDIO_SAMPLE_WIDTH_16BITS, SD_AUDIO_I2S_STANDARD_PHILLIPS},
    {SD_AUDIO_TRANSFER_CODEC_SLAVE | SD_AUDIO_DIR_MODE_FULL_DUPLEX | SD_AUDIO_CHANNEL_NUM_TX_MONO, SD_AUDIO_SR_192000, SD_AUDIO_SAMPLE_WIDTH_16BITS, SD_AUDIO_I2S_LEFT_JUSTIFIED},
    {SD_AUDIO_TRANSFER_CODEC_SLAVE | SD_AUDIO_DIR_MODE_FULL_DUPLEX | SD_AUDIO_CHANNEL_NUM_TX_MONO, SD_AUDIO_SR_192000, SD_AUDIO_SAMPLE_WIDTH_16BITS, SD_AUDIO_I2S_RIGHT_JUSTIFIED},
    {SD_AUDIO_TRANSFER_CODEC_SLAVE | SD_AUDIO_DIR_MODE_FULL_DUPLEX | SD_AUDIO_CHANNEL_NUM_TX_MONO, SD_AUDIO_SR_192000, SD_AUDIO_SAMPLE_WIDTH_16BITS, SD_AUDIO_I2S_DSP_A},
    {SD_AUDIO_TRANSFER_CODEC_SLAVE | SD_AUDIO_DIR_MODE_FULL_DUPLEX | SD_AUDIO_CHANNEL_NUM_TX_MONO, SD_AUDIO_SR_192000, SD_AUDIO_SAMPLE_WIDTH_16BITS, SD_AUDIO_I2S_DSP_B},

    {SD_AUDIO_TRANSFER_CODEC_SLAVE | SD_AUDIO_DIR_MODE_FULL_DUPLEX | SD_AUDIO_CHANNEL_NUM_TX_MONO, SD_AUDIO_SR_192000, SD_AUDIO_SAMPLE_WIDTH_24BITS, SD_AUDIO_I2S_STANDARD_PHILLIPS},
    {SD_AUDIO_TRANSFER_CODEC_SLAVE | SD_AUDIO_DIR_MODE_FULL_DUPLEX | SD_AUDIO_CHANNEL_NUM_TX_MONO, SD_AUDIO_SR_192000, SD_AUDIO_SAMPLE_WIDTH_24BITS, SD_AUDIO_I2S_LEFT_JUSTIFIED},
    {SD_AUDIO_TRANSFER_CODEC_SLAVE | SD_AUDIO_DIR_MODE_FULL_DUPLEX | SD_AUDIO_CHANNEL_NUM_TX_MONO, SD_AUDIO_SR_192000, SD_AUDIO_SAMPLE_WIDTH_24BITS, SD_AUDIO_I2S_RIGHT_JUSTIFIED},
    {SD_AUDIO_TRANSFER_CODEC_SLAVE | SD_AUDIO_DIR_MODE_FULL_DUPLEX | SD_AUDIO_CHANNEL_NUM_TX_MONO, SD_AUDIO_SR_192000, SD_AUDIO_SAMPLE_WIDTH_24BITS, SD_AUDIO_I2S_DSP_A},
    {SD_AUDIO_TRANSFER_CODEC_SLAVE | SD_AUDIO_DIR_MODE_FULL_DUPLEX | SD_AUDIO_CHANNEL_NUM_TX_MONO, SD_AUDIO_SR_192000, SD_AUDIO_SAMPLE_WIDTH_24BITS, SD_AUDIO_I2S_DSP_B},

    {SD_AUDIO_TRANSFER_CODEC_SLAVE | SD_AUDIO_DIR_MODE_FULL_DUPLEX | SD_AUDIO_CHANNEL_NUM_TX_MONO, SD_AUDIO_SR_192000, SD_AUDIO_SAMPLE_WIDTH_32BITS, SD_AUDIO_I2S_STANDARD_PHILLIPS},
    {SD_AUDIO_TRANSFER_CODEC_SLAVE | SD_AUDIO_DIR_MODE_FULL_DUPLEX | SD_AUDIO_CHANNEL_NUM_TX_MONO, SD_AUDIO_SR_192000, SD_AUDIO_SAMPLE_WIDTH_32BITS, SD_AUDIO_I2S_LEFT_JUSTIFIED},
    {SD_AUDIO_TRANSFER_CODEC_SLAVE | SD_AUDIO_DIR_MODE_FULL_DUPLEX | SD_AUDIO_CHANNEL_NUM_TX_MONO, SD_AUDIO_SR_192000, SD_AUDIO_SAMPLE_WIDTH_32BITS, SD_AUDIO_I2S_RIGHT_JUSTIFIED},
    {SD_AUDIO_TRANSFER_CODEC_SLAVE | SD_AUDIO_DIR_MODE_FULL_DUPLEX | SD_AUDIO_CHANNEL_NUM_TX_MONO, SD_AUDIO_SR_192000, SD_AUDIO_SAMPLE_WIDTH_32BITS, SD_AUDIO_I2S_DSP_A},
    {SD_AUDIO_TRANSFER_CODEC_SLAVE | SD_AUDIO_DIR_MODE_FULL_DUPLEX | SD_AUDIO_CHANNEL_NUM_TX_MONO, SD_AUDIO_SR_192000, SD_AUDIO_SAMPLE_WIDTH_32BITS, SD_AUDIO_I2S_DSP_B},



/////////////////////////////////////////////////////////////////////////////////mode 6/////////////////////////////////////////////////////////////////////////////////////////

//case 401~420
    {SD_AUDIO_TRANSFER_CODEC_SLAVE | SD_AUDIO_DIR_MODE_FULL_DUPLEX | SD_AUDIO_CHANNEL_NUM_TX_STEREO, SD_AUDIO_SR_44100, SD_AUDIO_SAMPLE_WIDTH_8BITS, SD_AUDIO_I2S_STANDARD_PHILLIPS},
    {SD_AUDIO_TRANSFER_CODEC_SLAVE | SD_AUDIO_DIR_MODE_FULL_DUPLEX | SD_AUDIO_CHANNEL_NUM_TX_STEREO, SD_AUDIO_SR_44100, SD_AUDIO_SAMPLE_WIDTH_8BITS, SD_AUDIO_I2S_LEFT_JUSTIFIED},
    {SD_AUDIO_TRANSFER_CODEC_SLAVE | SD_AUDIO_DIR_MODE_FULL_DUPLEX | SD_AUDIO_CHANNEL_NUM_TX_STEREO, SD_AUDIO_SR_44100, SD_AUDIO_SAMPLE_WIDTH_8BITS, SD_AUDIO_I2S_RIGHT_JUSTIFIED},
    {SD_AUDIO_TRANSFER_CODEC_SLAVE | SD_AUDIO_DIR_MODE_FULL_DUPLEX | SD_AUDIO_CHANNEL_NUM_TX_STEREO, SD_AUDIO_SR_44100, SD_AUDIO_SAMPLE_WIDTH_8BITS, SD_AUDIO_I2S_DSP_A},
    {SD_AUDIO_TRANSFER_CODEC_SLAVE | SD_AUDIO_DIR_MODE_FULL_DUPLEX | SD_AUDIO_CHANNEL_NUM_TX_STEREO, SD_AUDIO_SR_44100, SD_AUDIO_SAMPLE_WIDTH_8BITS, SD_AUDIO_I2S_DSP_B},

    {SD_AUDIO_TRANSFER_CODEC_SLAVE | SD_AUDIO_DIR_MODE_FULL_DUPLEX | SD_AUDIO_CHANNEL_NUM_TX_STEREO, SD_AUDIO_SR_44100, SD_AUDIO_SAMPLE_WIDTH_16BITS, SD_AUDIO_I2S_STANDARD_PHILLIPS},
    {SD_AUDIO_TRANSFER_CODEC_SLAVE | SD_AUDIO_DIR_MODE_FULL_DUPLEX | SD_AUDIO_CHANNEL_NUM_TX_STEREO, SD_AUDIO_SR_44100, SD_AUDIO_SAMPLE_WIDTH_16BITS, SD_AUDIO_I2S_LEFT_JUSTIFIED},
    {SD_AUDIO_TRANSFER_CODEC_SLAVE | SD_AUDIO_DIR_MODE_FULL_DUPLEX | SD_AUDIO_CHANNEL_NUM_TX_STEREO, SD_AUDIO_SR_44100, SD_AUDIO_SAMPLE_WIDTH_16BITS, SD_AUDIO_I2S_RIGHT_JUSTIFIED},
    {SD_AUDIO_TRANSFER_CODEC_SLAVE | SD_AUDIO_DIR_MODE_FULL_DUPLEX | SD_AUDIO_CHANNEL_NUM_TX_STEREO, SD_AUDIO_SR_44100, SD_AUDIO_SAMPLE_WIDTH_16BITS, SD_AUDIO_I2S_DSP_A},
    {SD_AUDIO_TRANSFER_CODEC_SLAVE | SD_AUDIO_DIR_MODE_FULL_DUPLEX | SD_AUDIO_CHANNEL_NUM_TX_STEREO, SD_AUDIO_SR_44100, SD_AUDIO_SAMPLE_WIDTH_16BITS, SD_AUDIO_I2S_DSP_B},

    {SD_AUDIO_TRANSFER_CODEC_SLAVE | SD_AUDIO_DIR_MODE_FULL_DUPLEX | SD_AUDIO_CHANNEL_NUM_TX_STEREO, SD_AUDIO_SR_44100, SD_AUDIO_SAMPLE_WIDTH_24BITS, SD_AUDIO_I2S_STANDARD_PHILLIPS},
    {SD_AUDIO_TRANSFER_CODEC_SLAVE | SD_AUDIO_DIR_MODE_FULL_DUPLEX | SD_AUDIO_CHANNEL_NUM_TX_STEREO, SD_AUDIO_SR_44100, SD_AUDIO_SAMPLE_WIDTH_24BITS, SD_AUDIO_I2S_LEFT_JUSTIFIED},
    {SD_AUDIO_TRANSFER_CODEC_SLAVE | SD_AUDIO_DIR_MODE_FULL_DUPLEX | SD_AUDIO_CHANNEL_NUM_TX_STEREO, SD_AUDIO_SR_44100, SD_AUDIO_SAMPLE_WIDTH_24BITS, SD_AUDIO_I2S_RIGHT_JUSTIFIED},
    {SD_AUDIO_TRANSFER_CODEC_SLAVE | SD_AUDIO_DIR_MODE_FULL_DUPLEX | SD_AUDIO_CHANNEL_NUM_TX_STEREO, SD_AUDIO_SR_44100, SD_AUDIO_SAMPLE_WIDTH_24BITS, SD_AUDIO_I2S_DSP_A},
    {SD_AUDIO_TRANSFER_CODEC_SLAVE | SD_AUDIO_DIR_MODE_FULL_DUPLEX | SD_AUDIO_CHANNEL_NUM_TX_STEREO, SD_AUDIO_SR_44100, SD_AUDIO_SAMPLE_WIDTH_24BITS, SD_AUDIO_I2S_DSP_B},

    {SD_AUDIO_TRANSFER_CODEC_SLAVE | SD_AUDIO_DIR_MODE_FULL_DUPLEX | SD_AUDIO_CHANNEL_NUM_TX_STEREO, SD_AUDIO_SR_44100, SD_AUDIO_SAMPLE_WIDTH_32BITS, SD_AUDIO_I2S_STANDARD_PHILLIPS},
    {SD_AUDIO_TRANSFER_CODEC_SLAVE | SD_AUDIO_DIR_MODE_FULL_DUPLEX | SD_AUDIO_CHANNEL_NUM_TX_STEREO, SD_AUDIO_SR_44100, SD_AUDIO_SAMPLE_WIDTH_32BITS, SD_AUDIO_I2S_LEFT_JUSTIFIED},
    {SD_AUDIO_TRANSFER_CODEC_SLAVE | SD_AUDIO_DIR_MODE_FULL_DUPLEX | SD_AUDIO_CHANNEL_NUM_TX_STEREO, SD_AUDIO_SR_44100, SD_AUDIO_SAMPLE_WIDTH_32BITS, SD_AUDIO_I2S_RIGHT_JUSTIFIED},
    {SD_AUDIO_TRANSFER_CODEC_SLAVE | SD_AUDIO_DIR_MODE_FULL_DUPLEX | SD_AUDIO_CHANNEL_NUM_TX_STEREO, SD_AUDIO_SR_44100, SD_AUDIO_SAMPLE_WIDTH_32BITS, SD_AUDIO_I2S_DSP_A},
    {SD_AUDIO_TRANSFER_CODEC_SLAVE | SD_AUDIO_DIR_MODE_FULL_DUPLEX | SD_AUDIO_CHANNEL_NUM_TX_STEREO, SD_AUDIO_SR_44100, SD_AUDIO_SAMPLE_WIDTH_32BITS, SD_AUDIO_I2S_DSP_B},


////////////////////////////////////////////////////////////////////////////////////////////////////////////////////////////////////////////////////////////////////////////////////
//case 421~440
    {SD_AUDIO_TRANSFER_CODEC_SLAVE | SD_AUDIO_DIR_MODE_FULL_DUPLEX | SD_AUDIO_CHANNEL_NUM_TX_STEREO, SD_AUDIO_SR_48000, SD_AUDIO_SAMPLE_WIDTH_8BITS, SD_AUDIO_I2S_STANDARD_PHILLIPS},
    {SD_AUDIO_TRANSFER_CODEC_SLAVE | SD_AUDIO_DIR_MODE_FULL_DUPLEX | SD_AUDIO_CHANNEL_NUM_TX_STEREO, SD_AUDIO_SR_48000, SD_AUDIO_SAMPLE_WIDTH_8BITS, SD_AUDIO_I2S_LEFT_JUSTIFIED},
    {SD_AUDIO_TRANSFER_CODEC_SLAVE | SD_AUDIO_DIR_MODE_FULL_DUPLEX | SD_AUDIO_CHANNEL_NUM_TX_STEREO, SD_AUDIO_SR_48000, SD_AUDIO_SAMPLE_WIDTH_8BITS, SD_AUDIO_I2S_RIGHT_JUSTIFIED},
    {SD_AUDIO_TRANSFER_CODEC_SLAVE | SD_AUDIO_DIR_MODE_FULL_DUPLEX | SD_AUDIO_CHANNEL_NUM_TX_STEREO, SD_AUDIO_SR_48000, SD_AUDIO_SAMPLE_WIDTH_8BITS, SD_AUDIO_I2S_DSP_A},
    {SD_AUDIO_TRANSFER_CODEC_SLAVE | SD_AUDIO_DIR_MODE_FULL_DUPLEX | SD_AUDIO_CHANNEL_NUM_TX_STEREO, SD_AUDIO_SR_48000, SD_AUDIO_SAMPLE_WIDTH_8BITS, SD_AUDIO_I2S_DSP_B},

    {SD_AUDIO_TRANSFER_CODEC_SLAVE | SD_AUDIO_DIR_MODE_FULL_DUPLEX | SD_AUDIO_CHANNEL_NUM_TX_STEREO, SD_AUDIO_SR_48000, SD_AUDIO_SAMPLE_WIDTH_16BITS, SD_AUDIO_I2S_STANDARD_PHILLIPS},
    {SD_AUDIO_TRANSFER_CODEC_SLAVE | SD_AUDIO_DIR_MODE_FULL_DUPLEX | SD_AUDIO_CHANNEL_NUM_TX_STEREO, SD_AUDIO_SR_48000, SD_AUDIO_SAMPLE_WIDTH_16BITS, SD_AUDIO_I2S_LEFT_JUSTIFIED},
    {SD_AUDIO_TRANSFER_CODEC_SLAVE | SD_AUDIO_DIR_MODE_FULL_DUPLEX | SD_AUDIO_CHANNEL_NUM_TX_STEREO, SD_AUDIO_SR_48000, SD_AUDIO_SAMPLE_WIDTH_16BITS, SD_AUDIO_I2S_RIGHT_JUSTIFIED},
    {SD_AUDIO_TRANSFER_CODEC_SLAVE | SD_AUDIO_DIR_MODE_FULL_DUPLEX | SD_AUDIO_CHANNEL_NUM_TX_STEREO, SD_AUDIO_SR_48000, SD_AUDIO_SAMPLE_WIDTH_16BITS, SD_AUDIO_I2S_DSP_A},
    {SD_AUDIO_TRANSFER_CODEC_SLAVE | SD_AUDIO_DIR_MODE_FULL_DUPLEX | SD_AUDIO_CHANNEL_NUM_TX_STEREO, SD_AUDIO_SR_48000, SD_AUDIO_SAMPLE_WIDTH_16BITS, SD_AUDIO_I2S_DSP_B},

    {SD_AUDIO_TRANSFER_CODEC_SLAVE | SD_AUDIO_DIR_MODE_FULL_DUPLEX | SD_AUDIO_CHANNEL_NUM_TX_STEREO, SD_AUDIO_SR_48000, SD_AUDIO_SAMPLE_WIDTH_24BITS, SD_AUDIO_I2S_STANDARD_PHILLIPS},
    {SD_AUDIO_TRANSFER_CODEC_SLAVE | SD_AUDIO_DIR_MODE_FULL_DUPLEX | SD_AUDIO_CHANNEL_NUM_TX_STEREO, SD_AUDIO_SR_48000, SD_AUDIO_SAMPLE_WIDTH_24BITS, SD_AUDIO_I2S_LEFT_JUSTIFIED},
    {SD_AUDIO_TRANSFER_CODEC_SLAVE | SD_AUDIO_DIR_MODE_FULL_DUPLEX | SD_AUDIO_CHANNEL_NUM_TX_STEREO, SD_AUDIO_SR_48000, SD_AUDIO_SAMPLE_WIDTH_24BITS, SD_AUDIO_I2S_RIGHT_JUSTIFIED},
    {SD_AUDIO_TRANSFER_CODEC_SLAVE | SD_AUDIO_DIR_MODE_FULL_DUPLEX | SD_AUDIO_CHANNEL_NUM_TX_STEREO, SD_AUDIO_SR_48000, SD_AUDIO_SAMPLE_WIDTH_24BITS, SD_AUDIO_I2S_DSP_A},
    {SD_AUDIO_TRANSFER_CODEC_SLAVE | SD_AUDIO_DIR_MODE_FULL_DUPLEX | SD_AUDIO_CHANNEL_NUM_TX_STEREO, SD_AUDIO_SR_48000, SD_AUDIO_SAMPLE_WIDTH_24BITS, SD_AUDIO_I2S_DSP_B},

    {SD_AUDIO_TRANSFER_CODEC_SLAVE | SD_AUDIO_DIR_MODE_FULL_DUPLEX | SD_AUDIO_CHANNEL_NUM_TX_STEREO, SD_AUDIO_SR_48000, SD_AUDIO_SAMPLE_WIDTH_32BITS, SD_AUDIO_I2S_STANDARD_PHILLIPS},
    {SD_AUDIO_TRANSFER_CODEC_SLAVE | SD_AUDIO_DIR_MODE_FULL_DUPLEX | SD_AUDIO_CHANNEL_NUM_TX_STEREO, SD_AUDIO_SR_48000, SD_AUDIO_SAMPLE_WIDTH_32BITS, SD_AUDIO_I2S_LEFT_JUSTIFIED},
    {SD_AUDIO_TRANSFER_CODEC_SLAVE | SD_AUDIO_DIR_MODE_FULL_DUPLEX | SD_AUDIO_CHANNEL_NUM_TX_STEREO, SD_AUDIO_SR_48000, SD_AUDIO_SAMPLE_WIDTH_32BITS, SD_AUDIO_I2S_RIGHT_JUSTIFIED},
    {SD_AUDIO_TRANSFER_CODEC_SLAVE | SD_AUDIO_DIR_MODE_FULL_DUPLEX | SD_AUDIO_CHANNEL_NUM_TX_STEREO, SD_AUDIO_SR_48000, SD_AUDIO_SAMPLE_WIDTH_32BITS, SD_AUDIO_I2S_DSP_A},
    {SD_AUDIO_TRANSFER_CODEC_SLAVE | SD_AUDIO_DIR_MODE_FULL_DUPLEX | SD_AUDIO_CHANNEL_NUM_TX_STEREO, SD_AUDIO_SR_48000, SD_AUDIO_SAMPLE_WIDTH_32BITS, SD_AUDIO_I2S_DSP_B},


////////////////////////////////////////////////////////////////////////////////////////////////////////////////////////////////////////////////////////////////////////////////////
//case 441~460
    {SD_AUDIO_TRANSFER_CODEC_SLAVE | SD_AUDIO_DIR_MODE_FULL_DUPLEX | SD_AUDIO_CHANNEL_NUM_TX_STEREO, SD_AUDIO_SR_96000, SD_AUDIO_SAMPLE_WIDTH_8BITS, SD_AUDIO_I2S_STANDARD_PHILLIPS},
    {SD_AUDIO_TRANSFER_CODEC_SLAVE | SD_AUDIO_DIR_MODE_FULL_DUPLEX | SD_AUDIO_CHANNEL_NUM_TX_STEREO, SD_AUDIO_SR_96000, SD_AUDIO_SAMPLE_WIDTH_8BITS, SD_AUDIO_I2S_LEFT_JUSTIFIED},
    {SD_AUDIO_TRANSFER_CODEC_SLAVE | SD_AUDIO_DIR_MODE_FULL_DUPLEX | SD_AUDIO_CHANNEL_NUM_TX_STEREO, SD_AUDIO_SR_96000, SD_AUDIO_SAMPLE_WIDTH_8BITS, SD_AUDIO_I2S_RIGHT_JUSTIFIED},
    {SD_AUDIO_TRANSFER_CODEC_SLAVE | SD_AUDIO_DIR_MODE_FULL_DUPLEX | SD_AUDIO_CHANNEL_NUM_TX_STEREO, SD_AUDIO_SR_96000, SD_AUDIO_SAMPLE_WIDTH_8BITS, SD_AUDIO_I2S_DSP_A},
    {SD_AUDIO_TRANSFER_CODEC_SLAVE | SD_AUDIO_DIR_MODE_FULL_DUPLEX | SD_AUDIO_CHANNEL_NUM_TX_STEREO, SD_AUDIO_SR_96000, SD_AUDIO_SAMPLE_WIDTH_8BITS, SD_AUDIO_I2S_DSP_B},

    {SD_AUDIO_TRANSFER_CODEC_SLAVE | SD_AUDIO_DIR_MODE_FULL_DUPLEX | SD_AUDIO_CHANNEL_NUM_TX_STEREO, SD_AUDIO_SR_96000, SD_AUDIO_SAMPLE_WIDTH_16BITS, SD_AUDIO_I2S_STANDARD_PHILLIPS},
    {SD_AUDIO_TRANSFER_CODEC_SLAVE | SD_AUDIO_DIR_MODE_FULL_DUPLEX | SD_AUDIO_CHANNEL_NUM_TX_STEREO, SD_AUDIO_SR_96000, SD_AUDIO_SAMPLE_WIDTH_16BITS, SD_AUDIO_I2S_LEFT_JUSTIFIED},
    {SD_AUDIO_TRANSFER_CODEC_SLAVE | SD_AUDIO_DIR_MODE_FULL_DUPLEX | SD_AUDIO_CHANNEL_NUM_TX_STEREO, SD_AUDIO_SR_96000, SD_AUDIO_SAMPLE_WIDTH_16BITS, SD_AUDIO_I2S_RIGHT_JUSTIFIED},
    {SD_AUDIO_TRANSFER_CODEC_SLAVE | SD_AUDIO_DIR_MODE_FULL_DUPLEX | SD_AUDIO_CHANNEL_NUM_TX_STEREO, SD_AUDIO_SR_96000, SD_AUDIO_SAMPLE_WIDTH_16BITS, SD_AUDIO_I2S_DSP_A},
    {SD_AUDIO_TRANSFER_CODEC_SLAVE | SD_AUDIO_DIR_MODE_FULL_DUPLEX | SD_AUDIO_CHANNEL_NUM_TX_STEREO, SD_AUDIO_SR_96000, SD_AUDIO_SAMPLE_WIDTH_16BITS, SD_AUDIO_I2S_DSP_B},

    {SD_AUDIO_TRANSFER_CODEC_SLAVE | SD_AUDIO_DIR_MODE_FULL_DUPLEX | SD_AUDIO_CHANNEL_NUM_TX_STEREO, SD_AUDIO_SR_96000, SD_AUDIO_SAMPLE_WIDTH_24BITS, SD_AUDIO_I2S_STANDARD_PHILLIPS},
    {SD_AUDIO_TRANSFER_CODEC_SLAVE | SD_AUDIO_DIR_MODE_FULL_DUPLEX | SD_AUDIO_CHANNEL_NUM_TX_STEREO, SD_AUDIO_SR_96000, SD_AUDIO_SAMPLE_WIDTH_24BITS, SD_AUDIO_I2S_LEFT_JUSTIFIED},
    {SD_AUDIO_TRANSFER_CODEC_SLAVE | SD_AUDIO_DIR_MODE_FULL_DUPLEX | SD_AUDIO_CHANNEL_NUM_TX_STEREO, SD_AUDIO_SR_96000, SD_AUDIO_SAMPLE_WIDTH_24BITS, SD_AUDIO_I2S_RIGHT_JUSTIFIED},
    {SD_AUDIO_TRANSFER_CODEC_SLAVE | SD_AUDIO_DIR_MODE_FULL_DUPLEX | SD_AUDIO_CHANNEL_NUM_TX_STEREO, SD_AUDIO_SR_96000, SD_AUDIO_SAMPLE_WIDTH_24BITS, SD_AUDIO_I2S_DSP_A},
    {SD_AUDIO_TRANSFER_CODEC_SLAVE | SD_AUDIO_DIR_MODE_FULL_DUPLEX | SD_AUDIO_CHANNEL_NUM_TX_STEREO, SD_AUDIO_SR_96000, SD_AUDIO_SAMPLE_WIDTH_24BITS, SD_AUDIO_I2S_DSP_B},

    {SD_AUDIO_TRANSFER_CODEC_SLAVE | SD_AUDIO_DIR_MODE_FULL_DUPLEX | SD_AUDIO_CHANNEL_NUM_TX_STEREO, SD_AUDIO_SR_96000, SD_AUDIO_SAMPLE_WIDTH_32BITS, SD_AUDIO_I2S_STANDARD_PHILLIPS},
    {SD_AUDIO_TRANSFER_CODEC_SLAVE | SD_AUDIO_DIR_MODE_FULL_DUPLEX | SD_AUDIO_CHANNEL_NUM_TX_STEREO, SD_AUDIO_SR_96000, SD_AUDIO_SAMPLE_WIDTH_32BITS, SD_AUDIO_I2S_LEFT_JUSTIFIED},
    {SD_AUDIO_TRANSFER_CODEC_SLAVE | SD_AUDIO_DIR_MODE_FULL_DUPLEX | SD_AUDIO_CHANNEL_NUM_TX_STEREO, SD_AUDIO_SR_96000, SD_AUDIO_SAMPLE_WIDTH_32BITS, SD_AUDIO_I2S_RIGHT_JUSTIFIED},
    {SD_AUDIO_TRANSFER_CODEC_SLAVE | SD_AUDIO_DIR_MODE_FULL_DUPLEX | SD_AUDIO_CHANNEL_NUM_TX_STEREO, SD_AUDIO_SR_96000, SD_AUDIO_SAMPLE_WIDTH_32BITS, SD_AUDIO_I2S_DSP_A},
    {SD_AUDIO_TRANSFER_CODEC_SLAVE | SD_AUDIO_DIR_MODE_FULL_DUPLEX | SD_AUDIO_CHANNEL_NUM_TX_STEREO, SD_AUDIO_SR_96000, SD_AUDIO_SAMPLE_WIDTH_32BITS, SD_AUDIO_I2S_DSP_B},


////////////////////////////////////////////////////////////////////////////////////////////////////////////////////////////////////////////////////////////////////////////////////
//case 461~480
    {SD_AUDIO_TRANSFER_CODEC_SLAVE | SD_AUDIO_DIR_MODE_FULL_DUPLEX | SD_AUDIO_CHANNEL_NUM_TX_STEREO, SD_AUDIO_SR_192000, SD_AUDIO_SAMPLE_WIDTH_8BITS, SD_AUDIO_I2S_STANDARD_PHILLIPS},
    {SD_AUDIO_TRANSFER_CODEC_SLAVE | SD_AUDIO_DIR_MODE_FULL_DUPLEX | SD_AUDIO_CHANNEL_NUM_TX_STEREO, SD_AUDIO_SR_192000, SD_AUDIO_SAMPLE_WIDTH_8BITS, SD_AUDIO_I2S_LEFT_JUSTIFIED},
    {SD_AUDIO_TRANSFER_CODEC_SLAVE | SD_AUDIO_DIR_MODE_FULL_DUPLEX | SD_AUDIO_CHANNEL_NUM_TX_STEREO, SD_AUDIO_SR_192000, SD_AUDIO_SAMPLE_WIDTH_8BITS, SD_AUDIO_I2S_RIGHT_JUSTIFIED},
    {SD_AUDIO_TRANSFER_CODEC_SLAVE | SD_AUDIO_DIR_MODE_FULL_DUPLEX | SD_AUDIO_CHANNEL_NUM_TX_STEREO, SD_AUDIO_SR_192000, SD_AUDIO_SAMPLE_WIDTH_8BITS, SD_AUDIO_I2S_DSP_A},
    {SD_AUDIO_TRANSFER_CODEC_SLAVE | SD_AUDIO_DIR_MODE_FULL_DUPLEX | SD_AUDIO_CHANNEL_NUM_TX_STEREO, SD_AUDIO_SR_192000, SD_AUDIO_SAMPLE_WIDTH_8BITS, SD_AUDIO_I2S_DSP_B},

    {SD_AUDIO_TRANSFER_CODEC_SLAVE | SD_AUDIO_DIR_MODE_FULL_DUPLEX | SD_AUDIO_CHANNEL_NUM_TX_STEREO, SD_AUDIO_SR_192000, SD_AUDIO_SAMPLE_WIDTH_16BITS, SD_AUDIO_I2S_STANDARD_PHILLIPS},
    {SD_AUDIO_TRANSFER_CODEC_SLAVE | SD_AUDIO_DIR_MODE_FULL_DUPLEX | SD_AUDIO_CHANNEL_NUM_TX_STEREO, SD_AUDIO_SR_192000, SD_AUDIO_SAMPLE_WIDTH_16BITS, SD_AUDIO_I2S_LEFT_JUSTIFIED},
    {SD_AUDIO_TRANSFER_CODEC_SLAVE | SD_AUDIO_DIR_MODE_FULL_DUPLEX | SD_AUDIO_CHANNEL_NUM_TX_STEREO, SD_AUDIO_SR_192000, SD_AUDIO_SAMPLE_WIDTH_16BITS, SD_AUDIO_I2S_RIGHT_JUSTIFIED},
    {SD_AUDIO_TRANSFER_CODEC_SLAVE | SD_AUDIO_DIR_MODE_FULL_DUPLEX | SD_AUDIO_CHANNEL_NUM_TX_STEREO, SD_AUDIO_SR_192000, SD_AUDIO_SAMPLE_WIDTH_16BITS, SD_AUDIO_I2S_DSP_A},
    {SD_AUDIO_TRANSFER_CODEC_SLAVE | SD_AUDIO_DIR_MODE_FULL_DUPLEX | SD_AUDIO_CHANNEL_NUM_TX_STEREO, SD_AUDIO_SR_192000, SD_AUDIO_SAMPLE_WIDTH_16BITS, SD_AUDIO_I2S_DSP_B},

    {SD_AUDIO_TRANSFER_CODEC_SLAVE | SD_AUDIO_DIR_MODE_FULL_DUPLEX | SD_AUDIO_CHANNEL_NUM_TX_STEREO, SD_AUDIO_SR_192000, SD_AUDIO_SAMPLE_WIDTH_24BITS, SD_AUDIO_I2S_STANDARD_PHILLIPS},
    {SD_AUDIO_TRANSFER_CODEC_SLAVE | SD_AUDIO_DIR_MODE_FULL_DUPLEX | SD_AUDIO_CHANNEL_NUM_TX_STEREO, SD_AUDIO_SR_192000, SD_AUDIO_SAMPLE_WIDTH_24BITS, SD_AUDIO_I2S_LEFT_JUSTIFIED},
    {SD_AUDIO_TRANSFER_CODEC_SLAVE | SD_AUDIO_DIR_MODE_FULL_DUPLEX | SD_AUDIO_CHANNEL_NUM_TX_STEREO, SD_AUDIO_SR_192000, SD_AUDIO_SAMPLE_WIDTH_24BITS, SD_AUDIO_I2S_RIGHT_JUSTIFIED},
    {SD_AUDIO_TRANSFER_CODEC_SLAVE | SD_AUDIO_DIR_MODE_FULL_DUPLEX | SD_AUDIO_CHANNEL_NUM_TX_STEREO, SD_AUDIO_SR_192000, SD_AUDIO_SAMPLE_WIDTH_24BITS, SD_AUDIO_I2S_DSP_A},
    {SD_AUDIO_TRANSFER_CODEC_SLAVE | SD_AUDIO_DIR_MODE_FULL_DUPLEX | SD_AUDIO_CHANNEL_NUM_TX_STEREO, SD_AUDIO_SR_192000, SD_AUDIO_SAMPLE_WIDTH_24BITS, SD_AUDIO_I2S_DSP_B},

    {SD_AUDIO_TRANSFER_CODEC_SLAVE | SD_AUDIO_DIR_MODE_FULL_DUPLEX | SD_AUDIO_CHANNEL_NUM_TX_STEREO, SD_AUDIO_SR_192000, SD_AUDIO_SAMPLE_WIDTH_32BITS, SD_AUDIO_I2S_STANDARD_PHILLIPS},
    {SD_AUDIO_TRANSFER_CODEC_SLAVE | SD_AUDIO_DIR_MODE_FULL_DUPLEX | SD_AUDIO_CHANNEL_NUM_TX_STEREO, SD_AUDIO_SR_192000, SD_AUDIO_SAMPLE_WIDTH_32BITS, SD_AUDIO_I2S_LEFT_JUSTIFIED},
    {SD_AUDIO_TRANSFER_CODEC_SLAVE | SD_AUDIO_DIR_MODE_FULL_DUPLEX | SD_AUDIO_CHANNEL_NUM_TX_STEREO, SD_AUDIO_SR_192000, SD_AUDIO_SAMPLE_WIDTH_32BITS, SD_AUDIO_I2S_RIGHT_JUSTIFIED},
    {SD_AUDIO_TRANSFER_CODEC_SLAVE | SD_AUDIO_DIR_MODE_FULL_DUPLEX | SD_AUDIO_CHANNEL_NUM_TX_STEREO, SD_AUDIO_SR_192000, SD_AUDIO_SAMPLE_WIDTH_32BITS, SD_AUDIO_I2S_DSP_A},
    {SD_AUDIO_TRANSFER_CODEC_SLAVE | SD_AUDIO_DIR_MODE_FULL_DUPLEX | SD_AUDIO_CHANNEL_NUM_TX_STEREO, SD_AUDIO_SR_192000, SD_AUDIO_SAMPLE_WIDTH_32BITS, SD_AUDIO_I2S_DSP_B},



/////////////////////////////////////////////////////////////////////////////////mode 7///////////////////////////////////////////////////////////////////////////////////////////
//case 481~500
/// notice: in i2s sc tdm mode, standard only support "dsp mode-a" and "dsp mode-b"
    {SD_AUDIO_TRANSFER_CODEC_SLAVE | SD_AUDIO_DIR_MODE_MULTI_CHAN_TRANSMIT | SD_AUDIO_CHANNEL_NUM_TX_4CHANS, SD_AUDIO_SR_44100, SD_AUDIO_SAMPLE_WIDTH_8BITS, SD_AUDIO_I2S_STANDARD_PHILLIPS},
    {SD_AUDIO_TRANSFER_CODEC_SLAVE | SD_AUDIO_DIR_MODE_MULTI_CHAN_TRANSMIT | SD_AUDIO_CHANNEL_NUM_TX_4CHANS, SD_AUDIO_SR_44100, SD_AUDIO_SAMPLE_WIDTH_8BITS, SD_AUDIO_I2S_LEFT_JUSTIFIED},
    {SD_AUDIO_TRANSFER_CODEC_SLAVE | SD_AUDIO_DIR_MODE_MULTI_CHAN_TRANSMIT | SD_AUDIO_CHANNEL_NUM_TX_4CHANS, SD_AUDIO_SR_44100, SD_AUDIO_SAMPLE_WIDTH_8BITS, SD_AUDIO_I2S_RIGHT_JUSTIFIED},
    {SD_AUDIO_TRANSFER_CODEC_SLAVE | SD_AUDIO_DIR_MODE_MULTI_CHAN_TRANSMIT | SD_AUDIO_CHANNEL_NUM_TX_4CHANS, SD_AUDIO_SR_44100, SD_AUDIO_SAMPLE_WIDTH_8BITS, SD_AUDIO_I2S_DSP_A},
    {SD_AUDIO_TRANSFER_CODEC_SLAVE | SD_AUDIO_DIR_MODE_MULTI_CHAN_TRANSMIT | SD_AUDIO_CHANNEL_NUM_TX_4CHANS, SD_AUDIO_SR_44100, SD_AUDIO_SAMPLE_WIDTH_8BITS, SD_AUDIO_I2S_DSP_B},

    {SD_AUDIO_TRANSFER_CODEC_SLAVE | SD_AUDIO_DIR_MODE_MULTI_CHAN_TRANSMIT | SD_AUDIO_CHANNEL_NUM_TX_4CHANS, SD_AUDIO_SR_44100, SD_AUDIO_SAMPLE_WIDTH_16BITS, SD_AUDIO_I2S_STANDARD_PHILLIPS},
    {SD_AUDIO_TRANSFER_CODEC_SLAVE | SD_AUDIO_DIR_MODE_MULTI_CHAN_TRANSMIT | SD_AUDIO_CHANNEL_NUM_TX_4CHANS, SD_AUDIO_SR_44100, SD_AUDIO_SAMPLE_WIDTH_16BITS, SD_AUDIO_I2S_LEFT_JUSTIFIED},
    {SD_AUDIO_TRANSFER_CODEC_SLAVE | SD_AUDIO_DIR_MODE_MULTI_CHAN_TRANSMIT | SD_AUDIO_CHANNEL_NUM_TX_4CHANS, SD_AUDIO_SR_44100, SD_AUDIO_SAMPLE_WIDTH_16BITS, SD_AUDIO_I2S_RIGHT_JUSTIFIED},
    {SD_AUDIO_TRANSFER_CODEC_SLAVE | SD_AUDIO_DIR_MODE_MULTI_CHAN_TRANSMIT | SD_AUDIO_CHANNEL_NUM_TX_4CHANS, SD_AUDIO_SR_44100, SD_AUDIO_SAMPLE_WIDTH_16BITS, SD_AUDIO_I2S_DSP_A},
    {SD_AUDIO_TRANSFER_CODEC_SLAVE | SD_AUDIO_DIR_MODE_MULTI_CHAN_TRANSMIT | SD_AUDIO_CHANNEL_NUM_TX_4CHANS, SD_AUDIO_SR_44100, SD_AUDIO_SAMPLE_WIDTH_16BITS, SD_AUDIO_I2S_DSP_B},

    {SD_AUDIO_TRANSFER_CODEC_SLAVE | SD_AUDIO_DIR_MODE_MULTI_CHAN_TRANSMIT | SD_AUDIO_CHANNEL_NUM_TX_4CHANS, SD_AUDIO_SR_44100, SD_AUDIO_SAMPLE_WIDTH_24BITS, SD_AUDIO_I2S_STANDARD_PHILLIPS},
    {SD_AUDIO_TRANSFER_CODEC_SLAVE | SD_AUDIO_DIR_MODE_MULTI_CHAN_TRANSMIT | SD_AUDIO_CHANNEL_NUM_TX_4CHANS, SD_AUDIO_SR_44100, SD_AUDIO_SAMPLE_WIDTH_24BITS, SD_AUDIO_I2S_LEFT_JUSTIFIED},
    {SD_AUDIO_TRANSFER_CODEC_SLAVE | SD_AUDIO_DIR_MODE_MULTI_CHAN_TRANSMIT | SD_AUDIO_CHANNEL_NUM_TX_4CHANS, SD_AUDIO_SR_44100, SD_AUDIO_SAMPLE_WIDTH_24BITS, SD_AUDIO_I2S_RIGHT_JUSTIFIED},
    {SD_AUDIO_TRANSFER_CODEC_SLAVE | SD_AUDIO_DIR_MODE_MULTI_CHAN_TRANSMIT | SD_AUDIO_CHANNEL_NUM_TX_4CHANS, SD_AUDIO_SR_44100, SD_AUDIO_SAMPLE_WIDTH_24BITS, SD_AUDIO_I2S_DSP_A},
    {SD_AUDIO_TRANSFER_CODEC_SLAVE | SD_AUDIO_DIR_MODE_MULTI_CHAN_TRANSMIT | SD_AUDIO_CHANNEL_NUM_TX_4CHANS, SD_AUDIO_SR_44100, SD_AUDIO_SAMPLE_WIDTH_24BITS, SD_AUDIO_I2S_DSP_B},

    {SD_AUDIO_TRANSFER_CODEC_SLAVE | SD_AUDIO_DIR_MODE_MULTI_CHAN_TRANSMIT | SD_AUDIO_CHANNEL_NUM_TX_4CHANS, SD_AUDIO_SR_44100, SD_AUDIO_SAMPLE_WIDTH_32BITS, SD_AUDIO_I2S_STANDARD_PHILLIPS},
    {SD_AUDIO_TRANSFER_CODEC_SLAVE | SD_AUDIO_DIR_MODE_MULTI_CHAN_TRANSMIT | SD_AUDIO_CHANNEL_NUM_TX_4CHANS, SD_AUDIO_SR_44100, SD_AUDIO_SAMPLE_WIDTH_32BITS, SD_AUDIO_I2S_LEFT_JUSTIFIED},
    {SD_AUDIO_TRANSFER_CODEC_SLAVE | SD_AUDIO_DIR_MODE_MULTI_CHAN_TRANSMIT | SD_AUDIO_CHANNEL_NUM_TX_4CHANS, SD_AUDIO_SR_44100, SD_AUDIO_SAMPLE_WIDTH_32BITS, SD_AUDIO_I2S_RIGHT_JUSTIFIED},
    {SD_AUDIO_TRANSFER_CODEC_SLAVE | SD_AUDIO_DIR_MODE_MULTI_CHAN_TRANSMIT | SD_AUDIO_CHANNEL_NUM_TX_4CHANS, SD_AUDIO_SR_44100, SD_AUDIO_SAMPLE_WIDTH_32BITS, SD_AUDIO_I2S_DSP_A},
    {SD_AUDIO_TRANSFER_CODEC_SLAVE | SD_AUDIO_DIR_MODE_MULTI_CHAN_TRANSMIT | SD_AUDIO_CHANNEL_NUM_TX_4CHANS, SD_AUDIO_SR_44100, SD_AUDIO_SAMPLE_WIDTH_32BITS, SD_AUDIO_I2S_DSP_B},


////////////////////////////////////////////////////////////////////////////////////////////////////////////////////////////////////////////////////////////////////////////////////////////
//case 501~520
    {SD_AUDIO_TRANSFER_CODEC_SLAVE | SD_AUDIO_DIR_MODE_MULTI_CHAN_TRANSMIT | SD_AUDIO_CHANNEL_NUM_TX_4CHANS, SD_AUDIO_SR_48000, SD_AUDIO_SAMPLE_WIDTH_8BITS, SD_AUDIO_I2S_STANDARD_PHILLIPS},
    {SD_AUDIO_TRANSFER_CODEC_SLAVE | SD_AUDIO_DIR_MODE_MULTI_CHAN_TRANSMIT | SD_AUDIO_CHANNEL_NUM_TX_4CHANS, SD_AUDIO_SR_48000, SD_AUDIO_SAMPLE_WIDTH_8BITS, SD_AUDIO_I2S_LEFT_JUSTIFIED},
    {SD_AUDIO_TRANSFER_CODEC_SLAVE | SD_AUDIO_DIR_MODE_MULTI_CHAN_TRANSMIT | SD_AUDIO_CHANNEL_NUM_TX_4CHANS, SD_AUDIO_SR_48000, SD_AUDIO_SAMPLE_WIDTH_8BITS, SD_AUDIO_I2S_RIGHT_JUSTIFIED},
    {SD_AUDIO_TRANSFER_CODEC_SLAVE | SD_AUDIO_DIR_MODE_MULTI_CHAN_TRANSMIT | SD_AUDIO_CHANNEL_NUM_TX_4CHANS, SD_AUDIO_SR_48000, SD_AUDIO_SAMPLE_WIDTH_8BITS, SD_AUDIO_I2S_DSP_A},
    {SD_AUDIO_TRANSFER_CODEC_SLAVE | SD_AUDIO_DIR_MODE_MULTI_CHAN_TRANSMIT | SD_AUDIO_CHANNEL_NUM_TX_4CHANS, SD_AUDIO_SR_48000, SD_AUDIO_SAMPLE_WIDTH_8BITS, SD_AUDIO_I2S_DSP_B},

    {SD_AUDIO_TRANSFER_CODEC_SLAVE | SD_AUDIO_DIR_MODE_MULTI_CHAN_TRANSMIT | SD_AUDIO_CHANNEL_NUM_TX_4CHANS, SD_AUDIO_SR_48000, SD_AUDIO_SAMPLE_WIDTH_16BITS, SD_AUDIO_I2S_STANDARD_PHILLIPS},
    {SD_AUDIO_TRANSFER_CODEC_SLAVE | SD_AUDIO_DIR_MODE_MULTI_CHAN_TRANSMIT | SD_AUDIO_CHANNEL_NUM_TX_4CHANS, SD_AUDIO_SR_48000, SD_AUDIO_SAMPLE_WIDTH_16BITS, SD_AUDIO_I2S_LEFT_JUSTIFIED},
    {SD_AUDIO_TRANSFER_CODEC_SLAVE | SD_AUDIO_DIR_MODE_MULTI_CHAN_TRANSMIT | SD_AUDIO_CHANNEL_NUM_TX_4CHANS, SD_AUDIO_SR_48000, SD_AUDIO_SAMPLE_WIDTH_16BITS, SD_AUDIO_I2S_RIGHT_JUSTIFIED},
    {SD_AUDIO_TRANSFER_CODEC_SLAVE | SD_AUDIO_DIR_MODE_MULTI_CHAN_TRANSMIT | SD_AUDIO_CHANNEL_NUM_TX_4CHANS, SD_AUDIO_SR_48000, SD_AUDIO_SAMPLE_WIDTH_16BITS, SD_AUDIO_I2S_DSP_A},
    {SD_AUDIO_TRANSFER_CODEC_SLAVE | SD_AUDIO_DIR_MODE_MULTI_CHAN_TRANSMIT | SD_AUDIO_CHANNEL_NUM_TX_4CHANS, SD_AUDIO_SR_48000, SD_AUDIO_SAMPLE_WIDTH_16BITS, SD_AUDIO_I2S_DSP_B},

    {SD_AUDIO_TRANSFER_CODEC_SLAVE | SD_AUDIO_DIR_MODE_MULTI_CHAN_TRANSMIT | SD_AUDIO_CHANNEL_NUM_TX_4CHANS, SD_AUDIO_SR_48000, SD_AUDIO_SAMPLE_WIDTH_24BITS, SD_AUDIO_I2S_STANDARD_PHILLIPS},
    {SD_AUDIO_TRANSFER_CODEC_SLAVE | SD_AUDIO_DIR_MODE_MULTI_CHAN_TRANSMIT | SD_AUDIO_CHANNEL_NUM_TX_4CHANS, SD_AUDIO_SR_48000, SD_AUDIO_SAMPLE_WIDTH_24BITS, SD_AUDIO_I2S_LEFT_JUSTIFIED},
    {SD_AUDIO_TRANSFER_CODEC_SLAVE | SD_AUDIO_DIR_MODE_MULTI_CHAN_TRANSMIT | SD_AUDIO_CHANNEL_NUM_TX_4CHANS, SD_AUDIO_SR_48000, SD_AUDIO_SAMPLE_WIDTH_24BITS, SD_AUDIO_I2S_RIGHT_JUSTIFIED},
    {SD_AUDIO_TRANSFER_CODEC_SLAVE | SD_AUDIO_DIR_MODE_MULTI_CHAN_TRANSMIT | SD_AUDIO_CHANNEL_NUM_TX_4CHANS, SD_AUDIO_SR_48000, SD_AUDIO_SAMPLE_WIDTH_24BITS, SD_AUDIO_I2S_DSP_A},
    {SD_AUDIO_TRANSFER_CODEC_SLAVE | SD_AUDIO_DIR_MODE_MULTI_CHAN_TRANSMIT | SD_AUDIO_CHANNEL_NUM_TX_4CHANS, SD_AUDIO_SR_48000, SD_AUDIO_SAMPLE_WIDTH_24BITS, SD_AUDIO_I2S_DSP_B},

    {SD_AUDIO_TRANSFER_CODEC_SLAVE | SD_AUDIO_DIR_MODE_MULTI_CHAN_TRANSMIT | SD_AUDIO_CHANNEL_NUM_TX_4CHANS, SD_AUDIO_SR_48000, SD_AUDIO_SAMPLE_WIDTH_32BITS, SD_AUDIO_I2S_STANDARD_PHILLIPS},
    {SD_AUDIO_TRANSFER_CODEC_SLAVE | SD_AUDIO_DIR_MODE_MULTI_CHAN_TRANSMIT | SD_AUDIO_CHANNEL_NUM_TX_4CHANS, SD_AUDIO_SR_48000, SD_AUDIO_SAMPLE_WIDTH_32BITS, SD_AUDIO_I2S_LEFT_JUSTIFIED},
    {SD_AUDIO_TRANSFER_CODEC_SLAVE | SD_AUDIO_DIR_MODE_MULTI_CHAN_TRANSMIT | SD_AUDIO_CHANNEL_NUM_TX_4CHANS, SD_AUDIO_SR_48000, SD_AUDIO_SAMPLE_WIDTH_32BITS, SD_AUDIO_I2S_RIGHT_JUSTIFIED},
    {SD_AUDIO_TRANSFER_CODEC_SLAVE | SD_AUDIO_DIR_MODE_MULTI_CHAN_TRANSMIT | SD_AUDIO_CHANNEL_NUM_TX_4CHANS, SD_AUDIO_SR_48000, SD_AUDIO_SAMPLE_WIDTH_32BITS, SD_AUDIO_I2S_DSP_A},
    {SD_AUDIO_TRANSFER_CODEC_SLAVE | SD_AUDIO_DIR_MODE_MULTI_CHAN_TRANSMIT | SD_AUDIO_CHANNEL_NUM_TX_4CHANS, SD_AUDIO_SR_48000, SD_AUDIO_SAMPLE_WIDTH_32BITS, SD_AUDIO_I2S_DSP_B},


////////////////////////////////////////////////////////////////////////////////////////////////////////////////////////////////////////////////////////////////////////////////////////////
//case 521~540
    {SD_AUDIO_TRANSFER_CODEC_SLAVE | SD_AUDIO_DIR_MODE_MULTI_CHAN_TRANSMIT | SD_AUDIO_CHANNEL_NUM_TX_4CHANS, SD_AUDIO_SR_96000, SD_AUDIO_SAMPLE_WIDTH_8BITS, SD_AUDIO_I2S_STANDARD_PHILLIPS},
    {SD_AUDIO_TRANSFER_CODEC_SLAVE | SD_AUDIO_DIR_MODE_MULTI_CHAN_TRANSMIT | SD_AUDIO_CHANNEL_NUM_TX_4CHANS, SD_AUDIO_SR_96000, SD_AUDIO_SAMPLE_WIDTH_8BITS, SD_AUDIO_I2S_LEFT_JUSTIFIED},
    {SD_AUDIO_TRANSFER_CODEC_SLAVE | SD_AUDIO_DIR_MODE_MULTI_CHAN_TRANSMIT | SD_AUDIO_CHANNEL_NUM_TX_4CHANS, SD_AUDIO_SR_96000, SD_AUDIO_SAMPLE_WIDTH_8BITS, SD_AUDIO_I2S_RIGHT_JUSTIFIED},
    {SD_AUDIO_TRANSFER_CODEC_SLAVE | SD_AUDIO_DIR_MODE_MULTI_CHAN_TRANSMIT | SD_AUDIO_CHANNEL_NUM_TX_4CHANS, SD_AUDIO_SR_96000, SD_AUDIO_SAMPLE_WIDTH_8BITS, SD_AUDIO_I2S_DSP_A},
    {SD_AUDIO_TRANSFER_CODEC_SLAVE | SD_AUDIO_DIR_MODE_MULTI_CHAN_TRANSMIT | SD_AUDIO_CHANNEL_NUM_TX_4CHANS, SD_AUDIO_SR_96000, SD_AUDIO_SAMPLE_WIDTH_8BITS, SD_AUDIO_I2S_DSP_B},

    {SD_AUDIO_TRANSFER_CODEC_SLAVE | SD_AUDIO_DIR_MODE_MULTI_CHAN_TRANSMIT | SD_AUDIO_CHANNEL_NUM_TX_4CHANS, SD_AUDIO_SR_96000, SD_AUDIO_SAMPLE_WIDTH_16BITS, SD_AUDIO_I2S_STANDARD_PHILLIPS},
    {SD_AUDIO_TRANSFER_CODEC_SLAVE | SD_AUDIO_DIR_MODE_MULTI_CHAN_TRANSMIT | SD_AUDIO_CHANNEL_NUM_TX_4CHANS, SD_AUDIO_SR_96000, SD_AUDIO_SAMPLE_WIDTH_16BITS, SD_AUDIO_I2S_LEFT_JUSTIFIED},
    {SD_AUDIO_TRANSFER_CODEC_SLAVE | SD_AUDIO_DIR_MODE_MULTI_CHAN_TRANSMIT | SD_AUDIO_CHANNEL_NUM_TX_4CHANS, SD_AUDIO_SR_96000, SD_AUDIO_SAMPLE_WIDTH_16BITS, SD_AUDIO_I2S_RIGHT_JUSTIFIED},
    {SD_AUDIO_TRANSFER_CODEC_SLAVE | SD_AUDIO_DIR_MODE_MULTI_CHAN_TRANSMIT | SD_AUDIO_CHANNEL_NUM_TX_4CHANS, SD_AUDIO_SR_96000, SD_AUDIO_SAMPLE_WIDTH_16BITS, SD_AUDIO_I2S_DSP_A},
    {SD_AUDIO_TRANSFER_CODEC_SLAVE | SD_AUDIO_DIR_MODE_MULTI_CHAN_TRANSMIT | SD_AUDIO_CHANNEL_NUM_TX_4CHANS, SD_AUDIO_SR_96000, SD_AUDIO_SAMPLE_WIDTH_16BITS, SD_AUDIO_I2S_DSP_B},

    {SD_AUDIO_TRANSFER_CODEC_SLAVE | SD_AUDIO_DIR_MODE_MULTI_CHAN_TRANSMIT | SD_AUDIO_CHANNEL_NUM_TX_4CHANS, SD_AUDIO_SR_96000, SD_AUDIO_SAMPLE_WIDTH_24BITS, SD_AUDIO_I2S_STANDARD_PHILLIPS},
    {SD_AUDIO_TRANSFER_CODEC_SLAVE | SD_AUDIO_DIR_MODE_MULTI_CHAN_TRANSMIT | SD_AUDIO_CHANNEL_NUM_TX_4CHANS, SD_AUDIO_SR_96000, SD_AUDIO_SAMPLE_WIDTH_24BITS, SD_AUDIO_I2S_LEFT_JUSTIFIED},
    {SD_AUDIO_TRANSFER_CODEC_SLAVE | SD_AUDIO_DIR_MODE_MULTI_CHAN_TRANSMIT | SD_AUDIO_CHANNEL_NUM_TX_4CHANS, SD_AUDIO_SR_96000, SD_AUDIO_SAMPLE_WIDTH_24BITS, SD_AUDIO_I2S_RIGHT_JUSTIFIED},
    {SD_AUDIO_TRANSFER_CODEC_SLAVE | SD_AUDIO_DIR_MODE_MULTI_CHAN_TRANSMIT | SD_AUDIO_CHANNEL_NUM_TX_4CHANS, SD_AUDIO_SR_96000, SD_AUDIO_SAMPLE_WIDTH_24BITS, SD_AUDIO_I2S_DSP_A},
    {SD_AUDIO_TRANSFER_CODEC_SLAVE | SD_AUDIO_DIR_MODE_MULTI_CHAN_TRANSMIT | SD_AUDIO_CHANNEL_NUM_TX_4CHANS, SD_AUDIO_SR_96000, SD_AUDIO_SAMPLE_WIDTH_24BITS, SD_AUDIO_I2S_DSP_B},

    {SD_AUDIO_TRANSFER_CODEC_SLAVE | SD_AUDIO_DIR_MODE_MULTI_CHAN_TRANSMIT | SD_AUDIO_CHANNEL_NUM_TX_4CHANS, SD_AUDIO_SR_96000, SD_AUDIO_SAMPLE_WIDTH_32BITS, SD_AUDIO_I2S_STANDARD_PHILLIPS},
    {SD_AUDIO_TRANSFER_CODEC_SLAVE | SD_AUDIO_DIR_MODE_MULTI_CHAN_TRANSMIT | SD_AUDIO_CHANNEL_NUM_TX_4CHANS, SD_AUDIO_SR_96000, SD_AUDIO_SAMPLE_WIDTH_32BITS, SD_AUDIO_I2S_LEFT_JUSTIFIED},
    {SD_AUDIO_TRANSFER_CODEC_SLAVE | SD_AUDIO_DIR_MODE_MULTI_CHAN_TRANSMIT | SD_AUDIO_CHANNEL_NUM_TX_4CHANS, SD_AUDIO_SR_96000, SD_AUDIO_SAMPLE_WIDTH_32BITS, SD_AUDIO_I2S_RIGHT_JUSTIFIED},
    {SD_AUDIO_TRANSFER_CODEC_SLAVE | SD_AUDIO_DIR_MODE_MULTI_CHAN_TRANSMIT | SD_AUDIO_CHANNEL_NUM_TX_4CHANS, SD_AUDIO_SR_96000, SD_AUDIO_SAMPLE_WIDTH_32BITS, SD_AUDIO_I2S_DSP_A},
    {SD_AUDIO_TRANSFER_CODEC_SLAVE | SD_AUDIO_DIR_MODE_MULTI_CHAN_TRANSMIT | SD_AUDIO_CHANNEL_NUM_TX_4CHANS, SD_AUDIO_SR_96000, SD_AUDIO_SAMPLE_WIDTH_32BITS, SD_AUDIO_I2S_DSP_B},


////////////////////////////////////////////////////////////////////////////////////////////////////////////////////////////////////////////////////////////////////////////////////////////
//case 541~560
    {SD_AUDIO_TRANSFER_CODEC_SLAVE | SD_AUDIO_DIR_MODE_MULTI_CHAN_TRANSMIT | SD_AUDIO_CHANNEL_NUM_TX_4CHANS, SD_AUDIO_SR_192000, SD_AUDIO_SAMPLE_WIDTH_8BITS, SD_AUDIO_I2S_STANDARD_PHILLIPS},
    {SD_AUDIO_TRANSFER_CODEC_SLAVE | SD_AUDIO_DIR_MODE_MULTI_CHAN_TRANSMIT | SD_AUDIO_CHANNEL_NUM_TX_4CHANS, SD_AUDIO_SR_192000, SD_AUDIO_SAMPLE_WIDTH_8BITS, SD_AUDIO_I2S_LEFT_JUSTIFIED},
    {SD_AUDIO_TRANSFER_CODEC_SLAVE | SD_AUDIO_DIR_MODE_MULTI_CHAN_TRANSMIT | SD_AUDIO_CHANNEL_NUM_TX_4CHANS, SD_AUDIO_SR_192000, SD_AUDIO_SAMPLE_WIDTH_8BITS, SD_AUDIO_I2S_RIGHT_JUSTIFIED},
    {SD_AUDIO_TRANSFER_CODEC_SLAVE | SD_AUDIO_DIR_MODE_MULTI_CHAN_TRANSMIT | SD_AUDIO_CHANNEL_NUM_TX_4CHANS, SD_AUDIO_SR_192000, SD_AUDIO_SAMPLE_WIDTH_8BITS, SD_AUDIO_I2S_DSP_A},
    {SD_AUDIO_TRANSFER_CODEC_SLAVE | SD_AUDIO_DIR_MODE_MULTI_CHAN_TRANSMIT | SD_AUDIO_CHANNEL_NUM_TX_4CHANS, SD_AUDIO_SR_192000, SD_AUDIO_SAMPLE_WIDTH_8BITS, SD_AUDIO_I2S_DSP_B},

    {SD_AUDIO_TRANSFER_CODEC_SLAVE | SD_AUDIO_DIR_MODE_MULTI_CHAN_TRANSMIT | SD_AUDIO_CHANNEL_NUM_TX_4CHANS, SD_AUDIO_SR_192000, SD_AUDIO_SAMPLE_WIDTH_16BITS, SD_AUDIO_I2S_STANDARD_PHILLIPS},
    {SD_AUDIO_TRANSFER_CODEC_SLAVE | SD_AUDIO_DIR_MODE_MULTI_CHAN_TRANSMIT | SD_AUDIO_CHANNEL_NUM_TX_4CHANS, SD_AUDIO_SR_192000, SD_AUDIO_SAMPLE_WIDTH_16BITS, SD_AUDIO_I2S_LEFT_JUSTIFIED},
    {SD_AUDIO_TRANSFER_CODEC_SLAVE | SD_AUDIO_DIR_MODE_MULTI_CHAN_TRANSMIT | SD_AUDIO_CHANNEL_NUM_TX_4CHANS, SD_AUDIO_SR_192000, SD_AUDIO_SAMPLE_WIDTH_16BITS, SD_AUDIO_I2S_RIGHT_JUSTIFIED},
    {SD_AUDIO_TRANSFER_CODEC_SLAVE | SD_AUDIO_DIR_MODE_MULTI_CHAN_TRANSMIT | SD_AUDIO_CHANNEL_NUM_TX_4CHANS, SD_AUDIO_SR_192000, SD_AUDIO_SAMPLE_WIDTH_16BITS, SD_AUDIO_I2S_DSP_A},
    {SD_AUDIO_TRANSFER_CODEC_SLAVE | SD_AUDIO_DIR_MODE_MULTI_CHAN_TRANSMIT | SD_AUDIO_CHANNEL_NUM_TX_4CHANS, SD_AUDIO_SR_192000, SD_AUDIO_SAMPLE_WIDTH_16BITS, SD_AUDIO_I2S_DSP_B},

    {SD_AUDIO_TRANSFER_CODEC_SLAVE | SD_AUDIO_DIR_MODE_MULTI_CHAN_TRANSMIT | SD_AUDIO_CHANNEL_NUM_TX_4CHANS, SD_AUDIO_SR_192000, SD_AUDIO_SAMPLE_WIDTH_24BITS, SD_AUDIO_I2S_STANDARD_PHILLIPS},
    {SD_AUDIO_TRANSFER_CODEC_SLAVE | SD_AUDIO_DIR_MODE_MULTI_CHAN_TRANSMIT | SD_AUDIO_CHANNEL_NUM_TX_4CHANS, SD_AUDIO_SR_192000, SD_AUDIO_SAMPLE_WIDTH_24BITS, SD_AUDIO_I2S_LEFT_JUSTIFIED},
    {SD_AUDIO_TRANSFER_CODEC_SLAVE | SD_AUDIO_DIR_MODE_MULTI_CHAN_TRANSMIT | SD_AUDIO_CHANNEL_NUM_TX_4CHANS, SD_AUDIO_SR_192000, SD_AUDIO_SAMPLE_WIDTH_24BITS, SD_AUDIO_I2S_RIGHT_JUSTIFIED},
    {SD_AUDIO_TRANSFER_CODEC_SLAVE | SD_AUDIO_DIR_MODE_MULTI_CHAN_TRANSMIT | SD_AUDIO_CHANNEL_NUM_TX_4CHANS, SD_AUDIO_SR_192000, SD_AUDIO_SAMPLE_WIDTH_24BITS, SD_AUDIO_I2S_DSP_A},
    {SD_AUDIO_TRANSFER_CODEC_SLAVE | SD_AUDIO_DIR_MODE_MULTI_CHAN_TRANSMIT | SD_AUDIO_CHANNEL_NUM_TX_4CHANS, SD_AUDIO_SR_192000, SD_AUDIO_SAMPLE_WIDTH_24BITS, SD_AUDIO_I2S_DSP_B},

    {SD_AUDIO_TRANSFER_CODEC_SLAVE | SD_AUDIO_DIR_MODE_MULTI_CHAN_TRANSMIT | SD_AUDIO_CHANNEL_NUM_TX_4CHANS, SD_AUDIO_SR_192000, SD_AUDIO_SAMPLE_WIDTH_32BITS, SD_AUDIO_I2S_STANDARD_PHILLIPS},
    {SD_AUDIO_TRANSFER_CODEC_SLAVE | SD_AUDIO_DIR_MODE_MULTI_CHAN_TRANSMIT | SD_AUDIO_CHANNEL_NUM_TX_4CHANS, SD_AUDIO_SR_192000, SD_AUDIO_SAMPLE_WIDTH_32BITS, SD_AUDIO_I2S_LEFT_JUSTIFIED},
    {SD_AUDIO_TRANSFER_CODEC_SLAVE | SD_AUDIO_DIR_MODE_MULTI_CHAN_TRANSMIT | SD_AUDIO_CHANNEL_NUM_TX_4CHANS, SD_AUDIO_SR_192000, SD_AUDIO_SAMPLE_WIDTH_32BITS, SD_AUDIO_I2S_RIGHT_JUSTIFIED},
    {SD_AUDIO_TRANSFER_CODEC_SLAVE | SD_AUDIO_DIR_MODE_MULTI_CHAN_TRANSMIT | SD_AUDIO_CHANNEL_NUM_TX_4CHANS, SD_AUDIO_SR_192000, SD_AUDIO_SAMPLE_WIDTH_32BITS, SD_AUDIO_I2S_DSP_A},
    {SD_AUDIO_TRANSFER_CODEC_SLAVE | SD_AUDIO_DIR_MODE_MULTI_CHAN_TRANSMIT | SD_AUDIO_CHANNEL_NUM_TX_4CHANS, SD_AUDIO_SR_192000, SD_AUDIO_SAMPLE_WIDTH_32BITS, SD_AUDIO_I2S_DSP_B},



/////////////////////////////////////////////////////////////////////////////////mode 8///////////////////////////////////////////////////////////////////////////////////////////////////

//case 561~580
    {SD_AUDIO_TRANSFER_CODEC_SLAVE | SD_AUDIO_DIR_MODE_MULTI_CHAN_TRANSMIT | SD_AUDIO_CHANNEL_NUM_TX_8CHANS, SD_AUDIO_SR_44100, SD_AUDIO_SAMPLE_WIDTH_8BITS, SD_AUDIO_I2S_STANDARD_PHILLIPS},
    {SD_AUDIO_TRANSFER_CODEC_SLAVE | SD_AUDIO_DIR_MODE_MULTI_CHAN_TRANSMIT | SD_AUDIO_CHANNEL_NUM_TX_8CHANS, SD_AUDIO_SR_44100, SD_AUDIO_SAMPLE_WIDTH_8BITS, SD_AUDIO_I2S_LEFT_JUSTIFIED},
    {SD_AUDIO_TRANSFER_CODEC_SLAVE | SD_AUDIO_DIR_MODE_MULTI_CHAN_TRANSMIT | SD_AUDIO_CHANNEL_NUM_TX_8CHANS, SD_AUDIO_SR_44100, SD_AUDIO_SAMPLE_WIDTH_8BITS, SD_AUDIO_I2S_RIGHT_JUSTIFIED},
    {SD_AUDIO_TRANSFER_CODEC_SLAVE | SD_AUDIO_DIR_MODE_MULTI_CHAN_TRANSMIT | SD_AUDIO_CHANNEL_NUM_TX_8CHANS, SD_AUDIO_SR_44100, SD_AUDIO_SAMPLE_WIDTH_8BITS, SD_AUDIO_I2S_DSP_A},
    {SD_AUDIO_TRANSFER_CODEC_SLAVE | SD_AUDIO_DIR_MODE_MULTI_CHAN_TRANSMIT | SD_AUDIO_CHANNEL_NUM_TX_8CHANS, SD_AUDIO_SR_44100, SD_AUDIO_SAMPLE_WIDTH_8BITS, SD_AUDIO_I2S_DSP_B},

    {SD_AUDIO_TRANSFER_CODEC_SLAVE | SD_AUDIO_DIR_MODE_MULTI_CHAN_TRANSMIT | SD_AUDIO_CHANNEL_NUM_TX_8CHANS, SD_AUDIO_SR_44100, SD_AUDIO_SAMPLE_WIDTH_16BITS, SD_AUDIO_I2S_STANDARD_PHILLIPS},
    {SD_AUDIO_TRANSFER_CODEC_SLAVE | SD_AUDIO_DIR_MODE_MULTI_CHAN_TRANSMIT | SD_AUDIO_CHANNEL_NUM_TX_8CHANS, SD_AUDIO_SR_44100, SD_AUDIO_SAMPLE_WIDTH_16BITS, SD_AUDIO_I2S_LEFT_JUSTIFIED},
    {SD_AUDIO_TRANSFER_CODEC_SLAVE | SD_AUDIO_DIR_MODE_MULTI_CHAN_TRANSMIT | SD_AUDIO_CHANNEL_NUM_TX_8CHANS, SD_AUDIO_SR_44100, SD_AUDIO_SAMPLE_WIDTH_16BITS, SD_AUDIO_I2S_RIGHT_JUSTIFIED},
    {SD_AUDIO_TRANSFER_CODEC_SLAVE | SD_AUDIO_DIR_MODE_MULTI_CHAN_TRANSMIT | SD_AUDIO_CHANNEL_NUM_TX_8CHANS, SD_AUDIO_SR_44100, SD_AUDIO_SAMPLE_WIDTH_16BITS, SD_AUDIO_I2S_DSP_A},
    {SD_AUDIO_TRANSFER_CODEC_SLAVE | SD_AUDIO_DIR_MODE_MULTI_CHAN_TRANSMIT | SD_AUDIO_CHANNEL_NUM_TX_8CHANS, SD_AUDIO_SR_44100, SD_AUDIO_SAMPLE_WIDTH_16BITS, SD_AUDIO_I2S_DSP_B},

    {SD_AUDIO_TRANSFER_CODEC_SLAVE | SD_AUDIO_DIR_MODE_MULTI_CHAN_TRANSMIT | SD_AUDIO_CHANNEL_NUM_TX_8CHANS, SD_AUDIO_SR_44100, SD_AUDIO_SAMPLE_WIDTH_24BITS, SD_AUDIO_I2S_STANDARD_PHILLIPS},
    {SD_AUDIO_TRANSFER_CODEC_SLAVE | SD_AUDIO_DIR_MODE_MULTI_CHAN_TRANSMIT | SD_AUDIO_CHANNEL_NUM_TX_8CHANS, SD_AUDIO_SR_44100, SD_AUDIO_SAMPLE_WIDTH_24BITS, SD_AUDIO_I2S_LEFT_JUSTIFIED},
    {SD_AUDIO_TRANSFER_CODEC_SLAVE | SD_AUDIO_DIR_MODE_MULTI_CHAN_TRANSMIT | SD_AUDIO_CHANNEL_NUM_TX_8CHANS, SD_AUDIO_SR_44100, SD_AUDIO_SAMPLE_WIDTH_24BITS, SD_AUDIO_I2S_RIGHT_JUSTIFIED},
    {SD_AUDIO_TRANSFER_CODEC_SLAVE | SD_AUDIO_DIR_MODE_MULTI_CHAN_TRANSMIT | SD_AUDIO_CHANNEL_NUM_TX_8CHANS, SD_AUDIO_SR_44100, SD_AUDIO_SAMPLE_WIDTH_24BITS, SD_AUDIO_I2S_DSP_A},
    {SD_AUDIO_TRANSFER_CODEC_SLAVE | SD_AUDIO_DIR_MODE_MULTI_CHAN_TRANSMIT | SD_AUDIO_CHANNEL_NUM_TX_8CHANS, SD_AUDIO_SR_44100, SD_AUDIO_SAMPLE_WIDTH_24BITS, SD_AUDIO_I2S_DSP_B},

    {SD_AUDIO_TRANSFER_CODEC_SLAVE | SD_AUDIO_DIR_MODE_MULTI_CHAN_TRANSMIT | SD_AUDIO_CHANNEL_NUM_TX_8CHANS, SD_AUDIO_SR_44100, SD_AUDIO_SAMPLE_WIDTH_32BITS, SD_AUDIO_I2S_STANDARD_PHILLIPS},
    {SD_AUDIO_TRANSFER_CODEC_SLAVE | SD_AUDIO_DIR_MODE_MULTI_CHAN_TRANSMIT | SD_AUDIO_CHANNEL_NUM_TX_8CHANS, SD_AUDIO_SR_44100, SD_AUDIO_SAMPLE_WIDTH_32BITS, SD_AUDIO_I2S_LEFT_JUSTIFIED},
    {SD_AUDIO_TRANSFER_CODEC_SLAVE | SD_AUDIO_DIR_MODE_MULTI_CHAN_TRANSMIT | SD_AUDIO_CHANNEL_NUM_TX_8CHANS, SD_AUDIO_SR_44100, SD_AUDIO_SAMPLE_WIDTH_32BITS, SD_AUDIO_I2S_RIGHT_JUSTIFIED},
    {SD_AUDIO_TRANSFER_CODEC_SLAVE | SD_AUDIO_DIR_MODE_MULTI_CHAN_TRANSMIT | SD_AUDIO_CHANNEL_NUM_TX_8CHANS, SD_AUDIO_SR_44100, SD_AUDIO_SAMPLE_WIDTH_32BITS, SD_AUDIO_I2S_DSP_A},
    {SD_AUDIO_TRANSFER_CODEC_SLAVE | SD_AUDIO_DIR_MODE_MULTI_CHAN_TRANSMIT | SD_AUDIO_CHANNEL_NUM_TX_8CHANS, SD_AUDIO_SR_44100, SD_AUDIO_SAMPLE_WIDTH_32BITS, SD_AUDIO_I2S_DSP_B},


////////////////////////////////////////////////////////////////////////////////////////////////////////////////////////////////////////////////////////////////////////////////////////////
//case 581~600
    {SD_AUDIO_TRANSFER_CODEC_SLAVE | SD_AUDIO_DIR_MODE_MULTI_CHAN_TRANSMIT | SD_AUDIO_CHANNEL_NUM_TX_8CHANS, SD_AUDIO_SR_48000, SD_AUDIO_SAMPLE_WIDTH_8BITS, SD_AUDIO_I2S_STANDARD_PHILLIPS},
    {SD_AUDIO_TRANSFER_CODEC_SLAVE | SD_AUDIO_DIR_MODE_MULTI_CHAN_TRANSMIT | SD_AUDIO_CHANNEL_NUM_TX_8CHANS, SD_AUDIO_SR_48000, SD_AUDIO_SAMPLE_WIDTH_8BITS, SD_AUDIO_I2S_LEFT_JUSTIFIED},
    {SD_AUDIO_TRANSFER_CODEC_SLAVE | SD_AUDIO_DIR_MODE_MULTI_CHAN_TRANSMIT | SD_AUDIO_CHANNEL_NUM_TX_8CHANS, SD_AUDIO_SR_48000, SD_AUDIO_SAMPLE_WIDTH_8BITS, SD_AUDIO_I2S_RIGHT_JUSTIFIED},
    {SD_AUDIO_TRANSFER_CODEC_SLAVE | SD_AUDIO_DIR_MODE_MULTI_CHAN_TRANSMIT | SD_AUDIO_CHANNEL_NUM_TX_8CHANS, SD_AUDIO_SR_48000, SD_AUDIO_SAMPLE_WIDTH_8BITS, SD_AUDIO_I2S_DSP_A},
    {SD_AUDIO_TRANSFER_CODEC_SLAVE | SD_AUDIO_DIR_MODE_MULTI_CHAN_TRANSMIT | SD_AUDIO_CHANNEL_NUM_TX_8CHANS, SD_AUDIO_SR_48000, SD_AUDIO_SAMPLE_WIDTH_8BITS, SD_AUDIO_I2S_DSP_B},

    {SD_AUDIO_TRANSFER_CODEC_SLAVE | SD_AUDIO_DIR_MODE_MULTI_CHAN_TRANSMIT | SD_AUDIO_CHANNEL_NUM_TX_8CHANS, SD_AUDIO_SR_48000, SD_AUDIO_SAMPLE_WIDTH_16BITS, SD_AUDIO_I2S_STANDARD_PHILLIPS},
    {SD_AUDIO_TRANSFER_CODEC_SLAVE | SD_AUDIO_DIR_MODE_MULTI_CHAN_TRANSMIT | SD_AUDIO_CHANNEL_NUM_TX_8CHANS, SD_AUDIO_SR_48000, SD_AUDIO_SAMPLE_WIDTH_16BITS, SD_AUDIO_I2S_LEFT_JUSTIFIED},
    {SD_AUDIO_TRANSFER_CODEC_SLAVE | SD_AUDIO_DIR_MODE_MULTI_CHAN_TRANSMIT | SD_AUDIO_CHANNEL_NUM_TX_8CHANS, SD_AUDIO_SR_48000, SD_AUDIO_SAMPLE_WIDTH_16BITS, SD_AUDIO_I2S_RIGHT_JUSTIFIED},
    {SD_AUDIO_TRANSFER_CODEC_SLAVE | SD_AUDIO_DIR_MODE_MULTI_CHAN_TRANSMIT | SD_AUDIO_CHANNEL_NUM_TX_8CHANS, SD_AUDIO_SR_48000, SD_AUDIO_SAMPLE_WIDTH_16BITS, SD_AUDIO_I2S_DSP_A},
    {SD_AUDIO_TRANSFER_CODEC_SLAVE | SD_AUDIO_DIR_MODE_MULTI_CHAN_TRANSMIT | SD_AUDIO_CHANNEL_NUM_TX_8CHANS, SD_AUDIO_SR_48000, SD_AUDIO_SAMPLE_WIDTH_16BITS, SD_AUDIO_I2S_DSP_B},

    {SD_AUDIO_TRANSFER_CODEC_SLAVE | SD_AUDIO_DIR_MODE_MULTI_CHAN_TRANSMIT | SD_AUDIO_CHANNEL_NUM_TX_8CHANS, SD_AUDIO_SR_48000, SD_AUDIO_SAMPLE_WIDTH_24BITS, SD_AUDIO_I2S_STANDARD_PHILLIPS},
    {SD_AUDIO_TRANSFER_CODEC_SLAVE | SD_AUDIO_DIR_MODE_MULTI_CHAN_TRANSMIT | SD_AUDIO_CHANNEL_NUM_TX_8CHANS, SD_AUDIO_SR_48000, SD_AUDIO_SAMPLE_WIDTH_24BITS, SD_AUDIO_I2S_LEFT_JUSTIFIED},
    {SD_AUDIO_TRANSFER_CODEC_SLAVE | SD_AUDIO_DIR_MODE_MULTI_CHAN_TRANSMIT | SD_AUDIO_CHANNEL_NUM_TX_8CHANS, SD_AUDIO_SR_48000, SD_AUDIO_SAMPLE_WIDTH_24BITS, SD_AUDIO_I2S_RIGHT_JUSTIFIED},
    {SD_AUDIO_TRANSFER_CODEC_SLAVE | SD_AUDIO_DIR_MODE_MULTI_CHAN_TRANSMIT | SD_AUDIO_CHANNEL_NUM_TX_8CHANS, SD_AUDIO_SR_48000, SD_AUDIO_SAMPLE_WIDTH_24BITS, SD_AUDIO_I2S_DSP_A},
    {SD_AUDIO_TRANSFER_CODEC_SLAVE | SD_AUDIO_DIR_MODE_MULTI_CHAN_TRANSMIT | SD_AUDIO_CHANNEL_NUM_TX_8CHANS, SD_AUDIO_SR_48000, SD_AUDIO_SAMPLE_WIDTH_24BITS, SD_AUDIO_I2S_DSP_B},

    {SD_AUDIO_TRANSFER_CODEC_SLAVE | SD_AUDIO_DIR_MODE_MULTI_CHAN_TRANSMIT | SD_AUDIO_CHANNEL_NUM_TX_8CHANS, SD_AUDIO_SR_48000, SD_AUDIO_SAMPLE_WIDTH_32BITS, SD_AUDIO_I2S_STANDARD_PHILLIPS},
    {SD_AUDIO_TRANSFER_CODEC_SLAVE | SD_AUDIO_DIR_MODE_MULTI_CHAN_TRANSMIT | SD_AUDIO_CHANNEL_NUM_TX_8CHANS, SD_AUDIO_SR_48000, SD_AUDIO_SAMPLE_WIDTH_32BITS, SD_AUDIO_I2S_LEFT_JUSTIFIED},
    {SD_AUDIO_TRANSFER_CODEC_SLAVE | SD_AUDIO_DIR_MODE_MULTI_CHAN_TRANSMIT | SD_AUDIO_CHANNEL_NUM_TX_8CHANS, SD_AUDIO_SR_48000, SD_AUDIO_SAMPLE_WIDTH_32BITS, SD_AUDIO_I2S_RIGHT_JUSTIFIED},
    {SD_AUDIO_TRANSFER_CODEC_SLAVE | SD_AUDIO_DIR_MODE_MULTI_CHAN_TRANSMIT | SD_AUDIO_CHANNEL_NUM_TX_8CHANS, SD_AUDIO_SR_48000, SD_AUDIO_SAMPLE_WIDTH_32BITS, SD_AUDIO_I2S_DSP_A},
    {SD_AUDIO_TRANSFER_CODEC_SLAVE | SD_AUDIO_DIR_MODE_MULTI_CHAN_TRANSMIT | SD_AUDIO_CHANNEL_NUM_TX_8CHANS, SD_AUDIO_SR_48000, SD_AUDIO_SAMPLE_WIDTH_32BITS, SD_AUDIO_I2S_DSP_B},


////////////////////////////////////////////////////////////////////////////////////////////////////////////////////////////////////////////////////////////////////////////////////////////
//case 601~620
    {SD_AUDIO_TRANSFER_CODEC_SLAVE | SD_AUDIO_DIR_MODE_MULTI_CHAN_TRANSMIT | SD_AUDIO_CHANNEL_NUM_TX_8CHANS, SD_AUDIO_SR_96000, SD_AUDIO_SAMPLE_WIDTH_8BITS, SD_AUDIO_I2S_STANDARD_PHILLIPS},
    {SD_AUDIO_TRANSFER_CODEC_SLAVE | SD_AUDIO_DIR_MODE_MULTI_CHAN_TRANSMIT | SD_AUDIO_CHANNEL_NUM_TX_8CHANS, SD_AUDIO_SR_96000, SD_AUDIO_SAMPLE_WIDTH_8BITS, SD_AUDIO_I2S_LEFT_JUSTIFIED},
    {SD_AUDIO_TRANSFER_CODEC_SLAVE | SD_AUDIO_DIR_MODE_MULTI_CHAN_TRANSMIT | SD_AUDIO_CHANNEL_NUM_TX_8CHANS, SD_AUDIO_SR_96000, SD_AUDIO_SAMPLE_WIDTH_8BITS, SD_AUDIO_I2S_RIGHT_JUSTIFIED},
    {SD_AUDIO_TRANSFER_CODEC_SLAVE | SD_AUDIO_DIR_MODE_MULTI_CHAN_TRANSMIT | SD_AUDIO_CHANNEL_NUM_TX_8CHANS, SD_AUDIO_SR_96000, SD_AUDIO_SAMPLE_WIDTH_8BITS, SD_AUDIO_I2S_DSP_A},
    {SD_AUDIO_TRANSFER_CODEC_SLAVE | SD_AUDIO_DIR_MODE_MULTI_CHAN_TRANSMIT | SD_AUDIO_CHANNEL_NUM_TX_8CHANS, SD_AUDIO_SR_96000, SD_AUDIO_SAMPLE_WIDTH_8BITS, SD_AUDIO_I2S_DSP_B},

    {SD_AUDIO_TRANSFER_CODEC_SLAVE | SD_AUDIO_DIR_MODE_MULTI_CHAN_TRANSMIT | SD_AUDIO_CHANNEL_NUM_TX_8CHANS, SD_AUDIO_SR_96000, SD_AUDIO_SAMPLE_WIDTH_16BITS, SD_AUDIO_I2S_STANDARD_PHILLIPS},
    {SD_AUDIO_TRANSFER_CODEC_SLAVE | SD_AUDIO_DIR_MODE_MULTI_CHAN_TRANSMIT | SD_AUDIO_CHANNEL_NUM_TX_8CHANS, SD_AUDIO_SR_96000, SD_AUDIO_SAMPLE_WIDTH_16BITS, SD_AUDIO_I2S_LEFT_JUSTIFIED},
    {SD_AUDIO_TRANSFER_CODEC_SLAVE | SD_AUDIO_DIR_MODE_MULTI_CHAN_TRANSMIT | SD_AUDIO_CHANNEL_NUM_TX_8CHANS, SD_AUDIO_SR_96000, SD_AUDIO_SAMPLE_WIDTH_16BITS, SD_AUDIO_I2S_RIGHT_JUSTIFIED},
    {SD_AUDIO_TRANSFER_CODEC_SLAVE | SD_AUDIO_DIR_MODE_MULTI_CHAN_TRANSMIT | SD_AUDIO_CHANNEL_NUM_TX_8CHANS, SD_AUDIO_SR_96000, SD_AUDIO_SAMPLE_WIDTH_16BITS, SD_AUDIO_I2S_DSP_A},
    {SD_AUDIO_TRANSFER_CODEC_SLAVE | SD_AUDIO_DIR_MODE_MULTI_CHAN_TRANSMIT | SD_AUDIO_CHANNEL_NUM_TX_8CHANS, SD_AUDIO_SR_96000, SD_AUDIO_SAMPLE_WIDTH_16BITS, SD_AUDIO_I2S_DSP_B},

    {SD_AUDIO_TRANSFER_CODEC_SLAVE | SD_AUDIO_DIR_MODE_MULTI_CHAN_TRANSMIT | SD_AUDIO_CHANNEL_NUM_TX_8CHANS, SD_AUDIO_SR_96000, SD_AUDIO_SAMPLE_WIDTH_24BITS, SD_AUDIO_I2S_STANDARD_PHILLIPS},
    {SD_AUDIO_TRANSFER_CODEC_SLAVE | SD_AUDIO_DIR_MODE_MULTI_CHAN_TRANSMIT | SD_AUDIO_CHANNEL_NUM_TX_8CHANS, SD_AUDIO_SR_96000, SD_AUDIO_SAMPLE_WIDTH_24BITS, SD_AUDIO_I2S_LEFT_JUSTIFIED},
    {SD_AUDIO_TRANSFER_CODEC_SLAVE | SD_AUDIO_DIR_MODE_MULTI_CHAN_TRANSMIT | SD_AUDIO_CHANNEL_NUM_TX_8CHANS, SD_AUDIO_SR_96000, SD_AUDIO_SAMPLE_WIDTH_24BITS, SD_AUDIO_I2S_RIGHT_JUSTIFIED},
    {SD_AUDIO_TRANSFER_CODEC_SLAVE | SD_AUDIO_DIR_MODE_MULTI_CHAN_TRANSMIT | SD_AUDIO_CHANNEL_NUM_TX_8CHANS, SD_AUDIO_SR_96000, SD_AUDIO_SAMPLE_WIDTH_24BITS, SD_AUDIO_I2S_DSP_A},
    {SD_AUDIO_TRANSFER_CODEC_SLAVE | SD_AUDIO_DIR_MODE_MULTI_CHAN_TRANSMIT | SD_AUDIO_CHANNEL_NUM_TX_8CHANS, SD_AUDIO_SR_96000, SD_AUDIO_SAMPLE_WIDTH_24BITS, SD_AUDIO_I2S_DSP_B},

    {SD_AUDIO_TRANSFER_CODEC_SLAVE | SD_AUDIO_DIR_MODE_MULTI_CHAN_TRANSMIT | SD_AUDIO_CHANNEL_NUM_TX_8CHANS, SD_AUDIO_SR_96000, SD_AUDIO_SAMPLE_WIDTH_32BITS, SD_AUDIO_I2S_STANDARD_PHILLIPS},
    {SD_AUDIO_TRANSFER_CODEC_SLAVE | SD_AUDIO_DIR_MODE_MULTI_CHAN_TRANSMIT | SD_AUDIO_CHANNEL_NUM_TX_8CHANS, SD_AUDIO_SR_96000, SD_AUDIO_SAMPLE_WIDTH_32BITS, SD_AUDIO_I2S_LEFT_JUSTIFIED},
    {SD_AUDIO_TRANSFER_CODEC_SLAVE | SD_AUDIO_DIR_MODE_MULTI_CHAN_TRANSMIT | SD_AUDIO_CHANNEL_NUM_TX_8CHANS, SD_AUDIO_SR_96000, SD_AUDIO_SAMPLE_WIDTH_32BITS, SD_AUDIO_I2S_RIGHT_JUSTIFIED},
    {SD_AUDIO_TRANSFER_CODEC_SLAVE | SD_AUDIO_DIR_MODE_MULTI_CHAN_TRANSMIT | SD_AUDIO_CHANNEL_NUM_TX_8CHANS, SD_AUDIO_SR_96000, SD_AUDIO_SAMPLE_WIDTH_32BITS, SD_AUDIO_I2S_DSP_A},
    {SD_AUDIO_TRANSFER_CODEC_SLAVE | SD_AUDIO_DIR_MODE_MULTI_CHAN_TRANSMIT | SD_AUDIO_CHANNEL_NUM_TX_8CHANS, SD_AUDIO_SR_96000, SD_AUDIO_SAMPLE_WIDTH_32BITS, SD_AUDIO_I2S_DSP_B},


////////////////////////////////////////////////////////////////////////////////////////////////////////////////////////////////////////////////////////////////////////////////////////////
//case 621~640
    {SD_AUDIO_TRANSFER_CODEC_SLAVE | SD_AUDIO_DIR_MODE_MULTI_CHAN_TRANSMIT | SD_AUDIO_CHANNEL_NUM_TX_8CHANS, SD_AUDIO_SR_192000, SD_AUDIO_SAMPLE_WIDTH_8BITS, SD_AUDIO_I2S_STANDARD_PHILLIPS},
    {SD_AUDIO_TRANSFER_CODEC_SLAVE | SD_AUDIO_DIR_MODE_MULTI_CHAN_TRANSMIT | SD_AUDIO_CHANNEL_NUM_TX_8CHANS, SD_AUDIO_SR_192000, SD_AUDIO_SAMPLE_WIDTH_8BITS, SD_AUDIO_I2S_LEFT_JUSTIFIED},
    {SD_AUDIO_TRANSFER_CODEC_SLAVE | SD_AUDIO_DIR_MODE_MULTI_CHAN_TRANSMIT | SD_AUDIO_CHANNEL_NUM_TX_8CHANS, SD_AUDIO_SR_192000, SD_AUDIO_SAMPLE_WIDTH_8BITS, SD_AUDIO_I2S_RIGHT_JUSTIFIED},
    {SD_AUDIO_TRANSFER_CODEC_SLAVE | SD_AUDIO_DIR_MODE_MULTI_CHAN_TRANSMIT | SD_AUDIO_CHANNEL_NUM_TX_8CHANS, SD_AUDIO_SR_192000, SD_AUDIO_SAMPLE_WIDTH_8BITS, SD_AUDIO_I2S_DSP_A},
    {SD_AUDIO_TRANSFER_CODEC_SLAVE | SD_AUDIO_DIR_MODE_MULTI_CHAN_TRANSMIT | SD_AUDIO_CHANNEL_NUM_TX_8CHANS, SD_AUDIO_SR_192000, SD_AUDIO_SAMPLE_WIDTH_8BITS, SD_AUDIO_I2S_DSP_B},

    {SD_AUDIO_TRANSFER_CODEC_SLAVE | SD_AUDIO_DIR_MODE_MULTI_CHAN_TRANSMIT | SD_AUDIO_CHANNEL_NUM_TX_8CHANS, SD_AUDIO_SR_192000, SD_AUDIO_SAMPLE_WIDTH_16BITS, SD_AUDIO_I2S_STANDARD_PHILLIPS},
    {SD_AUDIO_TRANSFER_CODEC_SLAVE | SD_AUDIO_DIR_MODE_MULTI_CHAN_TRANSMIT | SD_AUDIO_CHANNEL_NUM_TX_8CHANS, SD_AUDIO_SR_192000, SD_AUDIO_SAMPLE_WIDTH_16BITS, SD_AUDIO_I2S_LEFT_JUSTIFIED},
    {SD_AUDIO_TRANSFER_CODEC_SLAVE | SD_AUDIO_DIR_MODE_MULTI_CHAN_TRANSMIT | SD_AUDIO_CHANNEL_NUM_TX_8CHANS, SD_AUDIO_SR_192000, SD_AUDIO_SAMPLE_WIDTH_16BITS, SD_AUDIO_I2S_RIGHT_JUSTIFIED},
    {SD_AUDIO_TRANSFER_CODEC_SLAVE | SD_AUDIO_DIR_MODE_MULTI_CHAN_TRANSMIT | SD_AUDIO_CHANNEL_NUM_TX_8CHANS, SD_AUDIO_SR_192000, SD_AUDIO_SAMPLE_WIDTH_16BITS, SD_AUDIO_I2S_DSP_A},
    {SD_AUDIO_TRANSFER_CODEC_SLAVE | SD_AUDIO_DIR_MODE_MULTI_CHAN_TRANSMIT | SD_AUDIO_CHANNEL_NUM_TX_8CHANS, SD_AUDIO_SR_192000, SD_AUDIO_SAMPLE_WIDTH_16BITS, SD_AUDIO_I2S_DSP_B},

    {SD_AUDIO_TRANSFER_CODEC_SLAVE | SD_AUDIO_DIR_MODE_MULTI_CHAN_TRANSMIT | SD_AUDIO_CHANNEL_NUM_TX_8CHANS, SD_AUDIO_SR_192000, SD_AUDIO_SAMPLE_WIDTH_24BITS, SD_AUDIO_I2S_STANDARD_PHILLIPS},
    {SD_AUDIO_TRANSFER_CODEC_SLAVE | SD_AUDIO_DIR_MODE_MULTI_CHAN_TRANSMIT | SD_AUDIO_CHANNEL_NUM_TX_8CHANS, SD_AUDIO_SR_192000, SD_AUDIO_SAMPLE_WIDTH_24BITS, SD_AUDIO_I2S_LEFT_JUSTIFIED},
    {SD_AUDIO_TRANSFER_CODEC_SLAVE | SD_AUDIO_DIR_MODE_MULTI_CHAN_TRANSMIT | SD_AUDIO_CHANNEL_NUM_TX_8CHANS, SD_AUDIO_SR_192000, SD_AUDIO_SAMPLE_WIDTH_24BITS, SD_AUDIO_I2S_RIGHT_JUSTIFIED},
    {SD_AUDIO_TRANSFER_CODEC_SLAVE | SD_AUDIO_DIR_MODE_MULTI_CHAN_TRANSMIT | SD_AUDIO_CHANNEL_NUM_TX_8CHANS, SD_AUDIO_SR_192000, SD_AUDIO_SAMPLE_WIDTH_24BITS, SD_AUDIO_I2S_DSP_A},
    {SD_AUDIO_TRANSFER_CODEC_SLAVE | SD_AUDIO_DIR_MODE_MULTI_CHAN_TRANSMIT | SD_AUDIO_CHANNEL_NUM_TX_8CHANS, SD_AUDIO_SR_192000, SD_AUDIO_SAMPLE_WIDTH_24BITS, SD_AUDIO_I2S_DSP_B},

    {SD_AUDIO_TRANSFER_CODEC_SLAVE | SD_AUDIO_DIR_MODE_MULTI_CHAN_TRANSMIT | SD_AUDIO_CHANNEL_NUM_TX_8CHANS, SD_AUDIO_SR_192000, SD_AUDIO_SAMPLE_WIDTH_32BITS, SD_AUDIO_I2S_STANDARD_PHILLIPS},
    {SD_AUDIO_TRANSFER_CODEC_SLAVE | SD_AUDIO_DIR_MODE_MULTI_CHAN_TRANSMIT | SD_AUDIO_CHANNEL_NUM_TX_8CHANS, SD_AUDIO_SR_192000, SD_AUDIO_SAMPLE_WIDTH_32BITS, SD_AUDIO_I2S_LEFT_JUSTIFIED},
    {SD_AUDIO_TRANSFER_CODEC_SLAVE | SD_AUDIO_DIR_MODE_MULTI_CHAN_TRANSMIT | SD_AUDIO_CHANNEL_NUM_TX_8CHANS, SD_AUDIO_SR_192000, SD_AUDIO_SAMPLE_WIDTH_32BITS, SD_AUDIO_I2S_RIGHT_JUSTIFIED},
    {SD_AUDIO_TRANSFER_CODEC_SLAVE | SD_AUDIO_DIR_MODE_MULTI_CHAN_TRANSMIT | SD_AUDIO_CHANNEL_NUM_TX_8CHANS, SD_AUDIO_SR_192000, SD_AUDIO_SAMPLE_WIDTH_32BITS, SD_AUDIO_I2S_DSP_A},
    {SD_AUDIO_TRANSFER_CODEC_SLAVE | SD_AUDIO_DIR_MODE_MULTI_CHAN_TRANSMIT | SD_AUDIO_CHANNEL_NUM_TX_8CHANS, SD_AUDIO_SR_192000, SD_AUDIO_SAMPLE_WIDTH_32BITS, SD_AUDIO_I2S_DSP_B},



/////////////////////////////////////////////////////////////////////////////////mode 9///////////////////////////////////////////////////////////////////////////////////////////////////

//case 641~660
    {SD_AUDIO_TRANSFER_CODEC_SLAVE | SD_AUDIO_DIR_MODE_MULTI_CHAN_RECEIVE | SD_AUDIO_CHANNEL_NUM_RX_4CHANS, SD_AUDIO_SR_44100, SD_AUDIO_SAMPLE_WIDTH_8BITS, SD_AUDIO_I2S_STANDARD_PHILLIPS},
    {SD_AUDIO_TRANSFER_CODEC_SLAVE | SD_AUDIO_DIR_MODE_MULTI_CHAN_RECEIVE | SD_AUDIO_CHANNEL_NUM_RX_4CHANS, SD_AUDIO_SR_44100, SD_AUDIO_SAMPLE_WIDTH_8BITS, SD_AUDIO_I2S_LEFT_JUSTIFIED},
    {SD_AUDIO_TRANSFER_CODEC_SLAVE | SD_AUDIO_DIR_MODE_MULTI_CHAN_RECEIVE | SD_AUDIO_CHANNEL_NUM_RX_4CHANS, SD_AUDIO_SR_44100, SD_AUDIO_SAMPLE_WIDTH_8BITS, SD_AUDIO_I2S_RIGHT_JUSTIFIED},
    {SD_AUDIO_TRANSFER_CODEC_SLAVE | SD_AUDIO_DIR_MODE_MULTI_CHAN_RECEIVE | SD_AUDIO_CHANNEL_NUM_RX_4CHANS, SD_AUDIO_SR_44100, SD_AUDIO_SAMPLE_WIDTH_8BITS, SD_AUDIO_I2S_DSP_A},
    {SD_AUDIO_TRANSFER_CODEC_SLAVE | SD_AUDIO_DIR_MODE_MULTI_CHAN_RECEIVE | SD_AUDIO_CHANNEL_NUM_RX_4CHANS, SD_AUDIO_SR_44100, SD_AUDIO_SAMPLE_WIDTH_8BITS, SD_AUDIO_I2S_DSP_B},

    {SD_AUDIO_TRANSFER_CODEC_SLAVE | SD_AUDIO_DIR_MODE_MULTI_CHAN_RECEIVE | SD_AUDIO_CHANNEL_NUM_RX_4CHANS, SD_AUDIO_SR_44100, SD_AUDIO_SAMPLE_WIDTH_16BITS, SD_AUDIO_I2S_STANDARD_PHILLIPS},
    {SD_AUDIO_TRANSFER_CODEC_SLAVE | SD_AUDIO_DIR_MODE_MULTI_CHAN_RECEIVE | SD_AUDIO_CHANNEL_NUM_RX_4CHANS, SD_AUDIO_SR_44100, SD_AUDIO_SAMPLE_WIDTH_16BITS, SD_AUDIO_I2S_LEFT_JUSTIFIED},
    {SD_AUDIO_TRANSFER_CODEC_SLAVE | SD_AUDIO_DIR_MODE_MULTI_CHAN_RECEIVE | SD_AUDIO_CHANNEL_NUM_RX_4CHANS, SD_AUDIO_SR_44100, SD_AUDIO_SAMPLE_WIDTH_16BITS, SD_AUDIO_I2S_RIGHT_JUSTIFIED},
    {SD_AUDIO_TRANSFER_CODEC_SLAVE | SD_AUDIO_DIR_MODE_MULTI_CHAN_RECEIVE | SD_AUDIO_CHANNEL_NUM_RX_4CHANS, SD_AUDIO_SR_44100, SD_AUDIO_SAMPLE_WIDTH_16BITS, SD_AUDIO_I2S_DSP_A},
    {SD_AUDIO_TRANSFER_CODEC_SLAVE | SD_AUDIO_DIR_MODE_MULTI_CHAN_RECEIVE | SD_AUDIO_CHANNEL_NUM_RX_4CHANS, SD_AUDIO_SR_44100, SD_AUDIO_SAMPLE_WIDTH_16BITS, SD_AUDIO_I2S_DSP_B},

    {SD_AUDIO_TRANSFER_CODEC_SLAVE | SD_AUDIO_DIR_MODE_MULTI_CHAN_RECEIVE | SD_AUDIO_CHANNEL_NUM_RX_4CHANS, SD_AUDIO_SR_44100, SD_AUDIO_SAMPLE_WIDTH_24BITS, SD_AUDIO_I2S_STANDARD_PHILLIPS},
    {SD_AUDIO_TRANSFER_CODEC_SLAVE | SD_AUDIO_DIR_MODE_MULTI_CHAN_RECEIVE | SD_AUDIO_CHANNEL_NUM_RX_4CHANS, SD_AUDIO_SR_44100, SD_AUDIO_SAMPLE_WIDTH_24BITS, SD_AUDIO_I2S_LEFT_JUSTIFIED},
    {SD_AUDIO_TRANSFER_CODEC_SLAVE | SD_AUDIO_DIR_MODE_MULTI_CHAN_RECEIVE | SD_AUDIO_CHANNEL_NUM_RX_4CHANS, SD_AUDIO_SR_44100, SD_AUDIO_SAMPLE_WIDTH_24BITS, SD_AUDIO_I2S_RIGHT_JUSTIFIED},
    {SD_AUDIO_TRANSFER_CODEC_SLAVE | SD_AUDIO_DIR_MODE_MULTI_CHAN_RECEIVE | SD_AUDIO_CHANNEL_NUM_RX_4CHANS, SD_AUDIO_SR_44100, SD_AUDIO_SAMPLE_WIDTH_24BITS, SD_AUDIO_I2S_DSP_A},
    {SD_AUDIO_TRANSFER_CODEC_SLAVE | SD_AUDIO_DIR_MODE_MULTI_CHAN_RECEIVE | SD_AUDIO_CHANNEL_NUM_RX_4CHANS, SD_AUDIO_SR_44100, SD_AUDIO_SAMPLE_WIDTH_24BITS, SD_AUDIO_I2S_DSP_B},

    {SD_AUDIO_TRANSFER_CODEC_SLAVE | SD_AUDIO_DIR_MODE_MULTI_CHAN_RECEIVE | SD_AUDIO_CHANNEL_NUM_RX_4CHANS, SD_AUDIO_SR_44100, SD_AUDIO_SAMPLE_WIDTH_32BITS, SD_AUDIO_I2S_STANDARD_PHILLIPS},
    {SD_AUDIO_TRANSFER_CODEC_SLAVE | SD_AUDIO_DIR_MODE_MULTI_CHAN_RECEIVE | SD_AUDIO_CHANNEL_NUM_RX_4CHANS, SD_AUDIO_SR_44100, SD_AUDIO_SAMPLE_WIDTH_32BITS, SD_AUDIO_I2S_LEFT_JUSTIFIED},
    {SD_AUDIO_TRANSFER_CODEC_SLAVE | SD_AUDIO_DIR_MODE_MULTI_CHAN_RECEIVE | SD_AUDIO_CHANNEL_NUM_RX_4CHANS, SD_AUDIO_SR_44100, SD_AUDIO_SAMPLE_WIDTH_32BITS, SD_AUDIO_I2S_RIGHT_JUSTIFIED},
    {SD_AUDIO_TRANSFER_CODEC_SLAVE | SD_AUDIO_DIR_MODE_MULTI_CHAN_RECEIVE | SD_AUDIO_CHANNEL_NUM_RX_4CHANS, SD_AUDIO_SR_44100, SD_AUDIO_SAMPLE_WIDTH_32BITS, SD_AUDIO_I2S_DSP_A},
    {SD_AUDIO_TRANSFER_CODEC_SLAVE | SD_AUDIO_DIR_MODE_MULTI_CHAN_RECEIVE | SD_AUDIO_CHANNEL_NUM_RX_4CHANS, SD_AUDIO_SR_44100, SD_AUDIO_SAMPLE_WIDTH_32BITS, SD_AUDIO_I2S_DSP_B},


///////////////////////////////////////////////////////////////////////////////////////////////////////////////////////////////////////////////////////////////////////////////////////////
//case 661~680
    {SD_AUDIO_TRANSFER_CODEC_SLAVE | SD_AUDIO_DIR_MODE_MULTI_CHAN_RECEIVE | SD_AUDIO_CHANNEL_NUM_RX_4CHANS, SD_AUDIO_SR_48000, SD_AUDIO_SAMPLE_WIDTH_8BITS, SD_AUDIO_I2S_STANDARD_PHILLIPS},
    {SD_AUDIO_TRANSFER_CODEC_SLAVE | SD_AUDIO_DIR_MODE_MULTI_CHAN_RECEIVE | SD_AUDIO_CHANNEL_NUM_RX_4CHANS, SD_AUDIO_SR_48000, SD_AUDIO_SAMPLE_WIDTH_8BITS, SD_AUDIO_I2S_LEFT_JUSTIFIED},
    {SD_AUDIO_TRANSFER_CODEC_SLAVE | SD_AUDIO_DIR_MODE_MULTI_CHAN_RECEIVE | SD_AUDIO_CHANNEL_NUM_RX_4CHANS, SD_AUDIO_SR_48000, SD_AUDIO_SAMPLE_WIDTH_8BITS, SD_AUDIO_I2S_RIGHT_JUSTIFIED},
    {SD_AUDIO_TRANSFER_CODEC_SLAVE | SD_AUDIO_DIR_MODE_MULTI_CHAN_RECEIVE | SD_AUDIO_CHANNEL_NUM_RX_4CHANS, SD_AUDIO_SR_48000, SD_AUDIO_SAMPLE_WIDTH_8BITS, SD_AUDIO_I2S_DSP_A},
    {SD_AUDIO_TRANSFER_CODEC_SLAVE | SD_AUDIO_DIR_MODE_MULTI_CHAN_RECEIVE | SD_AUDIO_CHANNEL_NUM_RX_4CHANS, SD_AUDIO_SR_48000, SD_AUDIO_SAMPLE_WIDTH_8BITS, SD_AUDIO_I2S_DSP_B},

    {SD_AUDIO_TRANSFER_CODEC_SLAVE | SD_AUDIO_DIR_MODE_MULTI_CHAN_RECEIVE | SD_AUDIO_CHANNEL_NUM_RX_4CHANS, SD_AUDIO_SR_48000, SD_AUDIO_SAMPLE_WIDTH_16BITS, SD_AUDIO_I2S_STANDARD_PHILLIPS},
    {SD_AUDIO_TRANSFER_CODEC_SLAVE | SD_AUDIO_DIR_MODE_MULTI_CHAN_RECEIVE | SD_AUDIO_CHANNEL_NUM_RX_4CHANS, SD_AUDIO_SR_48000, SD_AUDIO_SAMPLE_WIDTH_16BITS, SD_AUDIO_I2S_LEFT_JUSTIFIED},
    {SD_AUDIO_TRANSFER_CODEC_SLAVE | SD_AUDIO_DIR_MODE_MULTI_CHAN_RECEIVE | SD_AUDIO_CHANNEL_NUM_RX_4CHANS, SD_AUDIO_SR_48000, SD_AUDIO_SAMPLE_WIDTH_16BITS, SD_AUDIO_I2S_RIGHT_JUSTIFIED},
    {SD_AUDIO_TRANSFER_CODEC_SLAVE | SD_AUDIO_DIR_MODE_MULTI_CHAN_RECEIVE | SD_AUDIO_CHANNEL_NUM_RX_4CHANS, SD_AUDIO_SR_48000, SD_AUDIO_SAMPLE_WIDTH_16BITS, SD_AUDIO_I2S_DSP_A},
    {SD_AUDIO_TRANSFER_CODEC_SLAVE | SD_AUDIO_DIR_MODE_MULTI_CHAN_RECEIVE | SD_AUDIO_CHANNEL_NUM_RX_4CHANS, SD_AUDIO_SR_48000, SD_AUDIO_SAMPLE_WIDTH_16BITS, SD_AUDIO_I2S_DSP_B},

    {SD_AUDIO_TRANSFER_CODEC_SLAVE | SD_AUDIO_DIR_MODE_MULTI_CHAN_RECEIVE | SD_AUDIO_CHANNEL_NUM_RX_4CHANS, SD_AUDIO_SR_48000, SD_AUDIO_SAMPLE_WIDTH_24BITS, SD_AUDIO_I2S_STANDARD_PHILLIPS},
    {SD_AUDIO_TRANSFER_CODEC_SLAVE | SD_AUDIO_DIR_MODE_MULTI_CHAN_RECEIVE | SD_AUDIO_CHANNEL_NUM_RX_4CHANS, SD_AUDIO_SR_48000, SD_AUDIO_SAMPLE_WIDTH_24BITS, SD_AUDIO_I2S_LEFT_JUSTIFIED},
    {SD_AUDIO_TRANSFER_CODEC_SLAVE | SD_AUDIO_DIR_MODE_MULTI_CHAN_RECEIVE | SD_AUDIO_CHANNEL_NUM_RX_4CHANS, SD_AUDIO_SR_48000, SD_AUDIO_SAMPLE_WIDTH_24BITS, SD_AUDIO_I2S_RIGHT_JUSTIFIED},
    {SD_AUDIO_TRANSFER_CODEC_SLAVE | SD_AUDIO_DIR_MODE_MULTI_CHAN_RECEIVE | SD_AUDIO_CHANNEL_NUM_RX_4CHANS, SD_AUDIO_SR_48000, SD_AUDIO_SAMPLE_WIDTH_24BITS, SD_AUDIO_I2S_DSP_A},
    {SD_AUDIO_TRANSFER_CODEC_SLAVE | SD_AUDIO_DIR_MODE_MULTI_CHAN_RECEIVE | SD_AUDIO_CHANNEL_NUM_RX_4CHANS, SD_AUDIO_SR_48000, SD_AUDIO_SAMPLE_WIDTH_24BITS, SD_AUDIO_I2S_DSP_B},

    {SD_AUDIO_TRANSFER_CODEC_SLAVE | SD_AUDIO_DIR_MODE_MULTI_CHAN_RECEIVE | SD_AUDIO_CHANNEL_NUM_RX_4CHANS, SD_AUDIO_SR_48000, SD_AUDIO_SAMPLE_WIDTH_32BITS, SD_AUDIO_I2S_STANDARD_PHILLIPS},
    {SD_AUDIO_TRANSFER_CODEC_SLAVE | SD_AUDIO_DIR_MODE_MULTI_CHAN_RECEIVE | SD_AUDIO_CHANNEL_NUM_RX_4CHANS, SD_AUDIO_SR_48000, SD_AUDIO_SAMPLE_WIDTH_32BITS, SD_AUDIO_I2S_LEFT_JUSTIFIED},
    {SD_AUDIO_TRANSFER_CODEC_SLAVE | SD_AUDIO_DIR_MODE_MULTI_CHAN_RECEIVE | SD_AUDIO_CHANNEL_NUM_RX_4CHANS, SD_AUDIO_SR_48000, SD_AUDIO_SAMPLE_WIDTH_32BITS, SD_AUDIO_I2S_RIGHT_JUSTIFIED},
    {SD_AUDIO_TRANSFER_CODEC_SLAVE | SD_AUDIO_DIR_MODE_MULTI_CHAN_RECEIVE | SD_AUDIO_CHANNEL_NUM_RX_4CHANS, SD_AUDIO_SR_48000, SD_AUDIO_SAMPLE_WIDTH_32BITS, SD_AUDIO_I2S_DSP_A},
    {SD_AUDIO_TRANSFER_CODEC_SLAVE | SD_AUDIO_DIR_MODE_MULTI_CHAN_RECEIVE | SD_AUDIO_CHANNEL_NUM_RX_4CHANS, SD_AUDIO_SR_48000, SD_AUDIO_SAMPLE_WIDTH_32BITS, SD_AUDIO_I2S_DSP_B},


///////////////////////////////////////////////////////////////////////////////////////////////////////////////////////////////////////////////////////////////////////////////////////////
//case 681~700
    {SD_AUDIO_TRANSFER_CODEC_SLAVE | SD_AUDIO_DIR_MODE_MULTI_CHAN_RECEIVE | SD_AUDIO_CHANNEL_NUM_RX_4CHANS, SD_AUDIO_SR_96000, SD_AUDIO_SAMPLE_WIDTH_8BITS, SD_AUDIO_I2S_STANDARD_PHILLIPS},
    {SD_AUDIO_TRANSFER_CODEC_SLAVE | SD_AUDIO_DIR_MODE_MULTI_CHAN_RECEIVE | SD_AUDIO_CHANNEL_NUM_RX_4CHANS, SD_AUDIO_SR_96000, SD_AUDIO_SAMPLE_WIDTH_8BITS, SD_AUDIO_I2S_LEFT_JUSTIFIED},
    {SD_AUDIO_TRANSFER_CODEC_SLAVE | SD_AUDIO_DIR_MODE_MULTI_CHAN_RECEIVE | SD_AUDIO_CHANNEL_NUM_RX_4CHANS, SD_AUDIO_SR_96000, SD_AUDIO_SAMPLE_WIDTH_8BITS, SD_AUDIO_I2S_RIGHT_JUSTIFIED},
    {SD_AUDIO_TRANSFER_CODEC_SLAVE | SD_AUDIO_DIR_MODE_MULTI_CHAN_RECEIVE | SD_AUDIO_CHANNEL_NUM_RX_4CHANS, SD_AUDIO_SR_96000, SD_AUDIO_SAMPLE_WIDTH_8BITS, SD_AUDIO_I2S_DSP_A},
    {SD_AUDIO_TRANSFER_CODEC_SLAVE | SD_AUDIO_DIR_MODE_MULTI_CHAN_RECEIVE | SD_AUDIO_CHANNEL_NUM_RX_4CHANS, SD_AUDIO_SR_96000, SD_AUDIO_SAMPLE_WIDTH_8BITS, SD_AUDIO_I2S_DSP_B},

    {SD_AUDIO_TRANSFER_CODEC_SLAVE | SD_AUDIO_DIR_MODE_MULTI_CHAN_RECEIVE | SD_AUDIO_CHANNEL_NUM_RX_4CHANS, SD_AUDIO_SR_96000, SD_AUDIO_SAMPLE_WIDTH_16BITS, SD_AUDIO_I2S_STANDARD_PHILLIPS},
    {SD_AUDIO_TRANSFER_CODEC_SLAVE | SD_AUDIO_DIR_MODE_MULTI_CHAN_RECEIVE | SD_AUDIO_CHANNEL_NUM_RX_4CHANS, SD_AUDIO_SR_96000, SD_AUDIO_SAMPLE_WIDTH_16BITS, SD_AUDIO_I2S_LEFT_JUSTIFIED},
    {SD_AUDIO_TRANSFER_CODEC_SLAVE | SD_AUDIO_DIR_MODE_MULTI_CHAN_RECEIVE | SD_AUDIO_CHANNEL_NUM_RX_4CHANS, SD_AUDIO_SR_96000, SD_AUDIO_SAMPLE_WIDTH_16BITS, SD_AUDIO_I2S_RIGHT_JUSTIFIED},
    {SD_AUDIO_TRANSFER_CODEC_SLAVE | SD_AUDIO_DIR_MODE_MULTI_CHAN_RECEIVE | SD_AUDIO_CHANNEL_NUM_RX_4CHANS, SD_AUDIO_SR_96000, SD_AUDIO_SAMPLE_WIDTH_16BITS, SD_AUDIO_I2S_DSP_A},
    {SD_AUDIO_TRANSFER_CODEC_SLAVE | SD_AUDIO_DIR_MODE_MULTI_CHAN_RECEIVE | SD_AUDIO_CHANNEL_NUM_RX_4CHANS, SD_AUDIO_SR_96000, SD_AUDIO_SAMPLE_WIDTH_16BITS, SD_AUDIO_I2S_DSP_B},

    {SD_AUDIO_TRANSFER_CODEC_SLAVE | SD_AUDIO_DIR_MODE_MULTI_CHAN_RECEIVE | SD_AUDIO_CHANNEL_NUM_RX_4CHANS, SD_AUDIO_SR_96000, SD_AUDIO_SAMPLE_WIDTH_24BITS, SD_AUDIO_I2S_STANDARD_PHILLIPS},
    {SD_AUDIO_TRANSFER_CODEC_SLAVE | SD_AUDIO_DIR_MODE_MULTI_CHAN_RECEIVE | SD_AUDIO_CHANNEL_NUM_RX_4CHANS, SD_AUDIO_SR_96000, SD_AUDIO_SAMPLE_WIDTH_24BITS, SD_AUDIO_I2S_LEFT_JUSTIFIED},
    {SD_AUDIO_TRANSFER_CODEC_SLAVE | SD_AUDIO_DIR_MODE_MULTI_CHAN_RECEIVE | SD_AUDIO_CHANNEL_NUM_RX_4CHANS, SD_AUDIO_SR_96000, SD_AUDIO_SAMPLE_WIDTH_24BITS, SD_AUDIO_I2S_RIGHT_JUSTIFIED},
    {SD_AUDIO_TRANSFER_CODEC_SLAVE | SD_AUDIO_DIR_MODE_MULTI_CHAN_RECEIVE | SD_AUDIO_CHANNEL_NUM_RX_4CHANS, SD_AUDIO_SR_96000, SD_AUDIO_SAMPLE_WIDTH_24BITS, SD_AUDIO_I2S_DSP_A},
    {SD_AUDIO_TRANSFER_CODEC_SLAVE | SD_AUDIO_DIR_MODE_MULTI_CHAN_RECEIVE | SD_AUDIO_CHANNEL_NUM_RX_4CHANS, SD_AUDIO_SR_96000, SD_AUDIO_SAMPLE_WIDTH_24BITS, SD_AUDIO_I2S_DSP_B},

    {SD_AUDIO_TRANSFER_CODEC_SLAVE | SD_AUDIO_DIR_MODE_MULTI_CHAN_RECEIVE | SD_AUDIO_CHANNEL_NUM_RX_4CHANS, SD_AUDIO_SR_96000, SD_AUDIO_SAMPLE_WIDTH_32BITS, SD_AUDIO_I2S_STANDARD_PHILLIPS},
    {SD_AUDIO_TRANSFER_CODEC_SLAVE | SD_AUDIO_DIR_MODE_MULTI_CHAN_RECEIVE | SD_AUDIO_CHANNEL_NUM_RX_4CHANS, SD_AUDIO_SR_96000, SD_AUDIO_SAMPLE_WIDTH_32BITS, SD_AUDIO_I2S_LEFT_JUSTIFIED},
    {SD_AUDIO_TRANSFER_CODEC_SLAVE | SD_AUDIO_DIR_MODE_MULTI_CHAN_RECEIVE | SD_AUDIO_CHANNEL_NUM_RX_4CHANS, SD_AUDIO_SR_96000, SD_AUDIO_SAMPLE_WIDTH_32BITS, SD_AUDIO_I2S_RIGHT_JUSTIFIED},
    {SD_AUDIO_TRANSFER_CODEC_SLAVE | SD_AUDIO_DIR_MODE_MULTI_CHAN_RECEIVE | SD_AUDIO_CHANNEL_NUM_RX_4CHANS, SD_AUDIO_SR_96000, SD_AUDIO_SAMPLE_WIDTH_32BITS, SD_AUDIO_I2S_DSP_A},
    {SD_AUDIO_TRANSFER_CODEC_SLAVE | SD_AUDIO_DIR_MODE_MULTI_CHAN_RECEIVE | SD_AUDIO_CHANNEL_NUM_RX_4CHANS, SD_AUDIO_SR_96000, SD_AUDIO_SAMPLE_WIDTH_32BITS, SD_AUDIO_I2S_DSP_B},


///////////////////////////////////////////////////////////////////////////////////////////////////////////////////////////////////////////////////////////////////////////////////////////
//case 701~720
    {SD_AUDIO_TRANSFER_CODEC_SLAVE | SD_AUDIO_DIR_MODE_MULTI_CHAN_RECEIVE | SD_AUDIO_CHANNEL_NUM_RX_4CHANS, SD_AUDIO_SR_192000, SD_AUDIO_SAMPLE_WIDTH_8BITS, SD_AUDIO_I2S_STANDARD_PHILLIPS},
    {SD_AUDIO_TRANSFER_CODEC_SLAVE | SD_AUDIO_DIR_MODE_MULTI_CHAN_RECEIVE | SD_AUDIO_CHANNEL_NUM_RX_4CHANS, SD_AUDIO_SR_192000, SD_AUDIO_SAMPLE_WIDTH_8BITS, SD_AUDIO_I2S_LEFT_JUSTIFIED},
    {SD_AUDIO_TRANSFER_CODEC_SLAVE | SD_AUDIO_DIR_MODE_MULTI_CHAN_RECEIVE | SD_AUDIO_CHANNEL_NUM_RX_4CHANS, SD_AUDIO_SR_192000, SD_AUDIO_SAMPLE_WIDTH_8BITS, SD_AUDIO_I2S_RIGHT_JUSTIFIED},
    {SD_AUDIO_TRANSFER_CODEC_SLAVE | SD_AUDIO_DIR_MODE_MULTI_CHAN_RECEIVE | SD_AUDIO_CHANNEL_NUM_RX_4CHANS, SD_AUDIO_SR_192000, SD_AUDIO_SAMPLE_WIDTH_8BITS, SD_AUDIO_I2S_DSP_A},
    {SD_AUDIO_TRANSFER_CODEC_SLAVE | SD_AUDIO_DIR_MODE_MULTI_CHAN_RECEIVE | SD_AUDIO_CHANNEL_NUM_RX_4CHANS, SD_AUDIO_SR_192000, SD_AUDIO_SAMPLE_WIDTH_8BITS, SD_AUDIO_I2S_DSP_B},

    {SD_AUDIO_TRANSFER_CODEC_SLAVE | SD_AUDIO_DIR_MODE_MULTI_CHAN_RECEIVE | SD_AUDIO_CHANNEL_NUM_RX_4CHANS, SD_AUDIO_SR_192000, SD_AUDIO_SAMPLE_WIDTH_16BITS, SD_AUDIO_I2S_STANDARD_PHILLIPS},
    {SD_AUDIO_TRANSFER_CODEC_SLAVE | SD_AUDIO_DIR_MODE_MULTI_CHAN_RECEIVE | SD_AUDIO_CHANNEL_NUM_RX_4CHANS, SD_AUDIO_SR_192000, SD_AUDIO_SAMPLE_WIDTH_16BITS, SD_AUDIO_I2S_LEFT_JUSTIFIED},
    {SD_AUDIO_TRANSFER_CODEC_SLAVE | SD_AUDIO_DIR_MODE_MULTI_CHAN_RECEIVE | SD_AUDIO_CHANNEL_NUM_RX_4CHANS, SD_AUDIO_SR_192000, SD_AUDIO_SAMPLE_WIDTH_16BITS, SD_AUDIO_I2S_RIGHT_JUSTIFIED},
    {SD_AUDIO_TRANSFER_CODEC_SLAVE | SD_AUDIO_DIR_MODE_MULTI_CHAN_RECEIVE | SD_AUDIO_CHANNEL_NUM_RX_4CHANS, SD_AUDIO_SR_192000, SD_AUDIO_SAMPLE_WIDTH_16BITS, SD_AUDIO_I2S_DSP_A},
    {SD_AUDIO_TRANSFER_CODEC_SLAVE | SD_AUDIO_DIR_MODE_MULTI_CHAN_RECEIVE | SD_AUDIO_CHANNEL_NUM_RX_4CHANS, SD_AUDIO_SR_192000, SD_AUDIO_SAMPLE_WIDTH_16BITS, SD_AUDIO_I2S_DSP_B},

    {SD_AUDIO_TRANSFER_CODEC_SLAVE | SD_AUDIO_DIR_MODE_MULTI_CHAN_RECEIVE | SD_AUDIO_CHANNEL_NUM_RX_4CHANS, SD_AUDIO_SR_192000, SD_AUDIO_SAMPLE_WIDTH_24BITS, SD_AUDIO_I2S_STANDARD_PHILLIPS},
    {SD_AUDIO_TRANSFER_CODEC_SLAVE | SD_AUDIO_DIR_MODE_MULTI_CHAN_RECEIVE | SD_AUDIO_CHANNEL_NUM_RX_4CHANS, SD_AUDIO_SR_192000, SD_AUDIO_SAMPLE_WIDTH_24BITS, SD_AUDIO_I2S_LEFT_JUSTIFIED},
    {SD_AUDIO_TRANSFER_CODEC_SLAVE | SD_AUDIO_DIR_MODE_MULTI_CHAN_RECEIVE | SD_AUDIO_CHANNEL_NUM_RX_4CHANS, SD_AUDIO_SR_192000, SD_AUDIO_SAMPLE_WIDTH_24BITS, SD_AUDIO_I2S_RIGHT_JUSTIFIED},
    {SD_AUDIO_TRANSFER_CODEC_SLAVE | SD_AUDIO_DIR_MODE_MULTI_CHAN_RECEIVE | SD_AUDIO_CHANNEL_NUM_RX_4CHANS, SD_AUDIO_SR_192000, SD_AUDIO_SAMPLE_WIDTH_24BITS, SD_AUDIO_I2S_DSP_A},
    {SD_AUDIO_TRANSFER_CODEC_SLAVE | SD_AUDIO_DIR_MODE_MULTI_CHAN_RECEIVE | SD_AUDIO_CHANNEL_NUM_RX_4CHANS, SD_AUDIO_SR_192000, SD_AUDIO_SAMPLE_WIDTH_24BITS, SD_AUDIO_I2S_DSP_B},

    {SD_AUDIO_TRANSFER_CODEC_SLAVE | SD_AUDIO_DIR_MODE_MULTI_CHAN_RECEIVE | SD_AUDIO_CHANNEL_NUM_RX_4CHANS, SD_AUDIO_SR_192000, SD_AUDIO_SAMPLE_WIDTH_32BITS, SD_AUDIO_I2S_STANDARD_PHILLIPS},
    {SD_AUDIO_TRANSFER_CODEC_SLAVE | SD_AUDIO_DIR_MODE_MULTI_CHAN_RECEIVE | SD_AUDIO_CHANNEL_NUM_RX_4CHANS, SD_AUDIO_SR_192000, SD_AUDIO_SAMPLE_WIDTH_32BITS, SD_AUDIO_I2S_LEFT_JUSTIFIED},
    {SD_AUDIO_TRANSFER_CODEC_SLAVE | SD_AUDIO_DIR_MODE_MULTI_CHAN_RECEIVE | SD_AUDIO_CHANNEL_NUM_RX_4CHANS, SD_AUDIO_SR_192000, SD_AUDIO_SAMPLE_WIDTH_32BITS, SD_AUDIO_I2S_RIGHT_JUSTIFIED},
    {SD_AUDIO_TRANSFER_CODEC_SLAVE | SD_AUDIO_DIR_MODE_MULTI_CHAN_RECEIVE | SD_AUDIO_CHANNEL_NUM_RX_4CHANS, SD_AUDIO_SR_192000, SD_AUDIO_SAMPLE_WIDTH_32BITS, SD_AUDIO_I2S_DSP_A},
    {SD_AUDIO_TRANSFER_CODEC_SLAVE | SD_AUDIO_DIR_MODE_MULTI_CHAN_RECEIVE | SD_AUDIO_CHANNEL_NUM_RX_4CHANS, SD_AUDIO_SR_192000, SD_AUDIO_SAMPLE_WIDTH_32BITS, SD_AUDIO_I2S_DSP_B},



/////////////////////////////////////////////////////////////////////////////////mode 10/////////////////////////////////////////////////////////////////////////////////////////////////

//case 721~740
    {SD_AUDIO_TRANSFER_CODEC_SLAVE | SD_AUDIO_DIR_MODE_MULTI_CHAN_RECEIVE | SD_AUDIO_CHANNEL_NUM_RX_8CHANS, SD_AUDIO_SR_44100, SD_AUDIO_SAMPLE_WIDTH_8BITS, SD_AUDIO_I2S_STANDARD_PHILLIPS},
    {SD_AUDIO_TRANSFER_CODEC_SLAVE | SD_AUDIO_DIR_MODE_MULTI_CHAN_RECEIVE | SD_AUDIO_CHANNEL_NUM_RX_8CHANS, SD_AUDIO_SR_44100, SD_AUDIO_SAMPLE_WIDTH_8BITS, SD_AUDIO_I2S_LEFT_JUSTIFIED},
    {SD_AUDIO_TRANSFER_CODEC_SLAVE | SD_AUDIO_DIR_MODE_MULTI_CHAN_RECEIVE | SD_AUDIO_CHANNEL_NUM_RX_8CHANS, SD_AUDIO_SR_44100, SD_AUDIO_SAMPLE_WIDTH_8BITS, SD_AUDIO_I2S_RIGHT_JUSTIFIED},
    {SD_AUDIO_TRANSFER_CODEC_SLAVE | SD_AUDIO_DIR_MODE_MULTI_CHAN_RECEIVE | SD_AUDIO_CHANNEL_NUM_RX_8CHANS, SD_AUDIO_SR_44100, SD_AUDIO_SAMPLE_WIDTH_8BITS, SD_AUDIO_I2S_DSP_A},
    {SD_AUDIO_TRANSFER_CODEC_SLAVE | SD_AUDIO_DIR_MODE_MULTI_CHAN_RECEIVE | SD_AUDIO_CHANNEL_NUM_RX_8CHANS, SD_AUDIO_SR_44100, SD_AUDIO_SAMPLE_WIDTH_8BITS, SD_AUDIO_I2S_DSP_B},

    {SD_AUDIO_TRANSFER_CODEC_SLAVE | SD_AUDIO_DIR_MODE_MULTI_CHAN_RECEIVE | SD_AUDIO_CHANNEL_NUM_RX_8CHANS, SD_AUDIO_SR_44100, SD_AUDIO_SAMPLE_WIDTH_16BITS, SD_AUDIO_I2S_STANDARD_PHILLIPS},
    {SD_AUDIO_TRANSFER_CODEC_SLAVE | SD_AUDIO_DIR_MODE_MULTI_CHAN_RECEIVE | SD_AUDIO_CHANNEL_NUM_RX_8CHANS, SD_AUDIO_SR_44100, SD_AUDIO_SAMPLE_WIDTH_16BITS, SD_AUDIO_I2S_LEFT_JUSTIFIED},
    {SD_AUDIO_TRANSFER_CODEC_SLAVE | SD_AUDIO_DIR_MODE_MULTI_CHAN_RECEIVE | SD_AUDIO_CHANNEL_NUM_RX_8CHANS, SD_AUDIO_SR_44100, SD_AUDIO_SAMPLE_WIDTH_16BITS, SD_AUDIO_I2S_RIGHT_JUSTIFIED},
    {SD_AUDIO_TRANSFER_CODEC_SLAVE | SD_AUDIO_DIR_MODE_MULTI_CHAN_RECEIVE | SD_AUDIO_CHANNEL_NUM_RX_8CHANS, SD_AUDIO_SR_44100, SD_AUDIO_SAMPLE_WIDTH_16BITS, SD_AUDIO_I2S_DSP_A},
    {SD_AUDIO_TRANSFER_CODEC_SLAVE | SD_AUDIO_DIR_MODE_MULTI_CHAN_RECEIVE | SD_AUDIO_CHANNEL_NUM_RX_8CHANS, SD_AUDIO_SR_44100, SD_AUDIO_SAMPLE_WIDTH_16BITS, SD_AUDIO_I2S_DSP_B},

    {SD_AUDIO_TRANSFER_CODEC_SLAVE | SD_AUDIO_DIR_MODE_MULTI_CHAN_RECEIVE | SD_AUDIO_CHANNEL_NUM_RX_8CHANS, SD_AUDIO_SR_44100, SD_AUDIO_SAMPLE_WIDTH_24BITS, SD_AUDIO_I2S_STANDARD_PHILLIPS},
    {SD_AUDIO_TRANSFER_CODEC_SLAVE | SD_AUDIO_DIR_MODE_MULTI_CHAN_RECEIVE | SD_AUDIO_CHANNEL_NUM_RX_8CHANS, SD_AUDIO_SR_44100, SD_AUDIO_SAMPLE_WIDTH_24BITS, SD_AUDIO_I2S_LEFT_JUSTIFIED},
    {SD_AUDIO_TRANSFER_CODEC_SLAVE | SD_AUDIO_DIR_MODE_MULTI_CHAN_RECEIVE | SD_AUDIO_CHANNEL_NUM_RX_8CHANS, SD_AUDIO_SR_44100, SD_AUDIO_SAMPLE_WIDTH_24BITS, SD_AUDIO_I2S_RIGHT_JUSTIFIED},
    {SD_AUDIO_TRANSFER_CODEC_SLAVE | SD_AUDIO_DIR_MODE_MULTI_CHAN_RECEIVE | SD_AUDIO_CHANNEL_NUM_RX_8CHANS, SD_AUDIO_SR_44100, SD_AUDIO_SAMPLE_WIDTH_24BITS, SD_AUDIO_I2S_DSP_A},
    {SD_AUDIO_TRANSFER_CODEC_SLAVE | SD_AUDIO_DIR_MODE_MULTI_CHAN_RECEIVE | SD_AUDIO_CHANNEL_NUM_RX_8CHANS, SD_AUDIO_SR_44100, SD_AUDIO_SAMPLE_WIDTH_24BITS, SD_AUDIO_I2S_DSP_B},

    {SD_AUDIO_TRANSFER_CODEC_SLAVE | SD_AUDIO_DIR_MODE_MULTI_CHAN_RECEIVE | SD_AUDIO_CHANNEL_NUM_RX_8CHANS, SD_AUDIO_SR_44100, SD_AUDIO_SAMPLE_WIDTH_32BITS, SD_AUDIO_I2S_STANDARD_PHILLIPS},
    {SD_AUDIO_TRANSFER_CODEC_SLAVE | SD_AUDIO_DIR_MODE_MULTI_CHAN_RECEIVE | SD_AUDIO_CHANNEL_NUM_RX_8CHANS, SD_AUDIO_SR_44100, SD_AUDIO_SAMPLE_WIDTH_32BITS, SD_AUDIO_I2S_LEFT_JUSTIFIED},
    {SD_AUDIO_TRANSFER_CODEC_SLAVE | SD_AUDIO_DIR_MODE_MULTI_CHAN_RECEIVE | SD_AUDIO_CHANNEL_NUM_RX_8CHANS, SD_AUDIO_SR_44100, SD_AUDIO_SAMPLE_WIDTH_32BITS, SD_AUDIO_I2S_RIGHT_JUSTIFIED},
    {SD_AUDIO_TRANSFER_CODEC_SLAVE | SD_AUDIO_DIR_MODE_MULTI_CHAN_RECEIVE | SD_AUDIO_CHANNEL_NUM_RX_8CHANS, SD_AUDIO_SR_44100, SD_AUDIO_SAMPLE_WIDTH_32BITS, SD_AUDIO_I2S_DSP_A},
    {SD_AUDIO_TRANSFER_CODEC_SLAVE | SD_AUDIO_DIR_MODE_MULTI_CHAN_RECEIVE | SD_AUDIO_CHANNEL_NUM_RX_8CHANS, SD_AUDIO_SR_44100, SD_AUDIO_SAMPLE_WIDTH_32BITS, SD_AUDIO_I2S_DSP_B},


///////////////////////////////////////////////////////////////////////////////////////////////////////////////////////////////////////////////////////////////////////////////////////////
//case 741~760
    {SD_AUDIO_TRANSFER_CODEC_SLAVE | SD_AUDIO_DIR_MODE_MULTI_CHAN_RECEIVE | SD_AUDIO_CHANNEL_NUM_RX_8CHANS, SD_AUDIO_SR_48000, SD_AUDIO_SAMPLE_WIDTH_8BITS, SD_AUDIO_I2S_STANDARD_PHILLIPS},
    {SD_AUDIO_TRANSFER_CODEC_SLAVE | SD_AUDIO_DIR_MODE_MULTI_CHAN_RECEIVE | SD_AUDIO_CHANNEL_NUM_RX_8CHANS, SD_AUDIO_SR_48000, SD_AUDIO_SAMPLE_WIDTH_8BITS, SD_AUDIO_I2S_LEFT_JUSTIFIED},
    {SD_AUDIO_TRANSFER_CODEC_SLAVE | SD_AUDIO_DIR_MODE_MULTI_CHAN_RECEIVE | SD_AUDIO_CHANNEL_NUM_RX_8CHANS, SD_AUDIO_SR_48000, SD_AUDIO_SAMPLE_WIDTH_8BITS, SD_AUDIO_I2S_RIGHT_JUSTIFIED},
    {SD_AUDIO_TRANSFER_CODEC_SLAVE | SD_AUDIO_DIR_MODE_MULTI_CHAN_RECEIVE | SD_AUDIO_CHANNEL_NUM_RX_8CHANS, SD_AUDIO_SR_48000, SD_AUDIO_SAMPLE_WIDTH_8BITS, SD_AUDIO_I2S_DSP_A},
    {SD_AUDIO_TRANSFER_CODEC_SLAVE | SD_AUDIO_DIR_MODE_MULTI_CHAN_RECEIVE | SD_AUDIO_CHANNEL_NUM_RX_8CHANS, SD_AUDIO_SR_48000, SD_AUDIO_SAMPLE_WIDTH_8BITS, SD_AUDIO_I2S_DSP_B},

    {SD_AUDIO_TRANSFER_CODEC_SLAVE | SD_AUDIO_DIR_MODE_MULTI_CHAN_RECEIVE | SD_AUDIO_CHANNEL_NUM_RX_8CHANS, SD_AUDIO_SR_48000, SD_AUDIO_SAMPLE_WIDTH_16BITS, SD_AUDIO_I2S_STANDARD_PHILLIPS},
    {SD_AUDIO_TRANSFER_CODEC_SLAVE | SD_AUDIO_DIR_MODE_MULTI_CHAN_RECEIVE | SD_AUDIO_CHANNEL_NUM_RX_8CHANS, SD_AUDIO_SR_48000, SD_AUDIO_SAMPLE_WIDTH_16BITS, SD_AUDIO_I2S_LEFT_JUSTIFIED},
    {SD_AUDIO_TRANSFER_CODEC_SLAVE | SD_AUDIO_DIR_MODE_MULTI_CHAN_RECEIVE | SD_AUDIO_CHANNEL_NUM_RX_8CHANS, SD_AUDIO_SR_48000, SD_AUDIO_SAMPLE_WIDTH_16BITS, SD_AUDIO_I2S_RIGHT_JUSTIFIED},
    {SD_AUDIO_TRANSFER_CODEC_SLAVE | SD_AUDIO_DIR_MODE_MULTI_CHAN_RECEIVE | SD_AUDIO_CHANNEL_NUM_RX_8CHANS, SD_AUDIO_SR_48000, SD_AUDIO_SAMPLE_WIDTH_16BITS, SD_AUDIO_I2S_DSP_A},
    {SD_AUDIO_TRANSFER_CODEC_SLAVE | SD_AUDIO_DIR_MODE_MULTI_CHAN_RECEIVE | SD_AUDIO_CHANNEL_NUM_RX_8CHANS, SD_AUDIO_SR_48000, SD_AUDIO_SAMPLE_WIDTH_16BITS, SD_AUDIO_I2S_DSP_B},

    {SD_AUDIO_TRANSFER_CODEC_SLAVE | SD_AUDIO_DIR_MODE_MULTI_CHAN_RECEIVE | SD_AUDIO_CHANNEL_NUM_RX_8CHANS, SD_AUDIO_SR_48000, SD_AUDIO_SAMPLE_WIDTH_24BITS, SD_AUDIO_I2S_STANDARD_PHILLIPS},
    {SD_AUDIO_TRANSFER_CODEC_SLAVE | SD_AUDIO_DIR_MODE_MULTI_CHAN_RECEIVE | SD_AUDIO_CHANNEL_NUM_RX_8CHANS, SD_AUDIO_SR_48000, SD_AUDIO_SAMPLE_WIDTH_24BITS, SD_AUDIO_I2S_LEFT_JUSTIFIED},
    {SD_AUDIO_TRANSFER_CODEC_SLAVE | SD_AUDIO_DIR_MODE_MULTI_CHAN_RECEIVE | SD_AUDIO_CHANNEL_NUM_RX_8CHANS, SD_AUDIO_SR_48000, SD_AUDIO_SAMPLE_WIDTH_24BITS, SD_AUDIO_I2S_RIGHT_JUSTIFIED},
    {SD_AUDIO_TRANSFER_CODEC_SLAVE | SD_AUDIO_DIR_MODE_MULTI_CHAN_RECEIVE | SD_AUDIO_CHANNEL_NUM_RX_8CHANS, SD_AUDIO_SR_48000, SD_AUDIO_SAMPLE_WIDTH_24BITS, SD_AUDIO_I2S_DSP_A},
    {SD_AUDIO_TRANSFER_CODEC_SLAVE | SD_AUDIO_DIR_MODE_MULTI_CHAN_RECEIVE | SD_AUDIO_CHANNEL_NUM_RX_8CHANS, SD_AUDIO_SR_48000, SD_AUDIO_SAMPLE_WIDTH_24BITS, SD_AUDIO_I2S_DSP_B},

    {SD_AUDIO_TRANSFER_CODEC_SLAVE | SD_AUDIO_DIR_MODE_MULTI_CHAN_RECEIVE | SD_AUDIO_CHANNEL_NUM_RX_8CHANS, SD_AUDIO_SR_48000, SD_AUDIO_SAMPLE_WIDTH_32BITS, SD_AUDIO_I2S_STANDARD_PHILLIPS},
    {SD_AUDIO_TRANSFER_CODEC_SLAVE | SD_AUDIO_DIR_MODE_MULTI_CHAN_RECEIVE | SD_AUDIO_CHANNEL_NUM_RX_8CHANS, SD_AUDIO_SR_48000, SD_AUDIO_SAMPLE_WIDTH_32BITS, SD_AUDIO_I2S_LEFT_JUSTIFIED},
    {SD_AUDIO_TRANSFER_CODEC_SLAVE | SD_AUDIO_DIR_MODE_MULTI_CHAN_RECEIVE | SD_AUDIO_CHANNEL_NUM_RX_8CHANS, SD_AUDIO_SR_48000, SD_AUDIO_SAMPLE_WIDTH_32BITS, SD_AUDIO_I2S_RIGHT_JUSTIFIED},
    {SD_AUDIO_TRANSFER_CODEC_SLAVE | SD_AUDIO_DIR_MODE_MULTI_CHAN_RECEIVE | SD_AUDIO_CHANNEL_NUM_RX_8CHANS, SD_AUDIO_SR_48000, SD_AUDIO_SAMPLE_WIDTH_32BITS, SD_AUDIO_I2S_DSP_A},
    {SD_AUDIO_TRANSFER_CODEC_SLAVE | SD_AUDIO_DIR_MODE_MULTI_CHAN_RECEIVE | SD_AUDIO_CHANNEL_NUM_RX_8CHANS, SD_AUDIO_SR_48000, SD_AUDIO_SAMPLE_WIDTH_32BITS, SD_AUDIO_I2S_DSP_B},


///////////////////////////////////////////////////////////////////////////////////////////////////////////////////////////////////////////////////////////////////////////////////////////
//case 761~780
    {SD_AUDIO_TRANSFER_CODEC_SLAVE | SD_AUDIO_DIR_MODE_MULTI_CHAN_RECEIVE | SD_AUDIO_CHANNEL_NUM_RX_8CHANS, SD_AUDIO_SR_96000, SD_AUDIO_SAMPLE_WIDTH_8BITS, SD_AUDIO_I2S_STANDARD_PHILLIPS},
    {SD_AUDIO_TRANSFER_CODEC_SLAVE | SD_AUDIO_DIR_MODE_MULTI_CHAN_RECEIVE | SD_AUDIO_CHANNEL_NUM_RX_8CHANS, SD_AUDIO_SR_96000, SD_AUDIO_SAMPLE_WIDTH_8BITS, SD_AUDIO_I2S_LEFT_JUSTIFIED},
    {SD_AUDIO_TRANSFER_CODEC_SLAVE | SD_AUDIO_DIR_MODE_MULTI_CHAN_RECEIVE | SD_AUDIO_CHANNEL_NUM_RX_8CHANS, SD_AUDIO_SR_96000, SD_AUDIO_SAMPLE_WIDTH_8BITS, SD_AUDIO_I2S_RIGHT_JUSTIFIED},
    {SD_AUDIO_TRANSFER_CODEC_SLAVE | SD_AUDIO_DIR_MODE_MULTI_CHAN_RECEIVE | SD_AUDIO_CHANNEL_NUM_RX_8CHANS, SD_AUDIO_SR_96000, SD_AUDIO_SAMPLE_WIDTH_8BITS, SD_AUDIO_I2S_DSP_A},
    {SD_AUDIO_TRANSFER_CODEC_SLAVE | SD_AUDIO_DIR_MODE_MULTI_CHAN_RECEIVE | SD_AUDIO_CHANNEL_NUM_RX_8CHANS, SD_AUDIO_SR_96000, SD_AUDIO_SAMPLE_WIDTH_8BITS, SD_AUDIO_I2S_DSP_B},

    {SD_AUDIO_TRANSFER_CODEC_SLAVE | SD_AUDIO_DIR_MODE_MULTI_CHAN_RECEIVE | SD_AUDIO_CHANNEL_NUM_RX_8CHANS, SD_AUDIO_SR_96000, SD_AUDIO_SAMPLE_WIDTH_16BITS, SD_AUDIO_I2S_STANDARD_PHILLIPS},
    {SD_AUDIO_TRANSFER_CODEC_SLAVE | SD_AUDIO_DIR_MODE_MULTI_CHAN_RECEIVE | SD_AUDIO_CHANNEL_NUM_RX_8CHANS, SD_AUDIO_SR_96000, SD_AUDIO_SAMPLE_WIDTH_16BITS, SD_AUDIO_I2S_LEFT_JUSTIFIED},
    {SD_AUDIO_TRANSFER_CODEC_SLAVE | SD_AUDIO_DIR_MODE_MULTI_CHAN_RECEIVE | SD_AUDIO_CHANNEL_NUM_RX_8CHANS, SD_AUDIO_SR_96000, SD_AUDIO_SAMPLE_WIDTH_16BITS, SD_AUDIO_I2S_RIGHT_JUSTIFIED},
    {SD_AUDIO_TRANSFER_CODEC_SLAVE | SD_AUDIO_DIR_MODE_MULTI_CHAN_RECEIVE | SD_AUDIO_CHANNEL_NUM_RX_8CHANS, SD_AUDIO_SR_96000, SD_AUDIO_SAMPLE_WIDTH_16BITS, SD_AUDIO_I2S_DSP_A},
    {SD_AUDIO_TRANSFER_CODEC_SLAVE | SD_AUDIO_DIR_MODE_MULTI_CHAN_RECEIVE | SD_AUDIO_CHANNEL_NUM_RX_8CHANS, SD_AUDIO_SR_96000, SD_AUDIO_SAMPLE_WIDTH_16BITS, SD_AUDIO_I2S_DSP_B},

    {SD_AUDIO_TRANSFER_CODEC_SLAVE | SD_AUDIO_DIR_MODE_MULTI_CHAN_RECEIVE | SD_AUDIO_CHANNEL_NUM_RX_8CHANS, SD_AUDIO_SR_96000, SD_AUDIO_SAMPLE_WIDTH_24BITS, SD_AUDIO_I2S_STANDARD_PHILLIPS},
    {SD_AUDIO_TRANSFER_CODEC_SLAVE | SD_AUDIO_DIR_MODE_MULTI_CHAN_RECEIVE | SD_AUDIO_CHANNEL_NUM_RX_8CHANS, SD_AUDIO_SR_96000, SD_AUDIO_SAMPLE_WIDTH_24BITS, SD_AUDIO_I2S_LEFT_JUSTIFIED},
    {SD_AUDIO_TRANSFER_CODEC_SLAVE | SD_AUDIO_DIR_MODE_MULTI_CHAN_RECEIVE | SD_AUDIO_CHANNEL_NUM_RX_8CHANS, SD_AUDIO_SR_96000, SD_AUDIO_SAMPLE_WIDTH_24BITS, SD_AUDIO_I2S_RIGHT_JUSTIFIED},
    {SD_AUDIO_TRANSFER_CODEC_SLAVE | SD_AUDIO_DIR_MODE_MULTI_CHAN_RECEIVE | SD_AUDIO_CHANNEL_NUM_RX_8CHANS, SD_AUDIO_SR_96000, SD_AUDIO_SAMPLE_WIDTH_24BITS, SD_AUDIO_I2S_DSP_A},
    {SD_AUDIO_TRANSFER_CODEC_SLAVE | SD_AUDIO_DIR_MODE_MULTI_CHAN_RECEIVE | SD_AUDIO_CHANNEL_NUM_RX_8CHANS, SD_AUDIO_SR_96000, SD_AUDIO_SAMPLE_WIDTH_24BITS, SD_AUDIO_I2S_DSP_B},

    {SD_AUDIO_TRANSFER_CODEC_SLAVE | SD_AUDIO_DIR_MODE_MULTI_CHAN_RECEIVE | SD_AUDIO_CHANNEL_NUM_RX_8CHANS, SD_AUDIO_SR_96000, SD_AUDIO_SAMPLE_WIDTH_32BITS, SD_AUDIO_I2S_STANDARD_PHILLIPS},
    {SD_AUDIO_TRANSFER_CODEC_SLAVE | SD_AUDIO_DIR_MODE_MULTI_CHAN_RECEIVE | SD_AUDIO_CHANNEL_NUM_RX_8CHANS, SD_AUDIO_SR_96000, SD_AUDIO_SAMPLE_WIDTH_32BITS, SD_AUDIO_I2S_LEFT_JUSTIFIED},
    {SD_AUDIO_TRANSFER_CODEC_SLAVE | SD_AUDIO_DIR_MODE_MULTI_CHAN_RECEIVE | SD_AUDIO_CHANNEL_NUM_RX_8CHANS, SD_AUDIO_SR_96000, SD_AUDIO_SAMPLE_WIDTH_32BITS, SD_AUDIO_I2S_RIGHT_JUSTIFIED},
    {SD_AUDIO_TRANSFER_CODEC_SLAVE | SD_AUDIO_DIR_MODE_MULTI_CHAN_RECEIVE | SD_AUDIO_CHANNEL_NUM_RX_8CHANS, SD_AUDIO_SR_96000, SD_AUDIO_SAMPLE_WIDTH_32BITS, SD_AUDIO_I2S_DSP_A},
    {SD_AUDIO_TRANSFER_CODEC_SLAVE | SD_AUDIO_DIR_MODE_MULTI_CHAN_RECEIVE | SD_AUDIO_CHANNEL_NUM_RX_8CHANS, SD_AUDIO_SR_96000, SD_AUDIO_SAMPLE_WIDTH_32BITS, SD_AUDIO_I2S_DSP_B},


///////////////////////////////////////////////////////////////////////////////////////////////////////////////////////////////////////////////////////////////////////////////////////////
//case 781~800
    {SD_AUDIO_TRANSFER_CODEC_SLAVE | SD_AUDIO_DIR_MODE_MULTI_CHAN_RECEIVE | SD_AUDIO_CHANNEL_NUM_RX_8CHANS, SD_AUDIO_SR_192000, SD_AUDIO_SAMPLE_WIDTH_8BITS, SD_AUDIO_I2S_STANDARD_PHILLIPS},
    {SD_AUDIO_TRANSFER_CODEC_SLAVE | SD_AUDIO_DIR_MODE_MULTI_CHAN_RECEIVE | SD_AUDIO_CHANNEL_NUM_RX_8CHANS, SD_AUDIO_SR_192000, SD_AUDIO_SAMPLE_WIDTH_8BITS, SD_AUDIO_I2S_LEFT_JUSTIFIED},
    {SD_AUDIO_TRANSFER_CODEC_SLAVE | SD_AUDIO_DIR_MODE_MULTI_CHAN_RECEIVE | SD_AUDIO_CHANNEL_NUM_RX_8CHANS, SD_AUDIO_SR_192000, SD_AUDIO_SAMPLE_WIDTH_8BITS, SD_AUDIO_I2S_RIGHT_JUSTIFIED},
    {SD_AUDIO_TRANSFER_CODEC_SLAVE | SD_AUDIO_DIR_MODE_MULTI_CHAN_RECEIVE | SD_AUDIO_CHANNEL_NUM_RX_8CHANS, SD_AUDIO_SR_192000, SD_AUDIO_SAMPLE_WIDTH_8BITS, SD_AUDIO_I2S_DSP_A},
    {SD_AUDIO_TRANSFER_CODEC_SLAVE | SD_AUDIO_DIR_MODE_MULTI_CHAN_RECEIVE | SD_AUDIO_CHANNEL_NUM_RX_8CHANS, SD_AUDIO_SR_192000, SD_AUDIO_SAMPLE_WIDTH_8BITS, SD_AUDIO_I2S_DSP_B},

    {SD_AUDIO_TRANSFER_CODEC_SLAVE | SD_AUDIO_DIR_MODE_MULTI_CHAN_RECEIVE | SD_AUDIO_CHANNEL_NUM_RX_8CHANS, SD_AUDIO_SR_192000, SD_AUDIO_SAMPLE_WIDTH_16BITS, SD_AUDIO_I2S_STANDARD_PHILLIPS},
    {SD_AUDIO_TRANSFER_CODEC_SLAVE | SD_AUDIO_DIR_MODE_MULTI_CHAN_RECEIVE | SD_AUDIO_CHANNEL_NUM_RX_8CHANS, SD_AUDIO_SR_192000, SD_AUDIO_SAMPLE_WIDTH_16BITS, SD_AUDIO_I2S_LEFT_JUSTIFIED},
    {SD_AUDIO_TRANSFER_CODEC_SLAVE | SD_AUDIO_DIR_MODE_MULTI_CHAN_RECEIVE | SD_AUDIO_CHANNEL_NUM_RX_8CHANS, SD_AUDIO_SR_192000, SD_AUDIO_SAMPLE_WIDTH_16BITS, SD_AUDIO_I2S_RIGHT_JUSTIFIED},
    {SD_AUDIO_TRANSFER_CODEC_SLAVE | SD_AUDIO_DIR_MODE_MULTI_CHAN_RECEIVE | SD_AUDIO_CHANNEL_NUM_RX_8CHANS, SD_AUDIO_SR_192000, SD_AUDIO_SAMPLE_WIDTH_16BITS, SD_AUDIO_I2S_DSP_A},
    {SD_AUDIO_TRANSFER_CODEC_SLAVE | SD_AUDIO_DIR_MODE_MULTI_CHAN_RECEIVE | SD_AUDIO_CHANNEL_NUM_RX_8CHANS, SD_AUDIO_SR_192000, SD_AUDIO_SAMPLE_WIDTH_16BITS, SD_AUDIO_I2S_DSP_B},

    {SD_AUDIO_TRANSFER_CODEC_SLAVE | SD_AUDIO_DIR_MODE_MULTI_CHAN_RECEIVE | SD_AUDIO_CHANNEL_NUM_RX_8CHANS, SD_AUDIO_SR_192000, SD_AUDIO_SAMPLE_WIDTH_24BITS, SD_AUDIO_I2S_STANDARD_PHILLIPS},
    {SD_AUDIO_TRANSFER_CODEC_SLAVE | SD_AUDIO_DIR_MODE_MULTI_CHAN_RECEIVE | SD_AUDIO_CHANNEL_NUM_RX_8CHANS, SD_AUDIO_SR_192000, SD_AUDIO_SAMPLE_WIDTH_24BITS, SD_AUDIO_I2S_LEFT_JUSTIFIED},
    {SD_AUDIO_TRANSFER_CODEC_SLAVE | SD_AUDIO_DIR_MODE_MULTI_CHAN_RECEIVE | SD_AUDIO_CHANNEL_NUM_RX_8CHANS, SD_AUDIO_SR_192000, SD_AUDIO_SAMPLE_WIDTH_24BITS, SD_AUDIO_I2S_RIGHT_JUSTIFIED},
    {SD_AUDIO_TRANSFER_CODEC_SLAVE | SD_AUDIO_DIR_MODE_MULTI_CHAN_RECEIVE | SD_AUDIO_CHANNEL_NUM_RX_8CHANS, SD_AUDIO_SR_192000, SD_AUDIO_SAMPLE_WIDTH_24BITS, SD_AUDIO_I2S_DSP_A},
    {SD_AUDIO_TRANSFER_CODEC_SLAVE | SD_AUDIO_DIR_MODE_MULTI_CHAN_RECEIVE | SD_AUDIO_CHANNEL_NUM_RX_8CHANS, SD_AUDIO_SR_192000, SD_AUDIO_SAMPLE_WIDTH_24BITS, SD_AUDIO_I2S_DSP_B},

    {SD_AUDIO_TRANSFER_CODEC_SLAVE | SD_AUDIO_DIR_MODE_MULTI_CHAN_RECEIVE | SD_AUDIO_CHANNEL_NUM_RX_8CHANS, SD_AUDIO_SR_192000, SD_AUDIO_SAMPLE_WIDTH_32BITS, SD_AUDIO_I2S_STANDARD_PHILLIPS},
    {SD_AUDIO_TRANSFER_CODEC_SLAVE | SD_AUDIO_DIR_MODE_MULTI_CHAN_RECEIVE | SD_AUDIO_CHANNEL_NUM_RX_8CHANS, SD_AUDIO_SR_192000, SD_AUDIO_SAMPLE_WIDTH_32BITS, SD_AUDIO_I2S_LEFT_JUSTIFIED},
    {SD_AUDIO_TRANSFER_CODEC_SLAVE | SD_AUDIO_DIR_MODE_MULTI_CHAN_RECEIVE | SD_AUDIO_CHANNEL_NUM_RX_8CHANS, SD_AUDIO_SR_192000, SD_AUDIO_SAMPLE_WIDTH_32BITS, SD_AUDIO_I2S_RIGHT_JUSTIFIED},
    {SD_AUDIO_TRANSFER_CODEC_SLAVE | SD_AUDIO_DIR_MODE_MULTI_CHAN_RECEIVE | SD_AUDIO_CHANNEL_NUM_RX_8CHANS, SD_AUDIO_SR_192000, SD_AUDIO_SAMPLE_WIDTH_32BITS, SD_AUDIO_I2S_DSP_A},
    {SD_AUDIO_TRANSFER_CODEC_SLAVE | SD_AUDIO_DIR_MODE_MULTI_CHAN_RECEIVE | SD_AUDIO_CHANNEL_NUM_RX_8CHANS, SD_AUDIO_SR_192000, SD_AUDIO_SAMPLE_WIDTH_32BITS, SD_AUDIO_I2S_DSP_B},



///////////////////////////////////////////////////////////////////////////////mode 11/////////////////////////////////////////////////////////////////////////////////////////////////

//case 801~820
    {SD_AUDIO_TRANSFER_CODEC_SLAVE | SD_AUDIO_DIR_MODE_MULTI_CHAN_FULL_DUPLEX | SD_AUDIO_CHANNEL_NUM_TX_4CHANS, SD_AUDIO_SR_44100, SD_AUDIO_SAMPLE_WIDTH_8BITS, SD_AUDIO_I2S_STANDARD_PHILLIPS},
    {SD_AUDIO_TRANSFER_CODEC_SLAVE | SD_AUDIO_DIR_MODE_MULTI_CHAN_FULL_DUPLEX | SD_AUDIO_CHANNEL_NUM_TX_4CHANS, SD_AUDIO_SR_44100, SD_AUDIO_SAMPLE_WIDTH_8BITS, SD_AUDIO_I2S_LEFT_JUSTIFIED},
    {SD_AUDIO_TRANSFER_CODEC_SLAVE | SD_AUDIO_DIR_MODE_MULTI_CHAN_FULL_DUPLEX | SD_AUDIO_CHANNEL_NUM_TX_4CHANS, SD_AUDIO_SR_44100, SD_AUDIO_SAMPLE_WIDTH_8BITS, SD_AUDIO_I2S_RIGHT_JUSTIFIED},
    {SD_AUDIO_TRANSFER_CODEC_SLAVE | SD_AUDIO_DIR_MODE_MULTI_CHAN_FULL_DUPLEX | SD_AUDIO_CHANNEL_NUM_TX_4CHANS, SD_AUDIO_SR_44100, SD_AUDIO_SAMPLE_WIDTH_8BITS, SD_AUDIO_I2S_DSP_A},
    {SD_AUDIO_TRANSFER_CODEC_SLAVE | SD_AUDIO_DIR_MODE_MULTI_CHAN_FULL_DUPLEX | SD_AUDIO_CHANNEL_NUM_TX_4CHANS, SD_AUDIO_SR_44100, SD_AUDIO_SAMPLE_WIDTH_8BITS, SD_AUDIO_I2S_DSP_B},

    {SD_AUDIO_TRANSFER_CODEC_SLAVE | SD_AUDIO_DIR_MODE_MULTI_CHAN_FULL_DUPLEX | SD_AUDIO_CHANNEL_NUM_TX_4CHANS, SD_AUDIO_SR_44100, SD_AUDIO_SAMPLE_WIDTH_16BITS, SD_AUDIO_I2S_STANDARD_PHILLIPS},
    {SD_AUDIO_TRANSFER_CODEC_SLAVE | SD_AUDIO_DIR_MODE_MULTI_CHAN_FULL_DUPLEX | SD_AUDIO_CHANNEL_NUM_TX_4CHANS, SD_AUDIO_SR_44100, SD_AUDIO_SAMPLE_WIDTH_16BITS, SD_AUDIO_I2S_LEFT_JUSTIFIED},
    {SD_AUDIO_TRANSFER_CODEC_SLAVE | SD_AUDIO_DIR_MODE_MULTI_CHAN_FULL_DUPLEX | SD_AUDIO_CHANNEL_NUM_TX_4CHANS, SD_AUDIO_SR_44100, SD_AUDIO_SAMPLE_WIDTH_16BITS, SD_AUDIO_I2S_RIGHT_JUSTIFIED},
    {SD_AUDIO_TRANSFER_CODEC_SLAVE | SD_AUDIO_DIR_MODE_MULTI_CHAN_FULL_DUPLEX | SD_AUDIO_CHANNEL_NUM_TX_4CHANS, SD_AUDIO_SR_44100, SD_AUDIO_SAMPLE_WIDTH_16BITS, SD_AUDIO_I2S_DSP_A},
    {SD_AUDIO_TRANSFER_CODEC_SLAVE | SD_AUDIO_DIR_MODE_MULTI_CHAN_FULL_DUPLEX | SD_AUDIO_CHANNEL_NUM_TX_4CHANS, SD_AUDIO_SR_44100, SD_AUDIO_SAMPLE_WIDTH_16BITS, SD_AUDIO_I2S_DSP_B},

    {SD_AUDIO_TRANSFER_CODEC_SLAVE | SD_AUDIO_DIR_MODE_MULTI_CHAN_FULL_DUPLEX | SD_AUDIO_CHANNEL_NUM_TX_4CHANS, SD_AUDIO_SR_44100, SD_AUDIO_SAMPLE_WIDTH_24BITS, SD_AUDIO_I2S_STANDARD_PHILLIPS},
    {SD_AUDIO_TRANSFER_CODEC_SLAVE | SD_AUDIO_DIR_MODE_MULTI_CHAN_FULL_DUPLEX | SD_AUDIO_CHANNEL_NUM_TX_4CHANS, SD_AUDIO_SR_44100, SD_AUDIO_SAMPLE_WIDTH_24BITS, SD_AUDIO_I2S_LEFT_JUSTIFIED},
    {SD_AUDIO_TRANSFER_CODEC_SLAVE | SD_AUDIO_DIR_MODE_MULTI_CHAN_FULL_DUPLEX | SD_AUDIO_CHANNEL_NUM_TX_4CHANS, SD_AUDIO_SR_44100, SD_AUDIO_SAMPLE_WIDTH_24BITS, SD_AUDIO_I2S_RIGHT_JUSTIFIED},
    {SD_AUDIO_TRANSFER_CODEC_SLAVE | SD_AUDIO_DIR_MODE_MULTI_CHAN_FULL_DUPLEX | SD_AUDIO_CHANNEL_NUM_TX_4CHANS, SD_AUDIO_SR_44100, SD_AUDIO_SAMPLE_WIDTH_24BITS, SD_AUDIO_I2S_DSP_A},
    {SD_AUDIO_TRANSFER_CODEC_SLAVE | SD_AUDIO_DIR_MODE_MULTI_CHAN_FULL_DUPLEX | SD_AUDIO_CHANNEL_NUM_TX_4CHANS, SD_AUDIO_SR_44100, SD_AUDIO_SAMPLE_WIDTH_24BITS, SD_AUDIO_I2S_DSP_B},

    {SD_AUDIO_TRANSFER_CODEC_SLAVE | SD_AUDIO_DIR_MODE_MULTI_CHAN_FULL_DUPLEX | SD_AUDIO_CHANNEL_NUM_TX_4CHANS, SD_AUDIO_SR_44100, SD_AUDIO_SAMPLE_WIDTH_32BITS, SD_AUDIO_I2S_STANDARD_PHILLIPS},
    {SD_AUDIO_TRANSFER_CODEC_SLAVE | SD_AUDIO_DIR_MODE_MULTI_CHAN_FULL_DUPLEX | SD_AUDIO_CHANNEL_NUM_TX_4CHANS, SD_AUDIO_SR_44100, SD_AUDIO_SAMPLE_WIDTH_32BITS, SD_AUDIO_I2S_LEFT_JUSTIFIED},
    {SD_AUDIO_TRANSFER_CODEC_SLAVE | SD_AUDIO_DIR_MODE_MULTI_CHAN_FULL_DUPLEX | SD_AUDIO_CHANNEL_NUM_TX_4CHANS, SD_AUDIO_SR_44100, SD_AUDIO_SAMPLE_WIDTH_32BITS, SD_AUDIO_I2S_RIGHT_JUSTIFIED},
    {SD_AUDIO_TRANSFER_CODEC_SLAVE | SD_AUDIO_DIR_MODE_MULTI_CHAN_FULL_DUPLEX | SD_AUDIO_CHANNEL_NUM_TX_4CHANS, SD_AUDIO_SR_44100, SD_AUDIO_SAMPLE_WIDTH_32BITS, SD_AUDIO_I2S_DSP_A},
    {SD_AUDIO_TRANSFER_CODEC_SLAVE | SD_AUDIO_DIR_MODE_MULTI_CHAN_FULL_DUPLEX | SD_AUDIO_CHANNEL_NUM_TX_4CHANS, SD_AUDIO_SR_44100, SD_AUDIO_SAMPLE_WIDTH_32BITS, SD_AUDIO_I2S_DSP_B},

///////////////////////////////////////////////////////////////////////////////////////////////////////////////////////////////////////////////////////////////////////////////////////////////
//case 821~840
    {SD_AUDIO_TRANSFER_CODEC_SLAVE | SD_AUDIO_DIR_MODE_MULTI_CHAN_FULL_DUPLEX | SD_AUDIO_CHANNEL_NUM_TX_4CHANS, SD_AUDIO_SR_48000, SD_AUDIO_SAMPLE_WIDTH_8BITS, SD_AUDIO_I2S_STANDARD_PHILLIPS},
    {SD_AUDIO_TRANSFER_CODEC_SLAVE | SD_AUDIO_DIR_MODE_MULTI_CHAN_FULL_DUPLEX | SD_AUDIO_CHANNEL_NUM_TX_4CHANS, SD_AUDIO_SR_48000, SD_AUDIO_SAMPLE_WIDTH_8BITS, SD_AUDIO_I2S_LEFT_JUSTIFIED},
    {SD_AUDIO_TRANSFER_CODEC_SLAVE | SD_AUDIO_DIR_MODE_MULTI_CHAN_FULL_DUPLEX | SD_AUDIO_CHANNEL_NUM_TX_4CHANS, SD_AUDIO_SR_48000, SD_AUDIO_SAMPLE_WIDTH_8BITS, SD_AUDIO_I2S_RIGHT_JUSTIFIED},
    {SD_AUDIO_TRANSFER_CODEC_SLAVE | SD_AUDIO_DIR_MODE_MULTI_CHAN_FULL_DUPLEX | SD_AUDIO_CHANNEL_NUM_TX_4CHANS, SD_AUDIO_SR_48000, SD_AUDIO_SAMPLE_WIDTH_8BITS, SD_AUDIO_I2S_DSP_A},
    {SD_AUDIO_TRANSFER_CODEC_SLAVE | SD_AUDIO_DIR_MODE_MULTI_CHAN_FULL_DUPLEX | SD_AUDIO_CHANNEL_NUM_TX_4CHANS, SD_AUDIO_SR_48000, SD_AUDIO_SAMPLE_WIDTH_8BITS, SD_AUDIO_I2S_DSP_B},

    {SD_AUDIO_TRANSFER_CODEC_SLAVE | SD_AUDIO_DIR_MODE_MULTI_CHAN_FULL_DUPLEX | SD_AUDIO_CHANNEL_NUM_TX_4CHANS, SD_AUDIO_SR_48000, SD_AUDIO_SAMPLE_WIDTH_16BITS, SD_AUDIO_I2S_STANDARD_PHILLIPS},
    {SD_AUDIO_TRANSFER_CODEC_SLAVE | SD_AUDIO_DIR_MODE_MULTI_CHAN_FULL_DUPLEX | SD_AUDIO_CHANNEL_NUM_TX_4CHANS, SD_AUDIO_SR_48000, SD_AUDIO_SAMPLE_WIDTH_16BITS, SD_AUDIO_I2S_LEFT_JUSTIFIED},
    {SD_AUDIO_TRANSFER_CODEC_SLAVE | SD_AUDIO_DIR_MODE_MULTI_CHAN_FULL_DUPLEX | SD_AUDIO_CHANNEL_NUM_TX_4CHANS, SD_AUDIO_SR_48000, SD_AUDIO_SAMPLE_WIDTH_16BITS, SD_AUDIO_I2S_RIGHT_JUSTIFIED},
    {SD_AUDIO_TRANSFER_CODEC_SLAVE | SD_AUDIO_DIR_MODE_MULTI_CHAN_FULL_DUPLEX | SD_AUDIO_CHANNEL_NUM_TX_4CHANS, SD_AUDIO_SR_48000, SD_AUDIO_SAMPLE_WIDTH_16BITS, SD_AUDIO_I2S_DSP_A},
    {SD_AUDIO_TRANSFER_CODEC_SLAVE | SD_AUDIO_DIR_MODE_MULTI_CHAN_FULL_DUPLEX | SD_AUDIO_CHANNEL_NUM_TX_4CHANS, SD_AUDIO_SR_48000, SD_AUDIO_SAMPLE_WIDTH_16BITS, SD_AUDIO_I2S_DSP_B},

    {SD_AUDIO_TRANSFER_CODEC_SLAVE | SD_AUDIO_DIR_MODE_MULTI_CHAN_FULL_DUPLEX | SD_AUDIO_CHANNEL_NUM_TX_4CHANS, SD_AUDIO_SR_48000, SD_AUDIO_SAMPLE_WIDTH_24BITS, SD_AUDIO_I2S_STANDARD_PHILLIPS},
    {SD_AUDIO_TRANSFER_CODEC_SLAVE | SD_AUDIO_DIR_MODE_MULTI_CHAN_FULL_DUPLEX | SD_AUDIO_CHANNEL_NUM_TX_4CHANS, SD_AUDIO_SR_48000, SD_AUDIO_SAMPLE_WIDTH_24BITS, SD_AUDIO_I2S_LEFT_JUSTIFIED},
    {SD_AUDIO_TRANSFER_CODEC_SLAVE | SD_AUDIO_DIR_MODE_MULTI_CHAN_FULL_DUPLEX | SD_AUDIO_CHANNEL_NUM_TX_4CHANS, SD_AUDIO_SR_48000, SD_AUDIO_SAMPLE_WIDTH_24BITS, SD_AUDIO_I2S_RIGHT_JUSTIFIED},
    {SD_AUDIO_TRANSFER_CODEC_SLAVE | SD_AUDIO_DIR_MODE_MULTI_CHAN_FULL_DUPLEX | SD_AUDIO_CHANNEL_NUM_TX_4CHANS, SD_AUDIO_SR_48000, SD_AUDIO_SAMPLE_WIDTH_24BITS, SD_AUDIO_I2S_DSP_A},
    {SD_AUDIO_TRANSFER_CODEC_SLAVE | SD_AUDIO_DIR_MODE_MULTI_CHAN_FULL_DUPLEX | SD_AUDIO_CHANNEL_NUM_TX_4CHANS, SD_AUDIO_SR_48000, SD_AUDIO_SAMPLE_WIDTH_24BITS, SD_AUDIO_I2S_DSP_B},

    {SD_AUDIO_TRANSFER_CODEC_SLAVE | SD_AUDIO_DIR_MODE_MULTI_CHAN_FULL_DUPLEX | SD_AUDIO_CHANNEL_NUM_TX_4CHANS, SD_AUDIO_SR_48000, SD_AUDIO_SAMPLE_WIDTH_32BITS, SD_AUDIO_I2S_STANDARD_PHILLIPS},
    {SD_AUDIO_TRANSFER_CODEC_SLAVE | SD_AUDIO_DIR_MODE_MULTI_CHAN_FULL_DUPLEX | SD_AUDIO_CHANNEL_NUM_TX_4CHANS, SD_AUDIO_SR_48000, SD_AUDIO_SAMPLE_WIDTH_32BITS, SD_AUDIO_I2S_LEFT_JUSTIFIED},
    {SD_AUDIO_TRANSFER_CODEC_SLAVE | SD_AUDIO_DIR_MODE_MULTI_CHAN_FULL_DUPLEX | SD_AUDIO_CHANNEL_NUM_TX_4CHANS, SD_AUDIO_SR_48000, SD_AUDIO_SAMPLE_WIDTH_32BITS, SD_AUDIO_I2S_RIGHT_JUSTIFIED},
    {SD_AUDIO_TRANSFER_CODEC_SLAVE | SD_AUDIO_DIR_MODE_MULTI_CHAN_FULL_DUPLEX | SD_AUDIO_CHANNEL_NUM_TX_4CHANS, SD_AUDIO_SR_48000, SD_AUDIO_SAMPLE_WIDTH_32BITS, SD_AUDIO_I2S_DSP_A},
    {SD_AUDIO_TRANSFER_CODEC_SLAVE | SD_AUDIO_DIR_MODE_MULTI_CHAN_FULL_DUPLEX | SD_AUDIO_CHANNEL_NUM_TX_4CHANS, SD_AUDIO_SR_48000, SD_AUDIO_SAMPLE_WIDTH_32BITS, SD_AUDIO_I2S_DSP_B},

///////////////////////////////////////////////////////////////////////////////////////////////////////////////////////////////////////////////////////////////////////////////////////////////
//case 841~860
    {SD_AUDIO_TRANSFER_CODEC_SLAVE | SD_AUDIO_DIR_MODE_MULTI_CHAN_FULL_DUPLEX | SD_AUDIO_CHANNEL_NUM_TX_4CHANS, SD_AUDIO_SR_96000, SD_AUDIO_SAMPLE_WIDTH_8BITS, SD_AUDIO_I2S_STANDARD_PHILLIPS},
    {SD_AUDIO_TRANSFER_CODEC_SLAVE | SD_AUDIO_DIR_MODE_MULTI_CHAN_FULL_DUPLEX | SD_AUDIO_CHANNEL_NUM_TX_4CHANS, SD_AUDIO_SR_96000, SD_AUDIO_SAMPLE_WIDTH_8BITS, SD_AUDIO_I2S_LEFT_JUSTIFIED},
    {SD_AUDIO_TRANSFER_CODEC_SLAVE | SD_AUDIO_DIR_MODE_MULTI_CHAN_FULL_DUPLEX | SD_AUDIO_CHANNEL_NUM_TX_4CHANS, SD_AUDIO_SR_96000, SD_AUDIO_SAMPLE_WIDTH_8BITS, SD_AUDIO_I2S_RIGHT_JUSTIFIED},
    {SD_AUDIO_TRANSFER_CODEC_SLAVE | SD_AUDIO_DIR_MODE_MULTI_CHAN_FULL_DUPLEX | SD_AUDIO_CHANNEL_NUM_TX_4CHANS, SD_AUDIO_SR_96000, SD_AUDIO_SAMPLE_WIDTH_8BITS, SD_AUDIO_I2S_DSP_A},
    {SD_AUDIO_TRANSFER_CODEC_SLAVE | SD_AUDIO_DIR_MODE_MULTI_CHAN_FULL_DUPLEX | SD_AUDIO_CHANNEL_NUM_TX_4CHANS, SD_AUDIO_SR_96000, SD_AUDIO_SAMPLE_WIDTH_8BITS, SD_AUDIO_I2S_DSP_B},

    {SD_AUDIO_TRANSFER_CODEC_SLAVE | SD_AUDIO_DIR_MODE_MULTI_CHAN_FULL_DUPLEX | SD_AUDIO_CHANNEL_NUM_TX_4CHANS, SD_AUDIO_SR_96000, SD_AUDIO_SAMPLE_WIDTH_16BITS, SD_AUDIO_I2S_STANDARD_PHILLIPS},
    {SD_AUDIO_TRANSFER_CODEC_SLAVE | SD_AUDIO_DIR_MODE_MULTI_CHAN_FULL_DUPLEX | SD_AUDIO_CHANNEL_NUM_TX_4CHANS, SD_AUDIO_SR_96000, SD_AUDIO_SAMPLE_WIDTH_16BITS, SD_AUDIO_I2S_LEFT_JUSTIFIED},
    {SD_AUDIO_TRANSFER_CODEC_SLAVE | SD_AUDIO_DIR_MODE_MULTI_CHAN_FULL_DUPLEX | SD_AUDIO_CHANNEL_NUM_TX_4CHANS, SD_AUDIO_SR_96000, SD_AUDIO_SAMPLE_WIDTH_16BITS, SD_AUDIO_I2S_RIGHT_JUSTIFIED},
    {SD_AUDIO_TRANSFER_CODEC_SLAVE | SD_AUDIO_DIR_MODE_MULTI_CHAN_FULL_DUPLEX | SD_AUDIO_CHANNEL_NUM_TX_4CHANS, SD_AUDIO_SR_96000, SD_AUDIO_SAMPLE_WIDTH_16BITS, SD_AUDIO_I2S_DSP_A},
    {SD_AUDIO_TRANSFER_CODEC_SLAVE | SD_AUDIO_DIR_MODE_MULTI_CHAN_FULL_DUPLEX | SD_AUDIO_CHANNEL_NUM_TX_4CHANS, SD_AUDIO_SR_96000, SD_AUDIO_SAMPLE_WIDTH_16BITS, SD_AUDIO_I2S_DSP_B},

    {SD_AUDIO_TRANSFER_CODEC_SLAVE | SD_AUDIO_DIR_MODE_MULTI_CHAN_FULL_DUPLEX | SD_AUDIO_CHANNEL_NUM_TX_4CHANS, SD_AUDIO_SR_96000, SD_AUDIO_SAMPLE_WIDTH_24BITS, SD_AUDIO_I2S_STANDARD_PHILLIPS},
    {SD_AUDIO_TRANSFER_CODEC_SLAVE | SD_AUDIO_DIR_MODE_MULTI_CHAN_FULL_DUPLEX | SD_AUDIO_CHANNEL_NUM_TX_4CHANS, SD_AUDIO_SR_96000, SD_AUDIO_SAMPLE_WIDTH_24BITS, SD_AUDIO_I2S_LEFT_JUSTIFIED},
    {SD_AUDIO_TRANSFER_CODEC_SLAVE | SD_AUDIO_DIR_MODE_MULTI_CHAN_FULL_DUPLEX | SD_AUDIO_CHANNEL_NUM_TX_4CHANS, SD_AUDIO_SR_96000, SD_AUDIO_SAMPLE_WIDTH_24BITS, SD_AUDIO_I2S_RIGHT_JUSTIFIED},
    {SD_AUDIO_TRANSFER_CODEC_SLAVE | SD_AUDIO_DIR_MODE_MULTI_CHAN_FULL_DUPLEX | SD_AUDIO_CHANNEL_NUM_TX_4CHANS, SD_AUDIO_SR_96000, SD_AUDIO_SAMPLE_WIDTH_24BITS, SD_AUDIO_I2S_DSP_A},
    {SD_AUDIO_TRANSFER_CODEC_SLAVE | SD_AUDIO_DIR_MODE_MULTI_CHAN_FULL_DUPLEX | SD_AUDIO_CHANNEL_NUM_TX_4CHANS, SD_AUDIO_SR_96000, SD_AUDIO_SAMPLE_WIDTH_24BITS, SD_AUDIO_I2S_DSP_B},

    {SD_AUDIO_TRANSFER_CODEC_SLAVE | SD_AUDIO_DIR_MODE_MULTI_CHAN_FULL_DUPLEX | SD_AUDIO_CHANNEL_NUM_TX_4CHANS, SD_AUDIO_SR_96000, SD_AUDIO_SAMPLE_WIDTH_32BITS, SD_AUDIO_I2S_STANDARD_PHILLIPS},
    {SD_AUDIO_TRANSFER_CODEC_SLAVE | SD_AUDIO_DIR_MODE_MULTI_CHAN_FULL_DUPLEX | SD_AUDIO_CHANNEL_NUM_TX_4CHANS, SD_AUDIO_SR_96000, SD_AUDIO_SAMPLE_WIDTH_32BITS, SD_AUDIO_I2S_LEFT_JUSTIFIED},
    {SD_AUDIO_TRANSFER_CODEC_SLAVE | SD_AUDIO_DIR_MODE_MULTI_CHAN_FULL_DUPLEX | SD_AUDIO_CHANNEL_NUM_TX_4CHANS, SD_AUDIO_SR_96000, SD_AUDIO_SAMPLE_WIDTH_32BITS, SD_AUDIO_I2S_RIGHT_JUSTIFIED},
    {SD_AUDIO_TRANSFER_CODEC_SLAVE | SD_AUDIO_DIR_MODE_MULTI_CHAN_FULL_DUPLEX | SD_AUDIO_CHANNEL_NUM_TX_4CHANS, SD_AUDIO_SR_96000, SD_AUDIO_SAMPLE_WIDTH_32BITS, SD_AUDIO_I2S_DSP_A},
    {SD_AUDIO_TRANSFER_CODEC_SLAVE | SD_AUDIO_DIR_MODE_MULTI_CHAN_FULL_DUPLEX | SD_AUDIO_CHANNEL_NUM_TX_4CHANS, SD_AUDIO_SR_96000, SD_AUDIO_SAMPLE_WIDTH_32BITS, SD_AUDIO_I2S_DSP_B},

///////////////////////////////////////////////////////////////////////////////////////////////////////////////////////////////////////////////////////////////////////////////////////////////
//case 861~880
    {SD_AUDIO_TRANSFER_CODEC_SLAVE | SD_AUDIO_DIR_MODE_MULTI_CHAN_FULL_DUPLEX | SD_AUDIO_CHANNEL_NUM_TX_4CHANS, SD_AUDIO_SR_192000, SD_AUDIO_SAMPLE_WIDTH_8BITS, SD_AUDIO_I2S_STANDARD_PHILLIPS},
    {SD_AUDIO_TRANSFER_CODEC_SLAVE | SD_AUDIO_DIR_MODE_MULTI_CHAN_FULL_DUPLEX | SD_AUDIO_CHANNEL_NUM_TX_4CHANS, SD_AUDIO_SR_192000, SD_AUDIO_SAMPLE_WIDTH_8BITS, SD_AUDIO_I2S_LEFT_JUSTIFIED},
    {SD_AUDIO_TRANSFER_CODEC_SLAVE | SD_AUDIO_DIR_MODE_MULTI_CHAN_FULL_DUPLEX | SD_AUDIO_CHANNEL_NUM_TX_4CHANS, SD_AUDIO_SR_192000, SD_AUDIO_SAMPLE_WIDTH_8BITS, SD_AUDIO_I2S_RIGHT_JUSTIFIED},
    {SD_AUDIO_TRANSFER_CODEC_SLAVE | SD_AUDIO_DIR_MODE_MULTI_CHAN_FULL_DUPLEX | SD_AUDIO_CHANNEL_NUM_TX_4CHANS, SD_AUDIO_SR_192000, SD_AUDIO_SAMPLE_WIDTH_8BITS, SD_AUDIO_I2S_DSP_A},
    {SD_AUDIO_TRANSFER_CODEC_SLAVE | SD_AUDIO_DIR_MODE_MULTI_CHAN_FULL_DUPLEX | SD_AUDIO_CHANNEL_NUM_TX_4CHANS, SD_AUDIO_SR_192000, SD_AUDIO_SAMPLE_WIDTH_8BITS, SD_AUDIO_I2S_DSP_B},

    {SD_AUDIO_TRANSFER_CODEC_SLAVE | SD_AUDIO_DIR_MODE_MULTI_CHAN_FULL_DUPLEX | SD_AUDIO_CHANNEL_NUM_TX_4CHANS, SD_AUDIO_SR_192000, SD_AUDIO_SAMPLE_WIDTH_16BITS, SD_AUDIO_I2S_STANDARD_PHILLIPS},
    {SD_AUDIO_TRANSFER_CODEC_SLAVE | SD_AUDIO_DIR_MODE_MULTI_CHAN_FULL_DUPLEX | SD_AUDIO_CHANNEL_NUM_TX_4CHANS, SD_AUDIO_SR_192000, SD_AUDIO_SAMPLE_WIDTH_16BITS, SD_AUDIO_I2S_LEFT_JUSTIFIED},
    {SD_AUDIO_TRANSFER_CODEC_SLAVE | SD_AUDIO_DIR_MODE_MULTI_CHAN_FULL_DUPLEX | SD_AUDIO_CHANNEL_NUM_TX_4CHANS, SD_AUDIO_SR_192000, SD_AUDIO_SAMPLE_WIDTH_16BITS, SD_AUDIO_I2S_RIGHT_JUSTIFIED},
    {SD_AUDIO_TRANSFER_CODEC_SLAVE | SD_AUDIO_DIR_MODE_MULTI_CHAN_FULL_DUPLEX | SD_AUDIO_CHANNEL_NUM_TX_4CHANS, SD_AUDIO_SR_192000, SD_AUDIO_SAMPLE_WIDTH_16BITS, SD_AUDIO_I2S_DSP_A},
    {SD_AUDIO_TRANSFER_CODEC_SLAVE | SD_AUDIO_DIR_MODE_MULTI_CHAN_FULL_DUPLEX | SD_AUDIO_CHANNEL_NUM_TX_4CHANS, SD_AUDIO_SR_192000, SD_AUDIO_SAMPLE_WIDTH_16BITS, SD_AUDIO_I2S_DSP_B},

    {SD_AUDIO_TRANSFER_CODEC_SLAVE | SD_AUDIO_DIR_MODE_MULTI_CHAN_FULL_DUPLEX | SD_AUDIO_CHANNEL_NUM_TX_4CHANS, SD_AUDIO_SR_192000, SD_AUDIO_SAMPLE_WIDTH_24BITS, SD_AUDIO_I2S_STANDARD_PHILLIPS},
    {SD_AUDIO_TRANSFER_CODEC_SLAVE | SD_AUDIO_DIR_MODE_MULTI_CHAN_FULL_DUPLEX | SD_AUDIO_CHANNEL_NUM_TX_4CHANS, SD_AUDIO_SR_192000, SD_AUDIO_SAMPLE_WIDTH_24BITS, SD_AUDIO_I2S_LEFT_JUSTIFIED},
    {SD_AUDIO_TRANSFER_CODEC_SLAVE | SD_AUDIO_DIR_MODE_MULTI_CHAN_FULL_DUPLEX | SD_AUDIO_CHANNEL_NUM_TX_4CHANS, SD_AUDIO_SR_192000, SD_AUDIO_SAMPLE_WIDTH_24BITS, SD_AUDIO_I2S_RIGHT_JUSTIFIED},
    {SD_AUDIO_TRANSFER_CODEC_SLAVE | SD_AUDIO_DIR_MODE_MULTI_CHAN_FULL_DUPLEX | SD_AUDIO_CHANNEL_NUM_TX_4CHANS, SD_AUDIO_SR_192000, SD_AUDIO_SAMPLE_WIDTH_24BITS, SD_AUDIO_I2S_DSP_A},
    {SD_AUDIO_TRANSFER_CODEC_SLAVE | SD_AUDIO_DIR_MODE_MULTI_CHAN_FULL_DUPLEX | SD_AUDIO_CHANNEL_NUM_TX_4CHANS, SD_AUDIO_SR_192000, SD_AUDIO_SAMPLE_WIDTH_24BITS, SD_AUDIO_I2S_DSP_B},

    {SD_AUDIO_TRANSFER_CODEC_SLAVE | SD_AUDIO_DIR_MODE_MULTI_CHAN_FULL_DUPLEX | SD_AUDIO_CHANNEL_NUM_TX_4CHANS, SD_AUDIO_SR_192000, SD_AUDIO_SAMPLE_WIDTH_32BITS, SD_AUDIO_I2S_STANDARD_PHILLIPS},
    {SD_AUDIO_TRANSFER_CODEC_SLAVE | SD_AUDIO_DIR_MODE_MULTI_CHAN_FULL_DUPLEX | SD_AUDIO_CHANNEL_NUM_TX_4CHANS, SD_AUDIO_SR_192000, SD_AUDIO_SAMPLE_WIDTH_32BITS, SD_AUDIO_I2S_LEFT_JUSTIFIED},
    {SD_AUDIO_TRANSFER_CODEC_SLAVE | SD_AUDIO_DIR_MODE_MULTI_CHAN_FULL_DUPLEX | SD_AUDIO_CHANNEL_NUM_TX_4CHANS, SD_AUDIO_SR_192000, SD_AUDIO_SAMPLE_WIDTH_32BITS, SD_AUDIO_I2S_RIGHT_JUSTIFIED},
    {SD_AUDIO_TRANSFER_CODEC_SLAVE | SD_AUDIO_DIR_MODE_MULTI_CHAN_FULL_DUPLEX | SD_AUDIO_CHANNEL_NUM_TX_4CHANS, SD_AUDIO_SR_192000, SD_AUDIO_SAMPLE_WIDTH_32BITS, SD_AUDIO_I2S_DSP_A},
    {SD_AUDIO_TRANSFER_CODEC_SLAVE | SD_AUDIO_DIR_MODE_MULTI_CHAN_FULL_DUPLEX | SD_AUDIO_CHANNEL_NUM_TX_4CHANS, SD_AUDIO_SR_192000, SD_AUDIO_SAMPLE_WIDTH_32BITS, SD_AUDIO_I2S_DSP_B},


///////////////////////////////////////////////////////////////////////////////mode 12/////////////////////////////////////////////////////////////////////////////////////////////////

//case 881~900
    {SD_AUDIO_TRANSFER_CODEC_SLAVE | SD_AUDIO_DIR_MODE_MULTI_CHAN_FULL_DUPLEX | SD_AUDIO_CHANNEL_NUM_TX_8CHANS, SD_AUDIO_SR_44100, SD_AUDIO_SAMPLE_WIDTH_8BITS, SD_AUDIO_I2S_STANDARD_PHILLIPS},
    {SD_AUDIO_TRANSFER_CODEC_SLAVE | SD_AUDIO_DIR_MODE_MULTI_CHAN_FULL_DUPLEX | SD_AUDIO_CHANNEL_NUM_TX_8CHANS, SD_AUDIO_SR_44100, SD_AUDIO_SAMPLE_WIDTH_8BITS, SD_AUDIO_I2S_LEFT_JUSTIFIED},
    {SD_AUDIO_TRANSFER_CODEC_SLAVE | SD_AUDIO_DIR_MODE_MULTI_CHAN_FULL_DUPLEX | SD_AUDIO_CHANNEL_NUM_TX_8CHANS, SD_AUDIO_SR_44100, SD_AUDIO_SAMPLE_WIDTH_8BITS, SD_AUDIO_I2S_RIGHT_JUSTIFIED},
    {SD_AUDIO_TRANSFER_CODEC_SLAVE | SD_AUDIO_DIR_MODE_MULTI_CHAN_FULL_DUPLEX | SD_AUDIO_CHANNEL_NUM_TX_8CHANS, SD_AUDIO_SR_44100, SD_AUDIO_SAMPLE_WIDTH_8BITS, SD_AUDIO_I2S_DSP_A},
    {SD_AUDIO_TRANSFER_CODEC_SLAVE | SD_AUDIO_DIR_MODE_MULTI_CHAN_FULL_DUPLEX | SD_AUDIO_CHANNEL_NUM_TX_8CHANS, SD_AUDIO_SR_44100, SD_AUDIO_SAMPLE_WIDTH_8BITS, SD_AUDIO_I2S_DSP_B},

    {SD_AUDIO_TRANSFER_CODEC_SLAVE | SD_AUDIO_DIR_MODE_MULTI_CHAN_FULL_DUPLEX | SD_AUDIO_CHANNEL_NUM_TX_8CHANS, SD_AUDIO_SR_44100, SD_AUDIO_SAMPLE_WIDTH_16BITS, SD_AUDIO_I2S_STANDARD_PHILLIPS},
    {SD_AUDIO_TRANSFER_CODEC_SLAVE | SD_AUDIO_DIR_MODE_MULTI_CHAN_FULL_DUPLEX | SD_AUDIO_CHANNEL_NUM_TX_8CHANS, SD_AUDIO_SR_44100, SD_AUDIO_SAMPLE_WIDTH_16BITS, SD_AUDIO_I2S_LEFT_JUSTIFIED},
    {SD_AUDIO_TRANSFER_CODEC_SLAVE | SD_AUDIO_DIR_MODE_MULTI_CHAN_FULL_DUPLEX | SD_AUDIO_CHANNEL_NUM_TX_8CHANS, SD_AUDIO_SR_44100, SD_AUDIO_SAMPLE_WIDTH_16BITS, SD_AUDIO_I2S_RIGHT_JUSTIFIED},
    {SD_AUDIO_TRANSFER_CODEC_SLAVE | SD_AUDIO_DIR_MODE_MULTI_CHAN_FULL_DUPLEX | SD_AUDIO_CHANNEL_NUM_TX_8CHANS, SD_AUDIO_SR_44100, SD_AUDIO_SAMPLE_WIDTH_16BITS, SD_AUDIO_I2S_DSP_A},
    {SD_AUDIO_TRANSFER_CODEC_SLAVE | SD_AUDIO_DIR_MODE_MULTI_CHAN_FULL_DUPLEX | SD_AUDIO_CHANNEL_NUM_TX_8CHANS, SD_AUDIO_SR_44100, SD_AUDIO_SAMPLE_WIDTH_16BITS, SD_AUDIO_I2S_DSP_B},

    {SD_AUDIO_TRANSFER_CODEC_SLAVE | SD_AUDIO_DIR_MODE_MULTI_CHAN_FULL_DUPLEX | SD_AUDIO_CHANNEL_NUM_TX_8CHANS, SD_AUDIO_SR_44100, SD_AUDIO_SAMPLE_WIDTH_24BITS, SD_AUDIO_I2S_STANDARD_PHILLIPS},
    {SD_AUDIO_TRANSFER_CODEC_SLAVE | SD_AUDIO_DIR_MODE_MULTI_CHAN_FULL_DUPLEX | SD_AUDIO_CHANNEL_NUM_TX_8CHANS, SD_AUDIO_SR_44100, SD_AUDIO_SAMPLE_WIDTH_24BITS, SD_AUDIO_I2S_LEFT_JUSTIFIED},
    {SD_AUDIO_TRANSFER_CODEC_SLAVE | SD_AUDIO_DIR_MODE_MULTI_CHAN_FULL_DUPLEX | SD_AUDIO_CHANNEL_NUM_TX_8CHANS, SD_AUDIO_SR_44100, SD_AUDIO_SAMPLE_WIDTH_24BITS, SD_AUDIO_I2S_RIGHT_JUSTIFIED},
    {SD_AUDIO_TRANSFER_CODEC_SLAVE | SD_AUDIO_DIR_MODE_MULTI_CHAN_FULL_DUPLEX | SD_AUDIO_CHANNEL_NUM_TX_8CHANS, SD_AUDIO_SR_44100, SD_AUDIO_SAMPLE_WIDTH_24BITS, SD_AUDIO_I2S_DSP_A},
    {SD_AUDIO_TRANSFER_CODEC_SLAVE | SD_AUDIO_DIR_MODE_MULTI_CHAN_FULL_DUPLEX | SD_AUDIO_CHANNEL_NUM_TX_8CHANS, SD_AUDIO_SR_44100, SD_AUDIO_SAMPLE_WIDTH_24BITS, SD_AUDIO_I2S_DSP_B},

    {SD_AUDIO_TRANSFER_CODEC_SLAVE | SD_AUDIO_DIR_MODE_MULTI_CHAN_FULL_DUPLEX | SD_AUDIO_CHANNEL_NUM_TX_8CHANS, SD_AUDIO_SR_44100, SD_AUDIO_SAMPLE_WIDTH_32BITS, SD_AUDIO_I2S_STANDARD_PHILLIPS},
    {SD_AUDIO_TRANSFER_CODEC_SLAVE | SD_AUDIO_DIR_MODE_MULTI_CHAN_FULL_DUPLEX | SD_AUDIO_CHANNEL_NUM_TX_8CHANS, SD_AUDIO_SR_44100, SD_AUDIO_SAMPLE_WIDTH_32BITS, SD_AUDIO_I2S_LEFT_JUSTIFIED},
    {SD_AUDIO_TRANSFER_CODEC_SLAVE | SD_AUDIO_DIR_MODE_MULTI_CHAN_FULL_DUPLEX | SD_AUDIO_CHANNEL_NUM_TX_8CHANS, SD_AUDIO_SR_44100, SD_AUDIO_SAMPLE_WIDTH_32BITS, SD_AUDIO_I2S_RIGHT_JUSTIFIED},
    {SD_AUDIO_TRANSFER_CODEC_SLAVE | SD_AUDIO_DIR_MODE_MULTI_CHAN_FULL_DUPLEX | SD_AUDIO_CHANNEL_NUM_TX_8CHANS, SD_AUDIO_SR_44100, SD_AUDIO_SAMPLE_WIDTH_32BITS, SD_AUDIO_I2S_DSP_A},
    {SD_AUDIO_TRANSFER_CODEC_SLAVE | SD_AUDIO_DIR_MODE_MULTI_CHAN_FULL_DUPLEX | SD_AUDIO_CHANNEL_NUM_TX_8CHANS, SD_AUDIO_SR_44100, SD_AUDIO_SAMPLE_WIDTH_32BITS, SD_AUDIO_I2S_DSP_B},

///////////////////////////////////////////////////////////////////////////////////////////////////////////////////////////////////////////////////////////////////////////////////////////////
//case 901~920
    {SD_AUDIO_TRANSFER_CODEC_SLAVE | SD_AUDIO_DIR_MODE_MULTI_CHAN_FULL_DUPLEX | SD_AUDIO_CHANNEL_NUM_TX_8CHANS, SD_AUDIO_SR_48000, SD_AUDIO_SAMPLE_WIDTH_8BITS, SD_AUDIO_I2S_STANDARD_PHILLIPS},
    {SD_AUDIO_TRANSFER_CODEC_SLAVE | SD_AUDIO_DIR_MODE_MULTI_CHAN_FULL_DUPLEX | SD_AUDIO_CHANNEL_NUM_TX_8CHANS, SD_AUDIO_SR_48000, SD_AUDIO_SAMPLE_WIDTH_8BITS, SD_AUDIO_I2S_LEFT_JUSTIFIED},
    {SD_AUDIO_TRANSFER_CODEC_SLAVE | SD_AUDIO_DIR_MODE_MULTI_CHAN_FULL_DUPLEX | SD_AUDIO_CHANNEL_NUM_TX_8CHANS, SD_AUDIO_SR_48000, SD_AUDIO_SAMPLE_WIDTH_8BITS, SD_AUDIO_I2S_RIGHT_JUSTIFIED},
    {SD_AUDIO_TRANSFER_CODEC_SLAVE | SD_AUDIO_DIR_MODE_MULTI_CHAN_FULL_DUPLEX | SD_AUDIO_CHANNEL_NUM_TX_8CHANS, SD_AUDIO_SR_48000, SD_AUDIO_SAMPLE_WIDTH_8BITS, SD_AUDIO_I2S_DSP_A},
    {SD_AUDIO_TRANSFER_CODEC_SLAVE | SD_AUDIO_DIR_MODE_MULTI_CHAN_FULL_DUPLEX | SD_AUDIO_CHANNEL_NUM_TX_8CHANS, SD_AUDIO_SR_48000, SD_AUDIO_SAMPLE_WIDTH_8BITS, SD_AUDIO_I2S_DSP_B},

    {SD_AUDIO_TRANSFER_CODEC_SLAVE | SD_AUDIO_DIR_MODE_MULTI_CHAN_FULL_DUPLEX | SD_AUDIO_CHANNEL_NUM_TX_8CHANS, SD_AUDIO_SR_48000, SD_AUDIO_SAMPLE_WIDTH_16BITS, SD_AUDIO_I2S_STANDARD_PHILLIPS},
    {SD_AUDIO_TRANSFER_CODEC_SLAVE | SD_AUDIO_DIR_MODE_MULTI_CHAN_FULL_DUPLEX | SD_AUDIO_CHANNEL_NUM_TX_8CHANS, SD_AUDIO_SR_48000, SD_AUDIO_SAMPLE_WIDTH_16BITS, SD_AUDIO_I2S_LEFT_JUSTIFIED},
    {SD_AUDIO_TRANSFER_CODEC_SLAVE | SD_AUDIO_DIR_MODE_MULTI_CHAN_FULL_DUPLEX | SD_AUDIO_CHANNEL_NUM_TX_8CHANS, SD_AUDIO_SR_48000, SD_AUDIO_SAMPLE_WIDTH_16BITS, SD_AUDIO_I2S_RIGHT_JUSTIFIED},
    {SD_AUDIO_TRANSFER_CODEC_SLAVE | SD_AUDIO_DIR_MODE_MULTI_CHAN_FULL_DUPLEX | SD_AUDIO_CHANNEL_NUM_TX_8CHANS, SD_AUDIO_SR_48000, SD_AUDIO_SAMPLE_WIDTH_16BITS, SD_AUDIO_I2S_DSP_A},
    {SD_AUDIO_TRANSFER_CODEC_SLAVE | SD_AUDIO_DIR_MODE_MULTI_CHAN_FULL_DUPLEX | SD_AUDIO_CHANNEL_NUM_TX_8CHANS, SD_AUDIO_SR_48000, SD_AUDIO_SAMPLE_WIDTH_16BITS, SD_AUDIO_I2S_DSP_B},

    {SD_AUDIO_TRANSFER_CODEC_SLAVE | SD_AUDIO_DIR_MODE_MULTI_CHAN_FULL_DUPLEX | SD_AUDIO_CHANNEL_NUM_TX_8CHANS, SD_AUDIO_SR_48000, SD_AUDIO_SAMPLE_WIDTH_24BITS, SD_AUDIO_I2S_STANDARD_PHILLIPS},
    {SD_AUDIO_TRANSFER_CODEC_SLAVE | SD_AUDIO_DIR_MODE_MULTI_CHAN_FULL_DUPLEX | SD_AUDIO_CHANNEL_NUM_TX_8CHANS, SD_AUDIO_SR_48000, SD_AUDIO_SAMPLE_WIDTH_24BITS, SD_AUDIO_I2S_LEFT_JUSTIFIED},
    {SD_AUDIO_TRANSFER_CODEC_SLAVE | SD_AUDIO_DIR_MODE_MULTI_CHAN_FULL_DUPLEX | SD_AUDIO_CHANNEL_NUM_TX_8CHANS, SD_AUDIO_SR_48000, SD_AUDIO_SAMPLE_WIDTH_24BITS, SD_AUDIO_I2S_RIGHT_JUSTIFIED},
    {SD_AUDIO_TRANSFER_CODEC_SLAVE | SD_AUDIO_DIR_MODE_MULTI_CHAN_FULL_DUPLEX | SD_AUDIO_CHANNEL_NUM_TX_8CHANS, SD_AUDIO_SR_48000, SD_AUDIO_SAMPLE_WIDTH_24BITS, SD_AUDIO_I2S_DSP_A},
    {SD_AUDIO_TRANSFER_CODEC_SLAVE | SD_AUDIO_DIR_MODE_MULTI_CHAN_FULL_DUPLEX | SD_AUDIO_CHANNEL_NUM_TX_8CHANS, SD_AUDIO_SR_48000, SD_AUDIO_SAMPLE_WIDTH_24BITS, SD_AUDIO_I2S_DSP_B},

    {SD_AUDIO_TRANSFER_CODEC_SLAVE | SD_AUDIO_DIR_MODE_MULTI_CHAN_FULL_DUPLEX | SD_AUDIO_CHANNEL_NUM_TX_8CHANS, SD_AUDIO_SR_48000, SD_AUDIO_SAMPLE_WIDTH_32BITS, SD_AUDIO_I2S_STANDARD_PHILLIPS},
    {SD_AUDIO_TRANSFER_CODEC_SLAVE | SD_AUDIO_DIR_MODE_MULTI_CHAN_FULL_DUPLEX | SD_AUDIO_CHANNEL_NUM_TX_8CHANS, SD_AUDIO_SR_48000, SD_AUDIO_SAMPLE_WIDTH_32BITS, SD_AUDIO_I2S_LEFT_JUSTIFIED},
    {SD_AUDIO_TRANSFER_CODEC_SLAVE | SD_AUDIO_DIR_MODE_MULTI_CHAN_FULL_DUPLEX | SD_AUDIO_CHANNEL_NUM_TX_8CHANS, SD_AUDIO_SR_48000, SD_AUDIO_SAMPLE_WIDTH_32BITS, SD_AUDIO_I2S_RIGHT_JUSTIFIED},
    {SD_AUDIO_TRANSFER_CODEC_SLAVE | SD_AUDIO_DIR_MODE_MULTI_CHAN_FULL_DUPLEX | SD_AUDIO_CHANNEL_NUM_TX_8CHANS, SD_AUDIO_SR_48000, SD_AUDIO_SAMPLE_WIDTH_32BITS, SD_AUDIO_I2S_DSP_A},
    {SD_AUDIO_TRANSFER_CODEC_SLAVE | SD_AUDIO_DIR_MODE_MULTI_CHAN_FULL_DUPLEX | SD_AUDIO_CHANNEL_NUM_TX_8CHANS, SD_AUDIO_SR_48000, SD_AUDIO_SAMPLE_WIDTH_32BITS, SD_AUDIO_I2S_DSP_B},

///////////////////////////////////////////////////////////////////////////////////////////////////////////////////////////////////////////////////////////////////////////////////////////////
//case 921~940
    {SD_AUDIO_TRANSFER_CODEC_SLAVE | SD_AUDIO_DIR_MODE_MULTI_CHAN_FULL_DUPLEX | SD_AUDIO_CHANNEL_NUM_TX_8CHANS, SD_AUDIO_SR_96000, SD_AUDIO_SAMPLE_WIDTH_8BITS, SD_AUDIO_I2S_STANDARD_PHILLIPS},
    {SD_AUDIO_TRANSFER_CODEC_SLAVE | SD_AUDIO_DIR_MODE_MULTI_CHAN_FULL_DUPLEX | SD_AUDIO_CHANNEL_NUM_TX_8CHANS, SD_AUDIO_SR_96000, SD_AUDIO_SAMPLE_WIDTH_8BITS, SD_AUDIO_I2S_LEFT_JUSTIFIED},
    {SD_AUDIO_TRANSFER_CODEC_SLAVE | SD_AUDIO_DIR_MODE_MULTI_CHAN_FULL_DUPLEX | SD_AUDIO_CHANNEL_NUM_TX_8CHANS, SD_AUDIO_SR_96000, SD_AUDIO_SAMPLE_WIDTH_8BITS, SD_AUDIO_I2S_RIGHT_JUSTIFIED},
    {SD_AUDIO_TRANSFER_CODEC_SLAVE | SD_AUDIO_DIR_MODE_MULTI_CHAN_FULL_DUPLEX | SD_AUDIO_CHANNEL_NUM_TX_8CHANS, SD_AUDIO_SR_96000, SD_AUDIO_SAMPLE_WIDTH_8BITS, SD_AUDIO_I2S_DSP_A},
    {SD_AUDIO_TRANSFER_CODEC_SLAVE | SD_AUDIO_DIR_MODE_MULTI_CHAN_FULL_DUPLEX | SD_AUDIO_CHANNEL_NUM_TX_8CHANS, SD_AUDIO_SR_96000, SD_AUDIO_SAMPLE_WIDTH_8BITS, SD_AUDIO_I2S_DSP_B},

    {SD_AUDIO_TRANSFER_CODEC_SLAVE | SD_AUDIO_DIR_MODE_MULTI_CHAN_FULL_DUPLEX | SD_AUDIO_CHANNEL_NUM_TX_8CHANS, SD_AUDIO_SR_96000, SD_AUDIO_SAMPLE_WIDTH_16BITS, SD_AUDIO_I2S_STANDARD_PHILLIPS},
    {SD_AUDIO_TRANSFER_CODEC_SLAVE | SD_AUDIO_DIR_MODE_MULTI_CHAN_FULL_DUPLEX | SD_AUDIO_CHANNEL_NUM_TX_8CHANS, SD_AUDIO_SR_96000, SD_AUDIO_SAMPLE_WIDTH_16BITS, SD_AUDIO_I2S_LEFT_JUSTIFIED},
    {SD_AUDIO_TRANSFER_CODEC_SLAVE | SD_AUDIO_DIR_MODE_MULTI_CHAN_FULL_DUPLEX | SD_AUDIO_CHANNEL_NUM_TX_8CHANS, SD_AUDIO_SR_96000, SD_AUDIO_SAMPLE_WIDTH_16BITS, SD_AUDIO_I2S_RIGHT_JUSTIFIED},
    {SD_AUDIO_TRANSFER_CODEC_SLAVE | SD_AUDIO_DIR_MODE_MULTI_CHAN_FULL_DUPLEX | SD_AUDIO_CHANNEL_NUM_TX_8CHANS, SD_AUDIO_SR_96000, SD_AUDIO_SAMPLE_WIDTH_16BITS, SD_AUDIO_I2S_DSP_A},
    {SD_AUDIO_TRANSFER_CODEC_SLAVE | SD_AUDIO_DIR_MODE_MULTI_CHAN_FULL_DUPLEX | SD_AUDIO_CHANNEL_NUM_TX_8CHANS, SD_AUDIO_SR_96000, SD_AUDIO_SAMPLE_WIDTH_16BITS, SD_AUDIO_I2S_DSP_B},

    {SD_AUDIO_TRANSFER_CODEC_SLAVE | SD_AUDIO_DIR_MODE_MULTI_CHAN_FULL_DUPLEX | SD_AUDIO_CHANNEL_NUM_TX_8CHANS, SD_AUDIO_SR_96000, SD_AUDIO_SAMPLE_WIDTH_24BITS, SD_AUDIO_I2S_STANDARD_PHILLIPS},
    {SD_AUDIO_TRANSFER_CODEC_SLAVE | SD_AUDIO_DIR_MODE_MULTI_CHAN_FULL_DUPLEX | SD_AUDIO_CHANNEL_NUM_TX_8CHANS, SD_AUDIO_SR_96000, SD_AUDIO_SAMPLE_WIDTH_24BITS, SD_AUDIO_I2S_LEFT_JUSTIFIED},
    {SD_AUDIO_TRANSFER_CODEC_SLAVE | SD_AUDIO_DIR_MODE_MULTI_CHAN_FULL_DUPLEX | SD_AUDIO_CHANNEL_NUM_TX_8CHANS, SD_AUDIO_SR_96000, SD_AUDIO_SAMPLE_WIDTH_24BITS, SD_AUDIO_I2S_RIGHT_JUSTIFIED},
    {SD_AUDIO_TRANSFER_CODEC_SLAVE | SD_AUDIO_DIR_MODE_MULTI_CHAN_FULL_DUPLEX | SD_AUDIO_CHANNEL_NUM_TX_8CHANS, SD_AUDIO_SR_96000, SD_AUDIO_SAMPLE_WIDTH_24BITS, SD_AUDIO_I2S_DSP_A},
    {SD_AUDIO_TRANSFER_CODEC_SLAVE | SD_AUDIO_DIR_MODE_MULTI_CHAN_FULL_DUPLEX | SD_AUDIO_CHANNEL_NUM_TX_8CHANS, SD_AUDIO_SR_96000, SD_AUDIO_SAMPLE_WIDTH_24BITS, SD_AUDIO_I2S_DSP_B},

    {SD_AUDIO_TRANSFER_CODEC_SLAVE | SD_AUDIO_DIR_MODE_MULTI_CHAN_FULL_DUPLEX | SD_AUDIO_CHANNEL_NUM_TX_8CHANS, SD_AUDIO_SR_96000, SD_AUDIO_SAMPLE_WIDTH_32BITS, SD_AUDIO_I2S_STANDARD_PHILLIPS},
    {SD_AUDIO_TRANSFER_CODEC_SLAVE | SD_AUDIO_DIR_MODE_MULTI_CHAN_FULL_DUPLEX | SD_AUDIO_CHANNEL_NUM_TX_8CHANS, SD_AUDIO_SR_96000, SD_AUDIO_SAMPLE_WIDTH_32BITS, SD_AUDIO_I2S_LEFT_JUSTIFIED},
    {SD_AUDIO_TRANSFER_CODEC_SLAVE | SD_AUDIO_DIR_MODE_MULTI_CHAN_FULL_DUPLEX | SD_AUDIO_CHANNEL_NUM_TX_8CHANS, SD_AUDIO_SR_96000, SD_AUDIO_SAMPLE_WIDTH_32BITS, SD_AUDIO_I2S_RIGHT_JUSTIFIED},
    {SD_AUDIO_TRANSFER_CODEC_SLAVE | SD_AUDIO_DIR_MODE_MULTI_CHAN_FULL_DUPLEX | SD_AUDIO_CHANNEL_NUM_TX_8CHANS, SD_AUDIO_SR_96000, SD_AUDIO_SAMPLE_WIDTH_32BITS, SD_AUDIO_I2S_DSP_A},
    {SD_AUDIO_TRANSFER_CODEC_SLAVE | SD_AUDIO_DIR_MODE_MULTI_CHAN_FULL_DUPLEX | SD_AUDIO_CHANNEL_NUM_TX_8CHANS, SD_AUDIO_SR_96000, SD_AUDIO_SAMPLE_WIDTH_32BITS, SD_AUDIO_I2S_DSP_B},

///////////////////////////////////////////////////////////////////////////////////////////////////////////////////////////////////////////////////////////////////////////////////////////////
//case 941~960
    {SD_AUDIO_TRANSFER_CODEC_SLAVE | SD_AUDIO_DIR_MODE_MULTI_CHAN_FULL_DUPLEX | SD_AUDIO_CHANNEL_NUM_TX_8CHANS, SD_AUDIO_SR_192000, SD_AUDIO_SAMPLE_WIDTH_8BITS, SD_AUDIO_I2S_STANDARD_PHILLIPS},
    {SD_AUDIO_TRANSFER_CODEC_SLAVE | SD_AUDIO_DIR_MODE_MULTI_CHAN_FULL_DUPLEX | SD_AUDIO_CHANNEL_NUM_TX_8CHANS, SD_AUDIO_SR_192000, SD_AUDIO_SAMPLE_WIDTH_8BITS, SD_AUDIO_I2S_LEFT_JUSTIFIED},
    {SD_AUDIO_TRANSFER_CODEC_SLAVE | SD_AUDIO_DIR_MODE_MULTI_CHAN_FULL_DUPLEX | SD_AUDIO_CHANNEL_NUM_TX_8CHANS, SD_AUDIO_SR_192000, SD_AUDIO_SAMPLE_WIDTH_8BITS, SD_AUDIO_I2S_RIGHT_JUSTIFIED},
    {SD_AUDIO_TRANSFER_CODEC_SLAVE | SD_AUDIO_DIR_MODE_MULTI_CHAN_FULL_DUPLEX | SD_AUDIO_CHANNEL_NUM_TX_8CHANS, SD_AUDIO_SR_192000, SD_AUDIO_SAMPLE_WIDTH_8BITS, SD_AUDIO_I2S_DSP_A},
    {SD_AUDIO_TRANSFER_CODEC_SLAVE | SD_AUDIO_DIR_MODE_MULTI_CHAN_FULL_DUPLEX | SD_AUDIO_CHANNEL_NUM_TX_8CHANS, SD_AUDIO_SR_192000, SD_AUDIO_SAMPLE_WIDTH_8BITS, SD_AUDIO_I2S_DSP_B},

    {SD_AUDIO_TRANSFER_CODEC_SLAVE | SD_AUDIO_DIR_MODE_MULTI_CHAN_FULL_DUPLEX | SD_AUDIO_CHANNEL_NUM_TX_8CHANS, SD_AUDIO_SR_192000, SD_AUDIO_SAMPLE_WIDTH_16BITS, SD_AUDIO_I2S_STANDARD_PHILLIPS},
    {SD_AUDIO_TRANSFER_CODEC_SLAVE | SD_AUDIO_DIR_MODE_MULTI_CHAN_FULL_DUPLEX | SD_AUDIO_CHANNEL_NUM_TX_8CHANS, SD_AUDIO_SR_192000, SD_AUDIO_SAMPLE_WIDTH_16BITS, SD_AUDIO_I2S_LEFT_JUSTIFIED},
    {SD_AUDIO_TRANSFER_CODEC_SLAVE | SD_AUDIO_DIR_MODE_MULTI_CHAN_FULL_DUPLEX | SD_AUDIO_CHANNEL_NUM_TX_8CHANS, SD_AUDIO_SR_192000, SD_AUDIO_SAMPLE_WIDTH_16BITS, SD_AUDIO_I2S_RIGHT_JUSTIFIED},
    {SD_AUDIO_TRANSFER_CODEC_SLAVE | SD_AUDIO_DIR_MODE_MULTI_CHAN_FULL_DUPLEX | SD_AUDIO_CHANNEL_NUM_TX_8CHANS, SD_AUDIO_SR_192000, SD_AUDIO_SAMPLE_WIDTH_16BITS, SD_AUDIO_I2S_DSP_A},
    {SD_AUDIO_TRANSFER_CODEC_SLAVE | SD_AUDIO_DIR_MODE_MULTI_CHAN_FULL_DUPLEX | SD_AUDIO_CHANNEL_NUM_TX_8CHANS, SD_AUDIO_SR_192000, SD_AUDIO_SAMPLE_WIDTH_16BITS, SD_AUDIO_I2S_DSP_B},

    {SD_AUDIO_TRANSFER_CODEC_SLAVE | SD_AUDIO_DIR_MODE_MULTI_CHAN_FULL_DUPLEX | SD_AUDIO_CHANNEL_NUM_TX_8CHANS, SD_AUDIO_SR_192000, SD_AUDIO_SAMPLE_WIDTH_24BITS, SD_AUDIO_I2S_STANDARD_PHILLIPS},
    {SD_AUDIO_TRANSFER_CODEC_SLAVE | SD_AUDIO_DIR_MODE_MULTI_CHAN_FULL_DUPLEX | SD_AUDIO_CHANNEL_NUM_TX_8CHANS, SD_AUDIO_SR_192000, SD_AUDIO_SAMPLE_WIDTH_24BITS, SD_AUDIO_I2S_LEFT_JUSTIFIED},
    {SD_AUDIO_TRANSFER_CODEC_SLAVE | SD_AUDIO_DIR_MODE_MULTI_CHAN_FULL_DUPLEX | SD_AUDIO_CHANNEL_NUM_TX_8CHANS, SD_AUDIO_SR_192000, SD_AUDIO_SAMPLE_WIDTH_24BITS, SD_AUDIO_I2S_RIGHT_JUSTIFIED},
    {SD_AUDIO_TRANSFER_CODEC_SLAVE | SD_AUDIO_DIR_MODE_MULTI_CHAN_FULL_DUPLEX | SD_AUDIO_CHANNEL_NUM_TX_8CHANS, SD_AUDIO_SR_192000, SD_AUDIO_SAMPLE_WIDTH_24BITS, SD_AUDIO_I2S_DSP_A},
    {SD_AUDIO_TRANSFER_CODEC_SLAVE | SD_AUDIO_DIR_MODE_MULTI_CHAN_FULL_DUPLEX | SD_AUDIO_CHANNEL_NUM_TX_8CHANS, SD_AUDIO_SR_192000, SD_AUDIO_SAMPLE_WIDTH_24BITS, SD_AUDIO_I2S_DSP_B},

    {SD_AUDIO_TRANSFER_CODEC_SLAVE | SD_AUDIO_DIR_MODE_MULTI_CHAN_FULL_DUPLEX | SD_AUDIO_CHANNEL_NUM_TX_8CHANS, SD_AUDIO_SR_192000, SD_AUDIO_SAMPLE_WIDTH_32BITS, SD_AUDIO_I2S_STANDARD_PHILLIPS},
    {SD_AUDIO_TRANSFER_CODEC_SLAVE | SD_AUDIO_DIR_MODE_MULTI_CHAN_FULL_DUPLEX | SD_AUDIO_CHANNEL_NUM_TX_8CHANS, SD_AUDIO_SR_192000, SD_AUDIO_SAMPLE_WIDTH_32BITS, SD_AUDIO_I2S_LEFT_JUSTIFIED},
    {SD_AUDIO_TRANSFER_CODEC_SLAVE | SD_AUDIO_DIR_MODE_MULTI_CHAN_FULL_DUPLEX | SD_AUDIO_CHANNEL_NUM_TX_8CHANS, SD_AUDIO_SR_192000, SD_AUDIO_SAMPLE_WIDTH_32BITS, SD_AUDIO_I2S_RIGHT_JUSTIFIED},
    {SD_AUDIO_TRANSFER_CODEC_SLAVE | SD_AUDIO_DIR_MODE_MULTI_CHAN_FULL_DUPLEX | SD_AUDIO_CHANNEL_NUM_TX_8CHANS, SD_AUDIO_SR_192000, SD_AUDIO_SAMPLE_WIDTH_32BITS, SD_AUDIO_I2S_DSP_A},
    {SD_AUDIO_TRANSFER_CODEC_SLAVE | SD_AUDIO_DIR_MODE_MULTI_CHAN_FULL_DUPLEX | SD_AUDIO_CHANNEL_NUM_TX_8CHANS, SD_AUDIO_SR_192000, SD_AUDIO_SAMPLE_WIDTH_32BITS, SD_AUDIO_I2S_DSP_B},

///////////////////////////////////////////////////////////////////////////////////////////////////////////////////////////////////////////////////////////////////////////////////////////

};

#define SD_AUDIO_TEST_MAX_NUM (sizeof audio_pcm_test_params / sizeof audio_pcm_test_params[0])

void sd_audio_test_usage(void)
{
    printf("cmd: audio_test -n [casenum] ##run audio case [casenum]\n");
    printf("Totally %u testcases included.\n", SD_AUDIO_TEST_MAX_NUM);
}

static const char *sd_audio_ctrl_mode_string[] = {"SD_AUDIO_CTRL_MODE_NO_INIT",
                                                  "SD_AUDIO_TRANSFER_CODEC_SLAVE",
                                                  "SD_AUDIO_TRANSFER_CODEC_MASTER",
                                                 };

static const char *sd_audio_dir_mode_string[] = {"SD_AUDIO_DIR_MODE_NO_INIT",
                                                 "SD_AUDIO_DIR_MODE_TRANSMIT",
                                                 "SD_AUDIO_DIR_MODE_RECEIVE",
                                                 "SD_AUDIO_DIR_MODE_FULL_DUPLEX",
                                                 "SD_AUDIO_DIR_MODE_MULTI_CHAN_TRANSMIT",
                                                 "SD_AUDIO_DIR_MODE_MULTI_CHAN_RECEIVE",
                                                 "SD_AUDIO_DIR_MODE_MULTI_CHAN_FULL_DUPLEX",
                                                };

static const char *sd_audio_tx_chan_num_string[] = {"SD_AUDIO_TX_CHAN_NUM_NO_INIT",
                                                    "SD_AUDIO_CHANNEL_NUM_TX_MONO",
                                                    "SD_AUDIO_CHANNEL_NUM_TX_STEREO",
                                                    "SD_AUDIO_CHANNEL_NUM_TX_4CHANS",
                                                    "SD_AUDIO_CHANNEL_NUM_TX_8CHANS",
                                                   };

static const char *sd_audio_rx_chan_num_string[] = {"SD_AUDIO_RX_CHAN_NUM_NO_INIT",
                                                    "SD_AUDIO_CHANNEL_NUM_RX_MONO",
                                                    "SD_AUDIO_CHANNEL_NUM_RX_STEREO",
                                                    "SD_AUDIO_CHANNEL_NUM_RX_4CHANS",
                                                    "SD_AUDIO_CHANNEL_NUM_RX_8CHANS",
                                                   };

static const char *sd_audio_sample_rate_string[] = {"SD_AUDIO_SR_NO_INIT",
                                                    "SD_AUDIO_SR_5512",
                                                    "SD_AUDIO_SR_8000",
                                                    "SD_AUDIO_SR_11025",
                                                    "SD_AUDIO_SR_16000",
                                                    "SD_AUDIO_SR_22050",
                                                    "SD_AUDIO_SR_32000",
                                                    "SD_AUDIO_SR_44100",
                                                    "SD_AUDIO_SR_48000",
                                                    "SD_AUDIO_SR_64000",
                                                    "SD_AUDIO_SR_88200",
                                                    "SD_AUDIO_SR_96000",
                                                    "SD_AUDIO_SR_176400",
                                                    "SD_AUDIO_SR_192000",
                                                   };

static const char *sd_audio_sample_width_string[] = {"SD_AUDIO_SAMPLE_WIDTH_NO_INIT",
                                                     "SD_AUDIO_SAMPLE_WIDTH_8BITS",
                                                     "SD_AUDIO_SAMPLE_WIDTH_16BITS",
                                                     "SD_AUDIO_SAMPLE_WIDTH_20BITS",
                                                     "SD_AUDIO_SAMPLE_WIDTH_24BITS",
                                                     "SD_AUDIO_SAMPLE_WIDTH_32BITS",
                                                    };

static const char *sd_audio_i2s_interfacemode_string[] = {"SD_AUDIO_I2S_INTERFACE_MODE_NO_INIT",
                                                          "SD_AUDIO_I2S_STANDARD_PHILLIPS",
                                                          "SD_AUDIO_I2S_LEFT_JUSTIFIED",
                                                          "SD_AUDIO_I2S_RIGHT_JUSTIFIED",
                                                          "SD_AUDIO_I2S_DSP_A",
                                                          "SD_AUDIO_I2S_DSP_B",
                                                         };

void sd_audio_show_test_info(pcm_params_t pcm_info)
{
    // print info
    u32 ctrl_mode, dir_mode, tx_chan_num, rx_chan_num;

    ctrl_mode = pcm_info.mode & SD_AUDIO_TRANSFER_MODE_ENABLE;
    dir_mode = pcm_info.mode & SD_AUDIO_DIR_MODE_ENABLE;
    tx_chan_num = pcm_info.mode & SD_AUDIO_CHANNEL_NUM_TX_ENABLE;
    rx_chan_num = pcm_info.mode & SD_AUDIO_CHANNEL_NUM_RX_ENABLE;
    printf("----------\n");
    printf("ctrl mode: \t\t\t");

    switch (ctrl_mode) {
        case 0:
            printf("%s.\n", sd_audio_ctrl_mode_string[0]);
            break;

        case SD_AUDIO_TRANSFER_CODEC_SLAVE:
            printf("%s.\n", sd_audio_ctrl_mode_string[1]);
            break;

        case SD_AUDIO_TRANSFER_CODEC_MASTER:
            printf("%s.\n", sd_audio_ctrl_mode_string[2]);
            break;

        default:
            break;
    }

    printf("direction mode: \t\t");

    switch (dir_mode) {
        case 0:
            printf("%s.\n", sd_audio_dir_mode_string[0]);
            break;

        case SD_AUDIO_DIR_MODE_TRANSMIT:
            printf("%s.\n", sd_audio_dir_mode_string[1]);
            break;

        case SD_AUDIO_DIR_MODE_RECEIVE:
            printf("%s.\n", sd_audio_dir_mode_string[2]);
            break;

        case SD_AUDIO_DIR_MODE_FULL_DUPLEX:
            printf("%s.\n", sd_audio_dir_mode_string[3]);
            break;

        case SD_AUDIO_DIR_MODE_MULTI_CHAN_TRANSMIT:
            printf("%s.\n", sd_audio_dir_mode_string[4]);
            break;

        case SD_AUDIO_DIR_MODE_MULTI_CHAN_RECEIVE:
            printf("%s.\n", sd_audio_dir_mode_string[5]);
            break;

        case SD_AUDIO_DIR_MODE_MULTI_CHAN_FULL_DUPLEX:
            printf("%s.\n", sd_audio_dir_mode_string[6]);
            break;

        default:
            break;
    }

    printf("tx channel number: \t\t");

    switch (tx_chan_num) {
        case 0:
            printf("%s.\n", sd_audio_tx_chan_num_string[0]);
            break;

        case SD_AUDIO_CHANNEL_NUM_TX_MONO:
            printf("%s.\n", sd_audio_tx_chan_num_string[1]);
            break;

        case SD_AUDIO_CHANNEL_NUM_TX_STEREO:
            printf("%s.\n", sd_audio_tx_chan_num_string[2]);
            break;

        case SD_AUDIO_CHANNEL_NUM_TX_4CHANS:
            printf("%s.\n", sd_audio_tx_chan_num_string[3]);
            break;

        case SD_AUDIO_CHANNEL_NUM_TX_8CHANS:
            printf("%s.\n", sd_audio_tx_chan_num_string[4]);
            break;

        default:
            break;
    }

    printf("rx channel number: \t\t");

    switch (rx_chan_num) {
        case 0:
            printf("%s.\n", sd_audio_rx_chan_num_string[0]);
            break;

        case SD_AUDIO_CHANNEL_NUM_RX_MONO:
            printf("%s.\n", sd_audio_rx_chan_num_string[1]);
            break;

        case SD_AUDIO_CHANNEL_NUM_RX_STEREO:
            printf("%s.\n", sd_audio_rx_chan_num_string[2]);
            break;

        case SD_AUDIO_CHANNEL_NUM_RX_4CHANS:
            printf("%s.\n", sd_audio_rx_chan_num_string[3]);
            break;

        case SD_AUDIO_CHANNEL_NUM_RX_8CHANS:
            printf("%s.\n", sd_audio_rx_chan_num_string[4]);
            break;

        default:
            break;
    }

    printf("sample resolution: \t\t");

    switch (pcm_info.sample_rate) {
        case 0:
            printf("%s.\n", sd_audio_sample_rate_string[0]);
            break;

        case SD_AUDIO_SR_5512:
            printf("%s.\n", sd_audio_sample_rate_string[1]);
            break;

        case SD_AUDIO_SR_8000:
            printf("%s.\n", sd_audio_sample_rate_string[2]);
            break;

        case SD_AUDIO_SR_11025:
            printf("%s.\n", sd_audio_sample_rate_string[3]);
            break;

        case SD_AUDIO_SR_16000:
            printf("%s.\n", sd_audio_sample_rate_string[4]);
            break;

        case SD_AUDIO_SR_22050:
            printf("%s.\n", sd_audio_sample_rate_string[5]);
            break;

        case SD_AUDIO_SR_32000:
            printf("%s.\n", sd_audio_sample_rate_string[6]);
            break;

        case SD_AUDIO_SR_44100:
            printf("%s.\n", sd_audio_sample_rate_string[7]);
            break;

        case SD_AUDIO_SR_48000:
            printf("%s.\n", sd_audio_sample_rate_string[8]);
            break;

        case SD_AUDIO_SR_64000:
            printf("%s.\n", sd_audio_sample_rate_string[9]);
            break;

        case SD_AUDIO_SR_88200:
            printf("%s.\n", sd_audio_sample_rate_string[10]);
            break;

        case SD_AUDIO_SR_96000:
            printf("%s.\n", sd_audio_sample_rate_string[11]);
            break;

        case SD_AUDIO_SR_176400:
            printf("%s.\n", sd_audio_sample_rate_string[12]);
            break;

        case SD_AUDIO_SR_192000:
            printf("%s.\n", sd_audio_sample_rate_string[13]);
            break;

        default:
            break;
    }

    printf("sample width: \t\t\t%s.\n",
           sd_audio_sample_width_string[pcm_info.resolution]);
    printf("standard: \t\t\t%s\n",
           sd_audio_i2s_interfacemode_string[pcm_info.standard]);
    printf("----------\n");
}


void sd_audio_show_test_info_by_casenum(u32 casenum)
{
    pcm_params_t pcm_info = audio_pcm_test_params[casenum];
    printf("audio testcase %d:\n", casenum + 1);
    sd_audio_show_test_info(pcm_info);
}

pcm_params_t sd_audio_get_test_params(u32 casenum)
{
    return audio_pcm_test_params[casenum];
}

pcm_params_t sd_audio_get_symm_test_params(u32 casenum)
{
    pcm_params_t pcm_info, pcm_info_symm;
    u32 dir_mode = 0, ctrl_mode = 0, tx_num = 0, rx_num = 0;

    pcm_info_symm = pcm_info = audio_pcm_test_params[casenum];

    if ((pcm_info.mode & SD_AUDIO_TRANSFER_MODE_ENABLE) ==
            SD_AUDIO_TRANSFER_CODEC_SLAVE) {
        ctrl_mode = SD_AUDIO_TRANSFER_CODEC_MASTER;
    }
    else {
        printf("error: pcm wrong direction mode.\n");
    }

    switch (pcm_info.mode & SD_AUDIO_DIR_MODE_ENABLE) {
        case SD_AUDIO_DIR_MODE_TRANSMIT:
            dir_mode = SD_AUDIO_DIR_MODE_RECEIVE;
            break;

        case SD_AUDIO_DIR_MODE_RECEIVE:
            dir_mode = SD_AUDIO_DIR_MODE_TRANSMIT;
            break;

        case SD_AUDIO_DIR_MODE_FULL_DUPLEX:
            dir_mode = SD_AUDIO_DIR_MODE_FULL_DUPLEX;
            break;

        case SD_AUDIO_DIR_MODE_MULTI_CHAN_TRANSMIT:
            dir_mode = SD_AUDIO_DIR_MODE_MULTI_CHAN_RECEIVE;
            break;

        case SD_AUDIO_DIR_MODE_MULTI_CHAN_RECEIVE:
            dir_mode = SD_AUDIO_DIR_MODE_MULTI_CHAN_TRANSMIT;
            break;

        case SD_AUDIO_DIR_MODE_MULTI_CHAN_FULL_DUPLEX:
            dir_mode = SD_AUDIO_DIR_MODE_MULTI_CHAN_FULL_DUPLEX;
            break;

        default:
            break;
    }

    switch (pcm_info.mode & SD_AUDIO_CHANNEL_NUM_TX_ENABLE) {
        case SD_AUDIO_CHANNEL_NUM_TX_MONO:
            rx_num = SD_AUDIO_CHANNEL_NUM_RX_MONO;
            break;
        case SD_AUDIO_CHANNEL_NUM_TX_STEREO:
            rx_num = SD_AUDIO_CHANNEL_NUM_RX_STEREO;
            break;
        case SD_AUDIO_CHANNEL_NUM_TX_4CHANS:
            rx_num = SD_AUDIO_CHANNEL_NUM_RX_4CHANS;
            break;
        case SD_AUDIO_CHANNEL_NUM_TX_8CHANS:
            rx_num = SD_AUDIO_CHANNEL_NUM_RX_8CHANS;
            break;

        default:
            break;
    }

    switch (pcm_info.mode & SD_AUDIO_CHANNEL_NUM_RX_ENABLE) {
        case SD_AUDIO_CHANNEL_NUM_RX_MONO:
            tx_num = SD_AUDIO_CHANNEL_NUM_TX_MONO;
            break;
        case SD_AUDIO_CHANNEL_NUM_RX_STEREO:
            tx_num = SD_AUDIO_CHANNEL_NUM_TX_STEREO;
            break;
        case SD_AUDIO_CHANNEL_NUM_RX_4CHANS:
            tx_num = SD_AUDIO_CHANNEL_NUM_TX_4CHANS;
            break;
        case SD_AUDIO_CHANNEL_NUM_RX_8CHANS:
            tx_num = SD_AUDIO_CHANNEL_NUM_TX_8CHANS;
            break;

        default:
            break;
    }

    pcm_info_symm.mode = ctrl_mode | dir_mode | tx_num | rx_num;

    return pcm_info_symm;
}


/**
 * test_result function: tell if data shift left or right and data match mostly. apply on loopback mode.
*/
bool sd_audio_test_transfer_result(u8 *src, u8 *dst, int len)
{
    bool shift_right = false, shift_left = false, result_match = false;
    int i, j;   //i counts src data, j counts dst data.
    int leading_zero_count = 0, tailing_zero_count  = 0;
    int sync_end = 0, sync_start = 0;

    if (src[0] != dst[0]) {
        if (dst[0] == 0) {
            shift_right = true;
            printf("shift_right.\n");
        }
        else {
            shift_left = true;
            printf("shift_left.\n");
        }
    }                   // decide shift right or left first.

    // check data.
    if (shift_right || (shift_right == false && shift_left == false)) {
        for (i = 0, j = 0; j < len; j++) {
            // to sync, once lost sync, data match failed.
            if ((dst[j] == 0) && (result_match == false) ) {
                leading_zero_count++;
            }
            else if (src[i] == dst[j]) {
                result_match = true;
                i++;
                sync_end = j;
            }
            else {
                result_match = false;
                break;
            }
        }

        // print report
        if (result_match && (sync_end == (len - 1))
                && (leading_zero_count != len)) {
            printf("----------\npassed: result match\n");
        }
        else {
            printf("----------\nfailed:\n");
        }

        printf("total data len: %d\n", len);
        printf("leading zero count: %d\n", leading_zero_count);
        printf("sync start from %d to %d\n----------\n", leading_zero_count + 1,
               sync_end + 1);
    }
    else {
        // shift left
        for (i = 0, j = 0; i < len; i++) {
            // start sync, once lost sync, data match failed.
            if (src[i] != dst[j] && (result_match == false)) {
                sync_start++;
            }
            else if (src[i] == dst[j]) {
                result_match = true;
                sync_end = i;
                j++;
            }
            else {
                result_match = false;
                break;
            }

            if ((dst[i] == 0) && (result_match == true)) {
                tailing_zero_count++;
            }
        }

        if (result_match && (leading_zero_count != len)) {
            printf("----------\npassed: result match\n");
        }
        else {
            printf("----------\nfailed:\n");
        }

        printf("total data len: %d\n", len);
        printf("tailing zero count: %d\n", tailing_zero_count);
        printf("sync start from %d to %d\n----------\n", sync_start + 1,
               sync_end + 1);
    }

    return true;
}
