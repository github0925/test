## meta-semidrive/conf/machine/d9plus_ref_ap1.conf
```bitbake
#@TYPE: Machine
#@NAME: D9 machine
#@DESCRIPTION: Machine configuration for running D9

SOC_FAMILY = "d9"
MACHAINE_NAME = "d9plus_ref_ap1"
#CHIPVERSION should be: d9 d9lite d9plus
CHIPVERSION = "d9plus"
SD_PROJECT = "d9plus_ref"
SD_PROJECT_BASE_CFG="CHIPVERSION=${CHIPVERSION} SD_PROJECT=${SD_PROJECT} PROJECT_BUILDDIR_POSTFIX=_${SD_PROJECT}"

DEFAULTTUNE ?= "cortexa57-cortexa53"
require conf/machine/include/tune-cortexa57-cortexa53.inc
require conf/machine/include/${SOC_FAMILY}.inc

# 32BIT package install (default is disable)
# This variables can be used only in multilib.
USE_32BIT_PKGS ?= "0"
USE_32BIT_WAYLAND ?= "0"
USE_32BIT_MMP ?= "0"

KBUILD_DEFCONFIG_${MACHAINE_NAME} = "d9_ref_linux_defconfig"
MACHINE_FEATURES = ""

require conf/machine/include/verified-boot.inc

# bootloader type select, default use lk bootloader, if you want to use uboot, modify the KERNEL_IMAGETYPE=Image.gz
KERNEL_IMAGETYPE = "Image.gz"
IMAGE_FSTYPES_append = " ext4"
IMAGE_FSTYPES_remove = "tar.gz"
# use 256 MB according to bpt
IMAGE_ROOTFS_SIZE = "262144"

SERIAL_CONSOLE = "115200 ttyS0"

# Configuration for kernel
PREFERRED_PROVIDER_virtual/kernel = "linux-semidrive-dev"

KERNEL_DEVICETREE = "semidrive/d9_plus_d9350_ap1_ref.dtb"
PREFERRED_PROVIDER_virtual/drm = "drm-dev"
PREFERRED_PROVIDER_virtual/g2d = "g2d-dev"
MACHINE_ESSENTIAL_EXTRA_RRECOMMENDS = " kernel-module-g2d kernel-module-pvrsrvkm kernel-module-drm  kernel-module-crypto-engine kernel-module-ecdh-generic kernel-module-sr9900 kernel-module-rtc-ds1307 kernel-module-lm75 kernel-module-ngbe"
KERNEL_MODULE_AUTOLOAD = "pvrsrvkm kunlun-drm kunlun-drm-crtc crypto_engine ecdh_generic sdrv-g2d sr9900 rtc-ds1307 lm75 ngbe"
MACHINE_GPU_REV_${MACHAINE_NAME} = "gm9226"

# Configuration for ARM Trusted Firmware
#EXTRA_IMAGEDEPENDS += " arm-trusted-firmware"
# Configuration for bootloaders
EXTRA_IMAGEDEPENDS += "lk"
MACHINE_SPL_${MACHAINE_NAME} = "spl"
MACHINE_SPLARG_${MACHAINE_NAME} = "${SD_PROJECT_BASE_CFG}"
MACHINE_SSYSTEM_${MACHAINE_NAME} = "ssystem"
MACHINE_SSYSTEMARG_${MACHAINE_NAME} = "${SD_PROJECT_BASE_CFG}"
MACHINE_DLOADER_${MACHAINE_NAME} = "dloader"
MACHINE_DLOADERARG_${MACHAINE_NAME} += "${SD_PROJECT_BASE_CFG}"
MACHINE_PRELOADER_${MACHAINE_NAME} = "preloader"
MACHINE_PRELOADERARG_${MACHAINE_NAME} = "${SD_PROJECT_BASE_CFG}"
MACHINE_BOOTLOADER_${MACHAINE_NAME} = "bootloader"
MACHINE_BOOTLOADERARG_${MACHAINE_NAME} = "${SD_PROJECT_BASE_CFG}"
MACHINE_MP_${MACHAINE_NAME} = ""
MACHINE_BOOT_EXTRA_OPTION_${MACHAINE_NAME} = ""

# safety
EXTRA_IMAGEDEPENDS += "safety"
MACHINE_SAFETY_${MACHAINE_NAME} = "safety"
MACHINE_SAFETYARG_${MACHAINE_NAME} = "${SD_PROJECT_BASE_CFG}"
MACHINE_OSPIHANDOVER_${MACHAINE_NAME} = "ospi_handover"
MACHINE_OSPIHANDOVERARG_${MACHAINE_NAME} = "${SD_PROJECT_BASE_CFG}"

#
#
# u-boot
EXTRA_IMAGEDEPENDS += "uboot"
MACHINE_UBOOT_${MACHAINE_NAME} = "uboot-${UBOOT_PROJ_NAME}"
MACHINE_UBOOT_DEFCONF_${MACHAINE_NAME}= "d9plus_ap1_defconfig"
MACHINE_UBOOT_MAKE_EXTRA_OPTION_${MACHAINE_NAME} = "ARCH=arm CROSS_COMPILE=aarch64-linux-gnu-"
MACHINE_UBOOT_BOOTLOADER_${MACHAINE_NAME} = "ivi_bootloader.bin"

#bootloader type, default lk
MACHAINE_BOOTLOADER_TYPE = "uboot"



#ssdk
#EXTRA_IMAGEDEPENDS += "ssdk"
#SD_SSDK_SAF_${MACHAINE_NAME}="d9_safety_ref"
#SD_SSDK_SEC_${MACHAINE_NAME}="d9_secure_ref"

# atf
#EXTRA_IMAGEDEPENDS += "atf"
#MACHINE_ATF_${MACHAINE_NAME} = ""
#MACHINE_ATFARG_${MACHAINE_NAME} = "ATF_BOARD=D9_REF ${SD_PROJECT_BASE_CFG}"

# graphics and drm
PREFERRED_PROVIDER_virtual/libgles1 = "pvr-lib"
PREFERRED_PROVIDER_virtual/libgles2 = "pvr-lib"
PREFERRED_PROVIDER_virtual/egl = "pvr-lib"
##MACHINE_EXTRA_RRECOMMENDS += "pvr-lib"
PREFERRED_VERSION_libdrm = "2.4.91"

# Add variable to Build Configuration in build log
BUILDCFG_VARS_append = " SOC_FAMILY"

MACHINEOVERRIDES .= ":d9"

#DISTRO_FEATURES_append = " bluetooth bluez5 wpa-supplicant"
#IMAGE_INSTALL_append = " bluez5 sdrvbtwifi wpa-supplicant"
# Command using to build kernel-module-gles
HOSTTOOLS += "sync seq"

#default d9 in emmc only,ifyou have ospi comment below
BAREMETAL_TGT = "sec"
PRELOAD_RES_SIZE = "0x1800000"
MACHINE_SAFETYARG_${MACHAINE_NAME} += "${SD_PROJECT_BASE_CFG} PRELOAD_RES_SIZE=${PRELOAD_RES_SIZE}"
MACHINE_DLOADERARG_${MACHAINE_NAME} += "BOOT_TYPE=emmc"

#BAREMETAL_DEBUG = "1"

#below defaut in sdk lpddr4
MACHINE_BAREMETALARG_${MACHAINE_NAME} = "${SD_PROJECT_BASE_CFG} BOARD=d9plus_ref DDR_FW=lpddr4 DDR_TYPE=lpddr4 DDR_SIZE=2GB DDR_FREQ=2133  D=${BAREMETAL_DEBUG}"
#MACHINE_BAREMETALARG_${MACHAINE_NAME} += "SDCARD_BOOT=1"
MACHINE_SPLARG_${MACHAINE_NAME} = "${SD_PROJECT_BASE_CFG} LPDDR4=true DDR_FREQ=2133 DDR_TYPE=lpddr4 DDR_SIZE=2GB"

#below defaut in sdk lpddr4x
#MACHINE_BAREMETALARG_${MACHAINE_NAME} = "BOARD=d9plus_ref DDR_FW=lpddr4x DDR_TYPE=lpddr4x DDR_SIZE=2GB DDR_FREQ=3200 D=${BAREMETAL_DEBUG}"

#below you can in sdk ddr4
#MACHINE_SPLARG_${MACHAINE_NAME} = "DDR4=true DDR_SIZE=2G DDR_FREQ=2400"
#MACHINE_BAREMETALARG_${MACHAINE_NAME} = "BOARD=d9_ref DDR_FW=ddr4 DDR_TYPE=ddr4 DDR_SIZE=2GB DDR_FREQ=2400  D=${BAREMETAL_DEBUG}"
#MACHINE_SPLARG_${MACHAINE_NAME} = "DDR4=true DDR_SIZE=2GB DDR_FREQ=2400"
```

## meta-semidrive/conf/machine/d9plus_ref_ap2.conf
```bitbake
#@TYPE: Machine
#@NAME: D9 machine
#@DESCRIPTION: Machine configuration for running D9

SOC_FAMILY = "d9"
MACHAINE_NAME = "d9plus_ref_ap2"
LK_PROJ_NAME = ""
SAFETY_PROJ_NAME = ""
#CHIPVERSION should be: d9 d9lite d9plus
CHIPVERSION = "d9plus"
SD_PROJECT = "d9plus_ref"
SD_PROJECT_BASE_CFG="CHIPVERSION=${CHIPVERSION} SD_PROJECT=${SD_PROJECT} PROJECT_BUILDDIR_POSTFIX=_${SD_PROJECT}"

DEFAULTTUNE ?= "cortexa57-cortexa53"
require conf/machine/include/tune-cortexa57-cortexa53.inc
require conf/machine/include/${SOC_FAMILY}.inc

# 32BIT package install (default is disable)
# This variables can be used only in multilib.
USE_32BIT_PKGS ?= "0"
USE_32BIT_WAYLAND ?= "0"
USE_32BIT_MMP ?= "0"

KBUILD_DEFCONFIG_${MACHAINE_NAME} = "d9_ref_ramdisk_defconfig"
MACHINE_FEATURES = ""

require conf/machine/include/verified-boot.inc
KERNEL_IMAGETYPE = "Image.gz"
IMAGE_FSTYPES_append = " cpio"
#IMAGE_FSTYPES_remove = "tar.gz"
# use 256 MB according to bpt
IMAGE_ROOTFS_SIZE = "131072"

SERIAL_CONSOLE = "115200 ttyS0"

# Configuration for kernel
PREFERRED_PROVIDER_virtual/kernel = "linux-semidrive-dev"
PREFERRED_VERSION_linux-semidrive-dev = "4.14.61"
# PREFERRED_VERSION_linux-semidrive-dev = "5.4.6"

KERNEL_DEVICETREE = "semidrive/d9_plus_d9350_ap2_ref.dtb"
#PREFERRED_PROVIDER_virtual/drm = "drm-dev"
#PREFERRED_PROVIDER_virtual/g2d = "g2d-dev"
MACHINE_ESSENTIAL_EXTRA_RRECOMMENDS = ""
KERNEL_MODULE_AUTOLOAD = ""
#MACHINE_GPU_REV_x9h-plus_ref_cluster = "gm9226"
#MACHINE_GPU_WITHOUT_OPENCL_x9h-plus_ref_cluster = "1"

# Configuration for ARM Trusted Firmware
#EXTRA_IMAGEDEPENDS += " arm-trusted-firmware"
# Configuration for bootloaders
EXTRA_IMAGEDEPENDS += "lk"
#MACHINE_SPL_${MACHAINE_NAME} = "spl"
#MACHINE_SPLARG_${MACHAINE_NAME} = ""
#MACHINE_SSYSTEM_${MACHAINE_NAME} = "ssystem"
#MACHINE_SSYSTEMARG_${MACHAINE_NAME} = ""
#MACHINE_DLOADER_${MACHAINE_NAME} = "dloader"
MACHINE_PRELOADER_${MACHAINE_NAME} = "preloader2"
MACHINE_PRELOADERARG_${MACHAINE_NAME} = "${SD_PROJECT_BASE_CFG}"
MACHINE_BOOTLOADER_${MACHAINE_NAME} = "bootloader2"
MACHINE_BOOTLOADERARG_${MACHAINE_NAME} = "${SD_PROJECT_BASE_CFG}"
MACHINE_MP_${MACHAINE_NAME} = ""
#MACHINE_BOOT_EXTRA_OPTION_${MACHAINE_NAME} = "BOOTDEVICE=EMMC"

# safety
EXTRA_IMAGEDEPENDS += "safety"
MACHINE_SAFETY_${MACHAINE_NAME} = "safety"
MACHINE_SAFETYARG_${MACHAINE_NAME} = "${SD_PROJECT_BASE_CFG}"
MACHINE_OSPIHANDOVER_${MACHAINE_NAME} = "ospi_handover"
MACHINE_OSPIHANDOVERARG_${MACHAINE_NAME} = "${SD_PROJECT_BASE_CFG}"

#
#
# u-boot
EXTRA_IMAGEDEPENDS += "uboot"
MACHINE_UBOOT_${MACHAINE_NAME} = "uboot-${UBOOT_PROJ_NAME}"
MACHINE_UBOOT_DEFCONF_${MACHAINE_NAME}= "d9plus_ap2_defconfig"
MACHINE_UBOOT_MAKE_EXTRA_OPTION_${MACHAINE_NAME} = "ARCH=arm CROSS_COMPILE=aarch64-linux-gnu-"
MACHINE_UBOOT_BOOTLOADER_${MACHAINE_NAME} = "ivi_bootloader.bin"

#bootloader type, default lk
MACHAINE_BOOTLOADER_TYPE = "uboot"

#ssdk
#EXTRA_IMAGEDEPENDS += "ssdk"
#SD_SSDK_SAF_${MACHAINE_NAME}="d9_safety_ref"
#SD_SSDK_SEC_${MACHAINE_NAME}="d9_secure_ref"

# libdrm
PREFERRED_PROVIDER_virtual/libgles1 = "pvr-lib"
PREFERRED_PROVIDER_virtual/libgles2 = "pvr-lib"
PREFERRED_PROVIDER_virtual/egl = "pvr-lib"
##MACHINE_EXTRA_RRECOMMENDS += "pvr-lib"
PREFERRED_VERSION_libdrm = "2.4.91"

# Add variable to Build Configuration in build log
BUILDCFG_VARS_append = " SOC_FAMILY"

MACHINEOVERRIDES .= ":d9"

# Command using to build kernel-module-gles
HOSTTOOLS += "sync seq"

#default d9 in emmc only,ifyou have ospi comment below
BAREMETAL_TGT = "sec"
PRELOAD_RES_SIZE = "0x1800000"
MACHINE_DLOADERARG_${MACHAINE_NAME} += "BOOT_TYPE=emmc"
MACHINE_BAREMETALARG_${MACHAINE_NAME} = "${SD_PROJECT_BASE_CFG} BOARD=d9plus_ref DDR_FW=lpddr4 DDR_TYPE=lpddr4 DDR_SIZE=2GB DDR_FREQ=2133 D=${BAREMETAL_DEBUG}"
#MACHINE_BAREMETALARG_${MACHAINE_NAME} += "SDCARD_BOOT=1"

#IMAGE_INSTALL_append = " messagecenter cluster "
```

## meta-semidrive/conf/machine/include/bf200.inc
```bitbake
SOC_FAMILY =. "bf200-gen1:"
require conf/machine/include/soc-family.inc

MACHINE_EXTRA_RRECOMMENDS = "udev-extraconf"
```

## meta-semidrive/conf/machine/include/d9.inc
```bitbake
SOC_FAMILY =. "x9-gen1:"
require conf/machine/include/soc-family.inc
LINUXLIBCVERSION = "4.14%"

MACHINE_EXTRA_RRECOMMENDS = "udev-extraconf"
```

## meta-semidrive/conf/machine/include/verified-boot.inc
```bitbake
#VERIFIED_BOOT="true"
EXTRA_IMAGECMD_ext4_append = " -b 4096 "
EXTRA_IMAGE_FEATURES += "read-only-rootfs"
```
