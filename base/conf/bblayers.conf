## base/conf/bblayers.conf
```bitbake
LCONF_VERSION = "6"

BBPATH = "${TOPDIR}"
BSPDIR := "${@os.path.abspath(os.path.dirname(d.getVar('FILE', True)) + '/../..')}"

BBFILES ?= ""
BBLAYERS = " \
  ${BSPDIR}/poky/meta \
  ${BSPDIR}/poky/meta-poky \
  \
  ${BSPDIR}/meta-openembedded/meta-oe \
  ${BSPDIR}/meta-openembedded/meta-multimedia \
  \
  ${BSPDIR}/meta-semidrive \
"
```

## meta-semidrive/conf/distro/adas.conf
```bitbake
# Semidrive Distro for console only without graphics and multimedia

require conf/distro/include/sdrv-base.inc

DISTRO = "adas"
DISTRO_NAME = "Semidrive Linux Adas Console"

# Remove conflicting backends.
DISTRO_FEATURES_remove = "x11 wayland directfb vulkan linux-libc-headers bluetooth "
DISTRO_FEATURES_append = " opengl"


IMAGE_INSTALL_append = " \
	rpmsg-echo-test \
	stressapptest \
	sdrvinit \
	sdrvadb \
	vdsp-avm \
	input-getevent \
	csi-test \
	e2fsprogs \
	libgpiod \
	haveged \
	lib-slots-update \
	pvr-lib-tests \
	bench-es2 \
	sdshell \
	"

# gstreamer and vpu
IMAGE_INSTALL_append = "gstreamer1.0 gstreamer1.0-libav gstreamer1.0-plugins-base \
gstreamer1.0-plugins-good gstreamer1.0-plugins-bad gstreamer1.0-omx libomxil libomxvpu libvpu vputest"

PREFERRED_VERSION_gstreamer1.0 = "1.14.4"
PREFERRED_VERSION_ffmpeg = "4.2.2"

LICENSE_FLAGS_WHITELIST = "commercial_libomxil commercial_gstreamer1.0-omx commercial_gstreamer1.0-libav commercial_ffmpeg commercial_x264"

PREFERRED_VERSION_openssl = "1.1.1k"

EXTRA_IMAGE_FEATURES += "\
	debug-tweaks"

# Don't include kernels in standard images
## RDEPENDS_kernel-base = ""
# Avoid warnings with above variable change
RDEPENDS_${KERNEL_PACKAGE_NAME}-base = ""
```

## meta-semidrive/conf/distro/gateway.conf
```bitbake
# Semidrive Distro for console without graphics and multimedia

require conf/distro/include/sdrv-base.inc

DISTRO = "gateway"
DISTRO_NAME = "Semidrive Linux Gateway Console"

PREFERRED_VERSION_openssl = "1.1.1k"

# Remove conflicting backends.
DISTRO_FEATURES_remove = "x11 wayland directfb vulkan linux-libc-headers "

IMAGE_INSTALL_append = " \
	rpmsg-echo-test \
	stressapptest \
	iperf2 tcpdump net-tools \
	sdrvinit \
	sdrvadb \
	e2fsprogs \
	libgpiod \
	sdpe-eth \
	sdpe-stat \
	doip-test \
	vlan \
	openssl-bin \
	lib-slots-update \
	sdshell \
"

IMAGE_FEATURES += "ssh-server-openssh"

EXTRA_IMAGE_FEATURES += " \
	tools-debug \
	tools-profile \
	debug-tweaks \
"

# Don't include kernels in standard images
## RDEPENDS_kernel-base = ""
# Avoid warnings with above variable change
RDEPENDS_${KERNEL_PACKAGE_NAME}-base = ""
```

## meta-semidrive/conf/distro/include/sdrv-base.inc
```bitbake
require conf/distro/poky.conf

DISTRO_VERSION = "2.5"

DISTRO = "sdrv-base"
DISTRO_NAME = "Semidrive Distro Base"
SDK_VENDOR = "-sdrvsdk"

MAINTAINER = "Semidrive Software <sw@semidrive.com>"
TARGET_VENDOR = "-sdrv"
DISTROOVERRIDES = "sdrv"

# This function changes the default tune for machines which are based on armv7a
# to use common tune value
def arm_tune_handler(d):
    features = d.getVar('TUNE_FEATURES', True).split()
    if 'armv7a' in features or 'armv7ve' in features:
        tune = 'armv7athf'
        if 'bigendian' in features:
            tune += 'b'
        if 'vfpv3' in features:
            tune += '-vfpv3'
        if 'vfpv3d16' in features:
            tune += '-vfpv3d16'
        if 'neon' in features:
            tune += '-neon'
        if 'vfpv4' in features:
            tune += '-vfpv4'
    else:
        tune = d.getVar('DEFAULTTUNE', True)
    return tune

DEFAULTTUNE_smdv := "${@arm_tune_handler(d)}"

DISTRO_ARM_INSTRUCTION ?= "thumb"
DISTRO_ARM_INSTRUCTION_armv5 ?= "arm"
ARM_INSTRUCTION_SET_smdv ??= "${DISTRO_ARM_INSTRUCTION}"

# Log information on images and packages
INHERIT += "buildhistory"
BUILDHISTORY_COMMIT = "1"

# Use bluez5 as default.
#DISTRO_FEATURES_append = " bluez5"

# The following set the providers to components supported by Semidrive
# Use Kernel, U-Boot and Gstreamer 1.0 providers
PREFERRED_PROVIDER_virtual/bootloader_x9 = "lk-boot-semidrive"
PREFERRED_PROVIDER_virtual/bootloader_g9 = "lk-boot-semidrive"

#PREFERRED_PROVIDER_virtual/kernel_x9 = "linux-semidrive"
#PREFERRED_PROVIDER_virtual/kernel_g9 = "linux-semidrive"
```

## meta-semidrive/conf/distro/industry.conf
```bitbake
# Semidrive Distro for console only without graphics and multimedia

require conf/distro/include/sdrv-base.inc

DISTRO = "industry"
DISTRO_NAME = "Semidrive Linux industry Console"

# Remove conflicting backends.
#DISTRO_FEATURES_remove = "x11 wayland directfb vulkan opengl linux-libc-headers alsa bluetooth "

#QT need opengl
DISTRO_FEATURES_remove = "x11 wayland directfb vulkan linux-libc-headers bluetooth"
DISTRO_FEATURES_append = "opengl"

IMAGE_INSTALL_append = " \
	rpmsg-echo-test \
	stressapptest \
	sdrvinit \
	sdrvadb \
	input-getevent \
	csi-test \
	e2fsprogs \
	libgpiod \
	lib-slots-update \
	pvr-lib-tests \
	bench-es2 \
	strace \
	quectel-cm \
	lrzsz \
	ethtool \
	openssl-bin \
	jpeg \
	openjpeg \
	uvccamera-test \
	tcpdump \
	audio-ref \
	alsa-lib \
	alsa-utils \
	alsa-state \
	iperf3 \
	lmbench \
	vdsp-test \
	g2d-test \
        "

# gstreamer and vpu
IMAGE_INSTALL_append = "gstreamer1.0 gstreamer1.0-libav gstreamer1.0-plugins-base \
gstreamer1.0-plugins-good gstreamer1.0-plugins-bad gstreamer1.0-omx libomxil libomxvpu libvpu vputest libjpeg-turbo"

PREFERRED_VERSION_gstreamer1.0 = "1.14.4"
PREFERRED_VERSION_ffmpeg = "4.2.2"

LICENSE_FLAGS_WHITELIST = "commercial_libomxil commercial_gstreamer1.0-omx commercial_gstreamer1.0-libav commercial_ffmpeg commercial_x264"

PREFERRED_VERSION_openssl = "1.1.1k"

#ADD QT sdk and application
IMAGE_INSTALL_append = " \
        qtbase \
        qtserialport \
        qtdeclarative \
        qtquickcontrols \
        qtquickcontrols2 \
        qtgraphicaleffects \
        d9demo \
         "

EXTRA_IMAGE_FEATURES += "\
	debug-tweaks"


# Don't include kernels in standard images
## RDEPENDS_kernel-base = ""
# Avoid warnings with above variable change
RDEPENDS_${KERNEL_PACKAGE_NAME}-base = ""
```

## meta-semidrive/conf/distro/jack.conf
```bitbake
# Semidrive Distro for IVI JACK project

require conf/distro/include/sdrv-base.inc

DISTRO = "jack"
DISTRO_NAME = "Semidrive Linux IVI for JACK"
DISTRO_VERSION = "1.0"

#PREFERRED_VERSION_libdrm = "2.4.101"
#PREFERRED_VERSION_mesa = "20.0.1"
#PREFERRED_VERSION_meson = "0.53.2"

# Remove conflicting backends.
DISTRO_FEATURES_remove = "x11 directfb vulkan "
DISTRO_FEATURES_append = " opengl bluetooth bluez5 wifi wayland systemd"
VIRTUAL-RUNTIME_init_manager = "systemd"

IMAGE_INSTALL_append = " \
	rpmsg-echo-test \
	libdrm-tests \
	stressapptest \
	sdrvinit sdrvadb \
	audio-ref alsa-lib alsa-utils alsa-state \
	rt-tests \
	e2fsprogs \
	sdshell \
	libgpiod"

CORE_IMAGE_EXTRA_INSTALL += "wayland mtdev libevdev libinput libxkbcommon weston weston-examples libvulkan pvr-lib-mesa-tests "

# gstreamer and vpu
#IMAGE_INSTALL_append = " gstreamer1.0 gstreamer1.0-libav gstreamer1.0-plugins-base \
#gstreamer1.0-plugins-good gstreamer1.0-plugins-bad gstreamer1.0-omx libomxil libomxvpu libvpu vputest "

IMAGE_INSTALL_append = " ffmpeg gstreamer1.0 libomxil libomxvpu libvpu gstreamertest "
PREFERRED_VERSION_gstreamer1.0 = "1.16.3"
PREFERRED_VERSION_ffmpeg = "4.2.2"
PREFERRED_VERSION_openssl = "1.0.2p"

LICENSE_FLAGS_WHITELIST = "commercial_libomxil commercial_gstreamer1.0-omx commercial_gstreamer1.0-libav commercial_ffmpeg commercial_x264"

IMAGE_INSTALL_append = " bluez5 sdrvbtwifi wpa-supplicant optee-file"

IMAGE_FEATURES += "ssh-server-openssh"

EXTRA_IMAGE_FEATURES += "\
      tools-debug \
      dev-pkgs \
      debug-tweaks"

# Don't include kernels in standard images
## RDEPENDS_kernel-base = ""
# Avoid warnings with above variable change
RDEPENDS_${KERNEL_PACKAGE_NAME}-base = ""

PREFERRED_PROVIDER_virtual/libgles1 = "mesa"
PREFERRED_PROVIDER_virtual/libgles2 = "mesa"
PREFERRED_PROVIDER_virtual/egl = "mesa"
PREFERRED_PROVIDER_virtual/libgbm = "mesa"

# use 2048 MB according to bpt
IMAGE_ROOTFS_SIZE = "2097152"

GPU_VZ_CTRL = "nonvz"
```

## meta-semidrive/conf/distro/minimal-console.conf
```bitbake
# Semidrive Distro for console only without graphics and multimedia

require conf/distro/include/sdrv-base.inc

DISTRO = "minimal-console"
DISTRO_NAME = "Semidrive Linux Console"

PREFERRED_VERSION_openssl = "1.1.1k"
# Remove conflicting backends.
DISTRO_FEATURES_remove = "x11 wayland directfb vulkan opengl linux-libc-headers alsa bluetooth "

IMAGE_INSTALL_append = " \
	rpmsg-echo-test \
	stressapptest \
	sdrvinit \
	sdrvadb \
	csi-test \
	e2fsprogs \
	libgpiod \
	haveged \
	lib-slots-update \
	strace \
	openssl-bin \
	sdshell \
	"

EXTRA_IMAGE_FEATURES += "\
	debug-tweaks"

LICENSE_FLAGS_WHITELIST = "commercial_libomxil commercial_gstreamer1.0-omx commercial_gstreamer1.0-libav commercial_ffmpeg commercial_x264"

# Don't include kernels in standard images
## RDEPENDS_kernel-base = ""
# Avoid warnings with above variable change
RDEPENDS_${KERNEL_PACKAGE_NAME}-base = ""
```

## meta-semidrive/conf/distro/minimal-rootfs-slt.conf
```bitbake
# Semidrive Distro for cluster developer with QT feature

require conf/distro/include/sdrv-base.inc

DISTRO = "minimal-rootfs"
DISTRO_NAME = "Semidrive Linux minimal rootfs"

# Remove conflicting backends.
DISTRO_FEATURES_remove = "x11 wayland directfb vulkan linux-libc-headers usbhost pci "
DISTRO_FEATURES_append = " opengl"

IMAGE_INSTALL_append = " libdrm pvr-lib \
    sdrvinit slt-slave slt-item slt-gpu"
#IMAGE_FEATURES += "ssh-server-openssh"

# add debug tools for example strace/gdb and performance tuning tool like perf etc.
# dbg-pkgs       # adds -dbg packages for all installed packages and symbol information for debugging (GDB) and profiling.
# tools-debug    # adds debugging tools like gdb and strace.
# tools-profile  # add profiling tools (oprofile, exmap, lttng valgrind (x86 only))
# tools-testapps # add useful testing tools (ts_print, aplay, arecord etc.)
# debug-tweaks   # make image for suitable of development, like setting an empty root password
# tools-sdk      # OPTIONAL: adds development tools (gcc, make, pkgconfig, etc)
# dev-pkgs"      # OPTIONAL: adds -dev packages for all installed packages

#EXTRA_IMAGE_FEATURES += "\
#      tools-debug \
#      tools-profile \
#      debug-tweaks"

## below is example of recipe-specific debug control variables, add in recipe bb file.
# Specifies recies to build packages with debugging information
#DEBUG_BUILD = "1"
# Do not remove debug symbols
#INHIBIT_PACKAGE_STRIP = "1"
# OPTIONAL: Do not split debug symbols in a separate file
#INHIBIT_PACKAGE_DEBUG_SPLIT= "1"
#PACKAGE_DEBUG_SPLIT_STYLE = 'debug-file-directory'

INHERIT += "extrausers"
EXTRA_USERS_PARAMS = "useradd -P 000000 user1;"

PREFERRED_VERSION_openssl = "1.1.1k"

# Don't include kernels in standard images
## RDEPENDS_kernel-base = ""
# Avoid warnings with above variable change
RDEPENDS_${KERNEL_PACKAGE_NAME}-base = ""
```

## meta-semidrive/conf/distro/vertical-cluster.conf
```bitbake
# Semidrive Distro for cluster developer with QT feature

require conf/distro/include/sdrv-base.inc

DISTRO = "vertical-cluster"
DISTRO_NAME = "Semidrive Linux vertical-cluster QT"

PREFERRED_VERSION_openssl = "1.1.1k"

# Remove conflicting backends.
DISTRO_FEATURES_remove = "x11 wayland directfb vulkan linux-libc-headers "
DISTRO_FEATURES_append = " opengl"

IMAGE_INSTALL_append = " \
	rpmsg-echo-test libdrm-tests stressapptest pvr-lib-tests csi-test \
	bench-es2 sdrvinit sdrvadb messagecenter vertical-cluster e2fsprogs libgpiod lib-slots-update \
	qtbase qtserialport qtdeclarative qtquickcontrols qtquickcontrols2 qtgraphicaleffects \
	audio-ref alsa-lib alsa-utils alsa-state \
	openssl-bin \
	cluster-demo"

IMAGE_FEATURES += "ssh-server-openssh"

# add debug tools for example strace/gdb and performance tuning tool like perf etc.
# dbg-pkgs       # adds -dbg packages for all installed packages and symbol information for debugging (GDB) and profiling.
# tools-debug    # adds debugging tools like gdb and strace.
# tools-profile  # add profiling tools (oprofile, exmap, lttng valgrind (x86 only))
# tools-testapps # add useful testing tools (ts_print, aplay, arecord etc.)
# debug-tweaks   # make image for suitable of development, like setting an empty root password
# tools-sdk      # OPTIONAL: adds development tools (gcc, make, pkgconfig, etc)
# dev-pkgs"      # OPTIONAL: adds -dev packages for all installed packages

#       tools-debug
#       tools-profile
EXTRA_IMAGE_FEATURES += "\
      debug-tweaks"

## below is example of recipe-specific debug control variables, add in recipe bb file.
# Specifies recies to build packages with debugging information
#DEBUG_BUILD = "1"
# Do not remove debug symbols
#INHIBIT_PACKAGE_STRIP = "1"
# OPTIONAL: Do not split debug symbols in a separate file
#INHIBIT_PACKAGE_DEBUG_SPLIT= "1"
#PACKAGE_DEBUG_SPLIT_STYLE = 'debug-file-directory'

INHERIT += "extrausers"
EXTRA_USERS_PARAMS = "useradd -P 000000 user1;"

# Don't include kernels in standard images
## RDEPENDS_kernel-base = ""
# Avoid warnings with above variable change
RDEPENDS_${KERNEL_PACKAGE_NAME}-base = ""
```

## meta-semidrive/conf/distro/xorg.conf
```bitbake
# Semidrive Distro for IVI JACK project

require conf/distro/include/sdrv-base.inc

DISTRO = "xorg"
DISTRO_NAME = "Semidrive Linux IVI for Xorg"
DISTRO_VERSION = "1.0"

#PREFERRED_VERSION_libdrm = "2.4.101"
PREFERRED_VERSION_mesa = "20.0.1"
#PREFERRED_VERSION_mesa = "17.3.8"
#PREFERRED_VERSION_xserver-xorg = "1.20.7"
PREFERRED_VERSION_xserver-xorg = "1.19.6"
#PREFERRED_VERSION_dri3proto = "1.2"
#PREFERRED_VERSION_meson = "0.53.2"

PREFERRED_VERSION_openssl = "1.1.1k"

# Remove conflicting backends.
DISTRO_FEATURES_remove = "directfb vulkan wayland"
DISTRO_FEATURES_append = " opengl bluetooth bluez5 wifi x11 systemd"
VIRTUAL-RUNTIME_init_manager = "systemd"

IMAGE_INSTALL_append = " \
	rpmsg-echo-test \
	libdrm-tests \
	stressapptest \
	sdrvinit sdrvadb \
	audio-ref alsa-lib alsa-utils alsa-state \
	rt-tests \
	e2fsprogs \
	libgpiod \
	xf86-input-tslib \
	xf86-video-modesetting \
	xserver-xorg-extension-glx \
	"

CORE_IMAGE_EXTRA_INSTALL += " mtdev libevdev libinput libxkbcommon libxtst pvr-lib-xorg-tests"

# gstreamer and vpu
#IMAGE_INSTALL_append = " gstreamer1.0 gstreamer1.0-libav gstreamer1.0-plugins-base \
#gstreamer1.0-plugins-good gstreamer1.0-plugins-bad gstreamer1.0-omx libomxil libomxvpu libvpu vputest "

#IMAGE_INSTALL_append = " ffmpeg gstreamer1.0 libomxil libomxvpu libvpu "
#PREFERRED_VERSION_gstreamer1.0 = "1.16.3"
#PREFERRED_VERSION_ffmpeg = "4.2.2"

#LICENSE_FLAGS_WHITELIST = "commercial_libomxil commercial_gstreamer1.0-omx commercial_gstreamer1.0-libav commercial_ffmpeg commercial_x264"

IMAGE_INSTALL_append = " bluez5 sdrvbtwifi wpa-supplicant optee-file"

IMAGE_FEATURES += " ssh-server-openssh package-management x11-base"

EXTRA_IMAGE_FEATURES += "\
      tools-debug \
      dev-pkgs \
      debug-tweaks"

# Don't include kernels in standard images
## RDEPENDS_kernel-base = ""
# Avoid warnings with above variable change
RDEPENDS_${KERNEL_PACKAGE_NAME}-base = ""

PREFERRED_PROVIDER_virtual/libgl = "mesa"
PREFERRED_PROVIDER_virtual/libgles1 = "mesa"
PREFERRED_PROVIDER_virtual/libgles2 = "mesa"
PREFERRED_PROVIDER_virtual/egl = "mesa"
PREFERRED_PROVIDER_virtual/libgbm = "mesa"
PREFERRED_PROVIDER_virtual/mesa = "mesa"

# use 2048 MB according to bpt
IMAGE_ROOTFS_SIZE = "2097152"

GPU_VZ_CTRL = "nonvz"
MESA_PATH_SUFFIX = "_xorg"
```

## meta-semidrive/conf/layer.conf
```bitbake
# We have a conf and classes directory, add to BBPATH
BBPATH .= ":${LAYERDIR}"

# We have recipes-* directories, add to BBFILES
BBFILES += "${LAYERDIR}/recipes-*/*/*.bb \
    ${LAYERDIR}/recipes-*/*/*.bbappend"

BBFILE_COLLECTIONS += "x9-gen1"
BBFILE_PATTERN_x9-gen1 = "^${LAYERDIR}/"
BBFILE_PRIORITY_x9-gen1 = "6"
LAYERSERIES_COMPAT_x9-gen1 = "sumo"
```
