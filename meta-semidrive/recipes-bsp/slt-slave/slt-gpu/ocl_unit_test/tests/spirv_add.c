/*************************************************************************/ /*!
@File           spirv_add.c
@Copyright      Copyright (c) Imagination Technologies Ltd. All Rights Reserved
@License        Strictly Confidential.
*/ /**************************************************************************/

typedef struct _SpirVAddData_
{
	/* CL Objects */
	cl_context       psContext;
	cl_program       psProgram;
	cl_device_id     psDeviceID;
	cl_platform_id   psPlatformID;
	cl_command_queue psCommandQueue;
	cl_kernel        psKernel;
	cl_mem           psBufferA;
	cl_mem           psBufferB;

	/* Host Object */
	unsigned int *pui32BufferA;
	unsigned int *pui32BufferB;
	size_t        puGlobalWorkSize[3];
	size_t*       puLocalWorkSize;

} SpirVAddData;

cl_int Init_SpirVAdd(OCLTestInstance *psInstance);
cl_int Compute_SpirVAdd(OCLTestInstance *psInstance);
cl_int Verify_SpirVAdd(OCLTestInstance *psInstance);

#define TEST_ADD_MAX_INSTANCES 4096

static const unsigned char g_ucAddSpv64[] =
{
  0x03, 0x02, 0x23, 0x07, 0x00, 0x00, 0x01, 0x00, 0x0e, 0x00, 0x06, 0x00,
  0x1a, 0x00, 0x00, 0x00, 0x00, 0x00, 0x00, 0x00, 0x11, 0x00, 0x02, 0x00,
  0x04, 0x00, 0x00, 0x00, 0x11, 0x00, 0x02, 0x00, 0x05, 0x00, 0x00, 0x00,
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  0xfd, 0x00, 0x01, 0x00, 0x38, 0x00, 0x01, 0x00
};

static const unsigned char g_ucAddSpv32[] =
{
  0x03, 0x02, 0x23, 0x07, 0x00, 0x00, 0x01, 0x00, 0x0e, 0x00, 0x06, 0x00, 0x15, 0x00, 0x00, 0x00,
  0x00, 0x00, 0x00, 0x00, 0x11, 0x00, 0x02, 0x00, 0x04, 0x00, 0x00, 0x00, 0x11, 0x00, 0x02, 0x00,
  0x05, 0x00, 0x00, 0x00, 0x11, 0x00, 0x02, 0x00, 0x06, 0x00, 0x00, 0x00, 0x0b, 0x00, 0x05, 0x00,
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  0xfd, 0x00, 0x01, 0x00, 0x38, 0x00, 0x01, 0x00
};

/***********************************************************************************
 Function Name      : Init_SpirVAdd
 Inputs             : None
 Outputs            : None
 Returns            : None
 Description        : Initialises input data
************************************************************************************/
cl_int Init_SpirVAdd(OCLTestInstance *psInstance)
{
	cl_int eResult;

	SpirVAddData *psData = (SpirVAddData*)calloc(1, sizeof(SpirVAddData));

	if(!psData)
		return CL_OUT_OF_RESOURCES;

	/* Initialise data */
	psInstance->pvPrivateData = (void*)psData;

	/* Initialise host side objects */

	/* Allocate first host buffer */
	psData->pui32BufferA = (unsigned int*)malloc(sizeof(unsigned int)*TEST_ADD_MAX_INSTANCES);

	if(!psData->pui32BufferA)
	{
		free(psData);
		return CL_OUT_OF_RESOURCES;
	}

	/* Allocate second host buffer */
	psData->pui32BufferB = (unsigned int*)malloc(sizeof(unsigned int)*TEST_ADD_MAX_INSTANCES);

	if(!psData->pui32BufferB)
	{
		free(psData->pui32BufferA);
		free(psData);
		return CL_OUT_OF_RESOURCES;
	}

	/* Initialise with test values */
	{
		unsigned int i;

		for(i=0; i < TEST_ADD_MAX_INSTANCES; i++)
		{
			psData->pui32BufferA[i] = rand();
			psData->pui32BufferB[i] = rand();
		}
	}

	eResult = clGetPlatformIDs(1,&psData->psPlatformID,NULL);
	CheckAndReportError(psInstance, "clGetPlatformIDs", eResult, init_add_cleanup);

	eResult = clGetDeviceIDs(psData->psPlatformID,CL_DEVICE_TYPE_GPU | CL_DEVICE_TYPE_ACCELERATOR,1,&psData->psDeviceID,NULL);
	CheckAndReportError(psInstance, "clGetDeviceIDs", eResult, init_add_cleanup);

	psData->psContext = clCreateContext(NULL,1,&psData->psDeviceID,NULL,NULL,&eResult);
	CheckAndReportError(psInstance, "clCreateContext", eResult, init_add_cleanup);

	cl_uint size_t_width;
	eResult = clGetDeviceInfo(psData->psDeviceID, CL_DEVICE_ADDRESS_BITS, sizeof(cl_uint), &size_t_width, NULL);
	CheckAndReportError(psInstance, "clGetDeviceInfo", eResult, init_add_cleanup);

	size_t g_uiAddSpvLen;

	if (size_t_width == 32)
	{
		const unsigned char *ucAddSpv = &g_ucAddSpv32[0];
		g_uiAddSpvLen = sizeof(g_ucAddSpv32);
		psData->psProgram = clCreateProgramWithBinary(psData->psContext, 1, &psData->psDeviceID, &g_uiAddSpvLen, &ucAddSpv, NULL, &eResult);
	}
	else
	{
		const unsigned char *ucAddSpv = &g_ucAddSpv64[0];
		g_uiAddSpvLen = sizeof(g_ucAddSpv64);
		psData->psProgram = clCreateProgramWithBinary(psData->psContext, 1, &psData->psDeviceID, &g_uiAddSpvLen, &ucAddSpv, NULL, &eResult);
	}
	CheckAndReportError(psInstance, "clCreateProgramWithBinary", eResult, init_add_cleanup);

	eResult = clBuildProgram(psData->psProgram,1,&psData->psDeviceID,"-cl-img-spirv",NULL,NULL);
	CheckAndReportError(psInstance, "clBuildProgram", eResult, init_add_cleanup);

	psData->psCommandQueue = clCreateCommandQueue(psData->psContext, psData->psDeviceID, 0, &eResult);
	CheckAndReportError(psInstance, "clCreateCommandQueue", eResult, init_add_cleanup);

	/*
	 * Setup the Arguments
	 */

	psData->psBufferA = clCreateBuffer(psData->psContext, CL_MEM_COPY_HOST_PTR, sizeof(cl_uint) * TEST_ADD_MAX_INSTANCES, psData->pui32BufferA, &eResult);
	CheckAndReportError(psInstance, "clCreateBuffer", eResult, init_add_cleanup);

	psData->psBufferB = clCreateBuffer(psData->psContext, CL_MEM_COPY_HOST_PTR, sizeof(cl_uint) * TEST_ADD_MAX_INSTANCES, psData->pui32BufferB, &eResult);
	CheckAndReportError(psInstance, "clCreateBuffer", eResult, init_add_cleanup);

	psData->psKernel = clCreateKernel(psData->psProgram, "AdditionKernel", &eResult);
	CheckAndReportError(psInstance, "clCreateKernel", eResult, init_add_cleanup);

	eResult = clSetKernelArg(psData->psKernel, 0, sizeof(cl_mem), (void*) &psData->psBufferA );
	CheckAndReportError(psInstance, "clSetKernelArg", eResult, init_add_cleanup);

	eResult = clSetKernelArg(psData->psKernel, 1, sizeof(cl_mem), (void*) &psData->psBufferB );
	CheckAndReportError(psInstance, "clSetKernelArg", eResult, init_add_cleanup);

	/* Setup the size of the kernel run */
	psData->puGlobalWorkSize[0] = TEST_ADD_MAX_INSTANCES;
	psData->puLocalWorkSize = NULL;

	return CL_SUCCESS;

init_add_cleanup:
	return eResult;
}

/***********************************************************************************
 Function Name      : Compute_SpirVAdd
 Inputs             : psInstance - test instance data
 Returns            : 0 or 1
 Description        : Main compute func
************************************************************************************/
cl_int Compute_SpirVAdd(OCLTestInstance *psInstance)
{
	cl_int eResult;
	SpirVAddData *psData =(SpirVAddData*) psInstance->pvPrivateData;

	OCLTestLog("%s: Online compilation of SPIR-V test with %zu instances\n",
	       __func__,psData->puGlobalWorkSize[0]);

	eResult = clEnqueueNDRangeKernel(psData->psCommandQueue, psData->psKernel, 1, NULL, psData->puGlobalWorkSize, psData->puLocalWorkSize , 0, NULL, NULL);
	CheckAndReportError(psInstance, "clEnqueueNDRangeKernel", eResult, compute_add_cleanup);

	clFinish(psData->psCommandQueue);

	return CL_SUCCESS;

compute_add_cleanup:
	return eResult;
}

/***********************************************************************************
 Function Name      : Verify_SpirVAdd
 Inputs             : None
 Outputs            : None
 Returns            : None
 Description        : Verifies output data
************************************************************************************/

cl_int Verify_SpirVAdd(OCLTestInstance *psInstance)
{
#if !defined(NO_HARDWARE)
	unsigned int t;
#endif /* !defined(NO_HARDWARE) */

	unsigned int *pui32Results = NULL;
	cl_int eResult = CL_SUCCESS;

	SpirVAddData *psData =(SpirVAddData*) psInstance->pvPrivateData;
	psData = psData;

	/* Allocate temporary buffer for reading back results */
	pui32Results = (unsigned int*)malloc(sizeof(unsigned int)*TEST_ADD_MAX_INSTANCES);

	if(!pui32Results)
	{
		free(psInstance->pvPrivateData);
		psInstance->pvPrivateData = strdup("Results buffer allocation failure");
		return CL_OUT_OF_HOST_MEMORY;
	}

	/* Read back the results */
	eResult = clEnqueueReadBuffer(psData->psCommandQueue, psData->psBufferA, CL_TRUE, 0, sizeof(cl_uint) * TEST_ADD_MAX_INSTANCES, pui32Results, 0, NULL, NULL);
	CheckAndReportError(psInstance, "clEnqueueReadBuffer", eResult, verify_add_cleanup);

#if !defined(NO_HARDWARE)
	/* Verify the written back data with what we would expect */
	for(t=0; t < TEST_ADD_MAX_INSTANCES; t++)
	{
		if( pui32Results[t] != (psData->pui32BufferA[t] + psData->pui32BufferB[t]))
		{
			OCLTestLog("%s: Verification failure at %d, expected (%d,%d)=%d got %d.\n",
			       __func__,
			       t,
			       psData->pui32BufferA[t],
			       psData->pui32BufferB[t],
			       psData->pui32BufferA[t]+psData->pui32BufferB[t],
			       pui32Results[t]);

			/* Verification Error */
			free(psInstance->pvPrivateData);
			psInstance->pvPrivateData = strdup("Verification failure");
			return CL_INVALID_VALUE;
		}
	}

	OCLTestLog("%s: Verification OK\n",__func__);
#endif /* !defined(NO_HARDWARE) */

	/* Cleanup */
	clReleaseKernel      ( psData->psKernel       );
	clReleaseMemObject   ( psData->psBufferA      );
	clReleaseMemObject   ( psData->psBufferB      );
	clReleaseCommandQueue( psData->psCommandQueue );
	clReleaseProgram     ( psData->psProgram      );
	clReleaseContext     ( psData->psContext      );

verify_add_cleanup:
	free(psData->pui32BufferA);
	free(psData->pui32BufferB);
	free(pui32Results);

	free(psInstance->pvPrivateData);
	psInstance->pvPrivateData = NULL;
	return eResult;
}

/******************************************************************************
 End of file (spirv_add.c)
******************************************************************************/
